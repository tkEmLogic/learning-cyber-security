## CMakeLists.txt
```
# SPDX-License-Identifier: Apache-2.0

cmake_minimum_required(VERSION 3.20.0)

# PROTOTYPE, issue #157. The spike lives under prototypes/, so the shared
# module is three directories further away than it is for a real tier.
list(APPEND EXTRA_ZEPHYR_MODULES ${CMAKE_CURRENT_SOURCE_DIR}/../../../firmware/common)

find_package(Zephyr REQUIRED HINTS $ENV{ZEPHYR_BASE})
project(tier_07_opaque_tls_spike)

test_sysbuild()

# The trust anchor is compiled into the image, the same way the Wi-Fi
# credentials are. ./course build firmware writes course_ca_der.inc from the
# Course certificate authority in .course-secrets/, and passes the directory
# here.
#
# Without it the build falls back to anchor/, which holds an empty anchor. The
# repository then still builds standalone, and the resulting image refuses to
# connect and says why. An image that trusts nothing is the right failure: the
# alternative is an image that trusts anything.
# The directory arrives in the environment rather than as a CMake cache
# variable. Sysbuild keeps an image-scoped -D<image>_VAR in its own cache and
# does not forward an arbitrary one into the image build, so a cache variable
# silently produced an image with no anchor. The environment reaches every
# image's configure step.
if(DEFINED ENV{COURSE_CA_INC_DIR})
	zephyr_include_directories($ENV{COURSE_CA_INC_DIR})
else()
	zephyr_include_directories(anchor)
endif()

# The release manifest verification key arrives the same way, from
# ./course build firmware, which writes release_pubkey.inc from the public half
# of the Learner's Release signing key. It has its own variable because it is
# its own decision: the certificate authority says which service to talk to,
# and this key says whose release metadata to believe. Nothing about one
# implies the other.
#
# Without it the build falls back to anchor/, which holds no key, and the
# resulting image verifies no manifest and says so at boot and at every
# refusal. That is the same honest failure the empty trust anchor produces.
if(DEFINED ENV{COURSE_RELEASE_KEY_INC_DIR})
	zephyr_include_directories($ENV{COURSE_RELEASE_KEY_INC_DIR})
else()
	zephyr_include_directories(anchor)
endif()

# The fleet identity, compiled into the shared image only.
#
# ./course build firmware --tier 06 --variant shared writes these and sets the
# variable. It is the one build in the course that is handed a private key, and
# the variable is set for that one variant, so the factory build does not have
# the key on its include path at all. See the Tier 6 section of
# docs/fixture-safety-contract.md for the bound on that exception.
#
# Without it the build falls back to anchor/, which is empty, and the shared
# image can prove possession of nothing and says so. That is the same honest
# failure the empty trust anchor produces.
if(DEFINED ENV{COURSE_SHARED_IDENTITY_INC_DIR})
	zephyr_include_directories($ENV{COURSE_SHARED_IDENTITY_INC_DIR})
else()
	zephyr_include_directories(anchor)
endif()

# PROTOTYPE, issue #157. The two files that make this a spike rather than a
# copy of Tier 6.
target_sources(app PRIVATE
	src/opaque_tls.c
	src/spike.c
	src/health_gate.c
	src/identity.c
	src/main.c
	src/ota_client.c
	src/recovery_state.c
	src/release_policy.c
)

target_sources_ifdef(CONFIG_COURSE_PROVISIONING_SHELL app PRIVATE
	src/provisioning_shell.c
)

target_sources_ifdef(CONFIG_COURSE_SHARED_SHELL app PRIVATE
	src/shared_shell.c
)
```

## prj.conf
```kconfig
CONFIG_PRINTK=y
CONFIG_ESPTOOLPY_FLASHSIZE_4MB=y
CONFIG_MAIN_STACK_SIZE=8192
CONFIG_REBOOT=y

# Wi-Fi station and IPv4. Tier 2 speaks HTTPS to one literal address and checks
# the certificate against a name, so it still needs no name resolution. The
# name is compared, never looked up, and there is no resolver in this image.
#
# Tier 4 fetches two more objects over that same connection, the Release
# manifest and its detached signature. Verifying the manifest does not make an
# unverified connection acceptable, so nothing here is relaxed.
CONFIG_NETWORKING=y
CONFIG_WIFI=y
CONFIG_NET_IPV4=y
CONFIG_NET_IPV6=n
CONFIG_NET_DHCPV4=y
CONFIG_NET_TCP=y
CONFIG_NET_SOCKETS=y
CONFIG_NET_MGMT=y
CONFIG_NET_MGMT_EVENT=y
CONFIG_NET_MGMT_EVENT_INFO=y
CONFIG_NET_MGMT_EVENT_STACK_SIZE=4096
CONFIG_ESP32_WIFI_STA_AUTO_DHCPV4=y

CONFIG_NET_PKT_RX_COUNT=16
CONFIG_NET_PKT_TX_COUNT=16
CONFIG_NET_BUF_RX_COUNT=32
CONFIG_NET_BUF_TX_COUNT=32
CONFIG_NET_MAX_CONTEXTS=8

CONFIG_HTTP_CLIENT=y
CONFIG_JSON_LIBRARY=y

# TLS for the update and status connection.
#
# CONFIG_MBEDTLS is already on in Tier 0, because the Wi-Fi driver needs it.
# Tier 2 adds the socket layer, the credential store, and one ciphersuite.
CONFIG_NET_SOCKETS_SOCKOPT_TLS=y
CONFIG_TLS_CREDENTIALS=y
CONFIG_MBEDTLS_CIPHERSUITE_TLS_ECDHE_ECDSA_WITH_AES_128_GCM_SHA256=y
CONFIG_MBEDTLS_ENABLE_HEAP=y
CONFIG_MBEDTLS_HEAP_SIZE=49152
# A TLS record can be 16 KiB, and the peer decides how big it makes one.
#
# This was 2048 while Tier 3 was being built, because every response Tier 2
# had ever fetched over TLS was a small JSON record that fitted. Tier 3 is the
# first tier to download a firmware image over the verified connection, and the
# Go service sends that in full sized records. The client cannot hold one,
# mbedTLS treats it as fatal, and the socket layer returns -ECONNABORTED before
# a single byte reaches the flash writer.
#
# The symptom is misleading: "ota.request failed err=-113" after a handshake
# the same log line says succeeded. Nothing in the failure mentions buffers.
#
# Tier 2 now sets 16384 for the same reason. See issue #62.
CONFIG_MBEDTLS_SSL_MAX_CONTENT_LEN=16384
CONFIG_NET_SOCKETS_TLS_MAX_CONTEXTS=2

# The trust anchor is compiled in as DER, so the PEM parser is not needed.
#
# Tier 4 adds a second compiled-in key, the release manifest verification key,
# and it stays off for that too. The build strips it to a bare 65-byte EC point
# that PSA imports directly. Measured on issue #65: turning PEM parsing back on
# costs 1696 bytes of .text and 228 of .flash.rodata to do at run time what the
# build does for free, and puts a text parser on the path to a trust decision.
CONFIG_MBEDTLS_PEM_PARSE_C=n

# Verifying the Release manifest needs no new Kconfig symbol at all.
#
# psa_hash_compute, mbedtls_ecdsa_der_to_raw, psa_import_key and
# psa_verify_hash are already linked into the untouched Tier 3 image, pulled in
# by two lines nobody set for this purpose: the ciphersuite above selects
# PSA_WANT_ALG_ECDSA, PSA_WANT_ALG_SHA_256 and the ECC key types and implies
# PSA_WANT_ECC_SECP_R1_256, and CONFIG_NET_SOCKETS_SOCKOPT_TLS does
# "select PSA_CRYPTO". psa_crypto_init() is already called from Zephyr's own
# SYS_INIT.
#
# The two lines below are assertions, not requests. They are already y, they
# change no bytes, and they are here so that a future change to the ciphersuite
# fails the build rather than quietly removing a verifier. release_policy.c
# carries the same statement as compile-time #error probes, because a symbol
# being set is not the same as a driver being present.
#
# Do not reach for CONFIG_MBEDTLS_ECDSA_C, CONFIG_MBEDTLS_ECP_C or
# CONFIG_MBEDTLS_ECP_DP_SECP256R1_ENABLED. This tree is Mbed TLS 4.1.0 with the
# separate tf-psa-crypto module and those symbols do not exist here; curves and
# algorithms are selected only through PSA_WANT_*.
CONFIG_PSA_WANT_ALG_ECDSA=y
CONFIG_PSA_WANT_ECC_SECP_R1_256=y

# Certificate validity dates are deliberately not checked.
#
# This board has no real-time clock. With CONFIG_MBEDTLS_HAVE_TIME_DATE=y and
# no time source the clock reads 1970, every certificate is "not yet valid",
# and every handshake fails forever. The option is orthogonal to chain and name
# checking, so leaving it off costs neither of those.
#
# The consequence is real and belongs in the Weakness ledger: this device would
# accept an expired certificate. Tier 8 is where credential lifetime becomes
# the subject.
CONFIG_MBEDTLS_HAVE_TIME_DATE=n

# Reading the verification flags after a refusal, so the device can say which
# check failed instead of only that something did.
CONFIG_MBEDTLS_X509_CRT_PARSE_C=y

# Writing the downloaded image into the secondary slot and asking MCUboot to
# swap it in. Tier 0 deliberately added no check here at all; Tier 4 decides
# whether to write before the transfer starts, and whether to request the swap
# after the bytes have been hashed.
CONFIG_FLASH=y
CONFIG_FLASH_MAP=y
CONFIG_STREAM_FLASH=y
CONFIG_IMG_MANAGER=y
CONFIG_IMG_ERASE_PROGRESSIVELY=y
CONFIG_MCUBOOT_IMG_MANAGER=y

# The course network may publish the same name on 2.4 GHz and 5 GHz. Scanning
# every channel makes the board pick the 2.4 GHz radio it can actually use.
CONFIG_ESP32_WIFI_STA_SCAN_ALL=y
CONFIG_ESP32_WIFI_STA_RECONNECT=y

# Tier 5: the storage partition's first use in this course.
#
# The 192 KiB storage partition at 0x3b0000 has been in the pinned flash map
# since Tier 0 and no tier has ever written to it. Tier 5 needs somewhere for
# the download progress record and the trial failure count to survive a power
# cut, and this is what that partition is for.
#
# NVS directly rather than the settings subsystem. Settings is built on NVS
# here, so it is a layer of ergonomics over a record with four fields, and in
# the one tier whose subject is what survives a power cut a Learner is better
# served by seeing the write that matters.
CONFIG_NVS=y

# Tier 5: the watchdog that resets a trial image which hangs before it can
# report failure.
#
# Nothing in firmware/ has ever set this, and the esp32 driver actively
# disables the hardware during its own init, so the watchdog is off until an
# application turns it on and calls wdt_setup(). An image that hangs on a board
# with no watchdog running looks exactly like a control working.
#
# Read the COURSE_TRIAL_HANG help text before assuming this catches every hang.
# It does not, and what it misses is in the Tier 5 ledger.
CONFIG_WATCHDOG=y

# Reading back the image from the secondary slot to hash it.
#
# Tier 4 hashed the bytes as they streamed past, which a resumable download
# cannot do: after a power cut the hash state is gone, and persisting SHA-256
# midstate would be a great deal of unpleasantness for no gain. Tier 5 hashes
# the slot once the transfer completes instead.
#
# That is strictly the better check. Tier 4's comment says the digest protects
# the upgrade request, and hashing the slot makes that true of what is actually
# in the flash rather than of what the device believes it wrote.
CONFIG_FLASH_PAGE_LAYOUT=y

# Tier 6: a device identity key generated on the board.
#
# PSA_WANT_ALG_ECDSA and PSA_WANT_ECC_SECP_R1_256 are already on above, from
# Tier 4's manifest verification. Generating a key rather than only verifying
# with one needs the keypair types as well.
CONFIG_PSA_WANT_KEY_TYPE_ECC_KEY_PAIR_GENERATE=y
CONFIG_PSA_WANT_KEY_TYPE_ECC_KEY_PAIR_EXPORT=y
CONFIG_PSA_WANT_ALG_SHA_256=y

# PSA_WANT_KEY_TYPE_ECC_PUBLIC_KEY is not optional and it fails silently.
#
# MBEDTLS_PK_MAX_PUBKEY_RAW_LEN is defined as 0 without it (pk.h:91) and that
# constant sizes a buffer in every PK context, so the failure is a zero length
# public key rather than a build error. It is currently on in some builds only
# as a side effect of the Wi-Fi driver's WPA3 option, which is not something to
# depend on. Measured on issue #108.
CONFIG_PSA_WANT_KEY_TYPE_ECC_PUBLIC_KEY=y

# Writing a certification request. MBEDTLS_X509_CSR_WRITE_C selects nothing at
# all, and the CSR writer calls mbedtls_pk_write_pubkey_der(), which is
# compiled out without MBEDTLS_PK_WRITE_C. Both are named here rather than one
# being assumed to imply the other.
#
# MBEDTLS_PEM_WRITE_C is deliberately absent. The request goes over the wire as
# DER. Turning PEM writing on would partly reverse the size decision Tier 5
# made and explained when it set CONFIG_MBEDTLS_PEM_PARSE_C=n.
CONFIG_MBEDTLS_PK_WRITE_C=y
CONFIG_MBEDTLS_X509_CSR_WRITE_C=y
CONFIG_MBEDTLS_X509_USE_C=y

# Storing the private key, in the exact configuration section 8 fixes.
#
# Read the limitation with it. The AEAD key is SHA-256 over a device identifier
# and the entry uid, and on this part that identifier is six bytes of the
# factory MAC: a value the device broadcasts in every Wi-Fi frame and which
# esptool read-mac prints over the same cable used to dump the flash. This
# encrypts the key at rest against casual inspection and detects unauthenticated
# changes. It is not a protected root secret, it does not prevent record replay,
# and it does not protect the key from privileged firmware, a debugger, or a
# capable flash attacker.
#
# Zephyr says so itself at boot, and the course leaves that warning switched on:
#   WARNING: Using a potentially insecure PSA ITS encryption key provider.
CONFIG_SECURE_STORAGE=y
CONFIG_SECURE_STORAGE_ITS_TRANSFORM_IMPLEMENTATION_AEAD=y
CONFIG_SECURE_STORAGE_ITS_TRANSFORM_AEAD_SCHEME_AES_GCM=y
CONFIG_SECURE_STORAGE_ITS_TRANSFORM_AEAD_KEY_PROVIDER_DEVICE_ID_HASH=y
CONFIG_SECURE_STORAGE_ITS_STORE_IMPLEMENTATION_SETTINGS=y

# The device identifier the key provider hashes comes from hwinfo.
CONFIG_HWINFO=y

# Settings, which the ITS store writes through, and which brings its own NVS
# instance on the storage partition.
#
# Tier 5 mounted its own nvs_fs at the first byte of that same partition and
# explained at length why it chose NVS over settings. Both land on the same
# bytes and nothing detects it: nvs_mount() checks write block size, sector
# size and a count of at least two, and nothing else, so both mounts return 0
# and the damage does not wait for a write.
#
# Tier 6 keeps Tier 5's raw records and its reasoning, and stops mounting a
# second instance. recovery_state.c now writes through the instance settings
# already owns, reached with settings_storage_get(). The entry id spaces do not
# overlap: settings uses 0x8000 and above, Tier 5 uses 1, 2 and 3. Measured on
# issue #109, decided on issue #120.
CONFIG_SETTINGS=y
CONFIG_SETTINGS_NVS=y

# The provisioning interface.
#
# SHELL_MINIMAL is the load-bearing line. Without it KERNEL_SHELL is default y
# and implies INIT_STACKS, THREAD_MONITOR, THREAD_NAME and THREAD_STACK_INFO,
# so a plain CONFIG_SHELL=y would hand anyone with the cable thread
# introspection and a reboot command. Every one of those, and the built-in
# commands, history, tab completion and VT100 handling, is gated on the same
# !SHELL_MINIMAL condition, so one symbol turns the lot off and anything
# upstream adds the same way stays off too.
#
# SHELL_AUTOSTART is off so the application chooses when the shell runs.
# shell_init() still runs at boot from the backend; AUTOSTART only decides
# whether it calls shell_start() for you (shell.c:1369).
CONFIG_SHELL=y
CONFIG_SHELL_MINIMAL=y
CONFIG_SHELL_AUTOSTART=n
CONFIG_SHELL_BACKEND_SERIAL=y

# The provisioning shell's own thread, and the buffers around it.
#
# Every one of these three was found on the board, and each produced a failure
# that looked like something else.
#
# SHELL_STACK_SIZE defaults to 2048. Enrollment runs the entire certification
# request on this thread: loading the persistent PSA key out of Secure Storage
# decrypts an AES-GCM record through settings and NVS, and the CSR writer then
# encodes and signs. That overran 2 KiB and the symptom was an illegal
# instruction at an address in SRAM with a call trace pointing into gcm_mask,
# which reads like a fault inside the crypto library rather than like a stack
# that ran out. It is neither: it is a return address overwritten by the frame
# below it.
CONFIG_SHELL_STACK_SIZE=8192

# A stack that runs out should say so instead of jumping to whatever the data
# happened to be. The sentinel is checked on every context switch and turns the
# failure above into a named panic. It is here because the failure it names
# cost a debugging session, and because an unprovisioned board in front of a
# Learner is exactly where this path runs.
CONFIG_STACK_SENTINEL=y

# The station sends the issued certificate over this console. The command
# buffer defaults to 128 bytes, which is shorter than the certificate.
CONFIG_SHELL_CMD_BUFF_SIZE=256

# The serial backend's receive ring defaults to 64 bytes. The shell thread does
# not drain it fast enough when a host writes a long line in one go, and the
# first attempt at enrollment lost characters out of the middle of a 64
# character credential and acted on the corrupted text. Nothing reported the
# loss: a dropped character is not an error, it is simply a different command.
CONFIG_SHELL_BACKEND_SERIAL_RX_RING_BUFFER_SIZE=512

# Issue #158 only: the stack high water mark #157 did not measure.
#
# INIT_STACKS fills the stacks with a pattern at boot, which is what makes
# k_thread_stack_space_get() report anything other than the whole stack, and
# THREAD_MONITOR is what lets the analyzer walk every thread rather than only
# the one asking. Both are measurement instruments, not firmware: Tier 6 turned
# them off deliberately with CONFIG_SHELL_MINIMAL, because they hand anyone with
# the cable thread introspection. They belong in a spike image and not in a
# shipped one.
CONFIG_INIT_STACKS=y
CONFIG_THREAD_MONITOR=y
CONFIG_THREAD_NAME=y
CONFIG_THREAD_STACK_INFO=y
CONFIG_THREAD_ANALYZER=y
CONFIG_THREAD_ANALYZER_USE_PRINTK=y
CONFIG_THREAD_ANALYZER_AUTO=n
```

## src/identity.c
```c
/*
 * Tier 6 device identity.
 *
 * Settled on issues #105, #112, #113, #114 and #120.
 *
 * The factory build generates a P-256 key with the platform random number
 * generator, keeps it through the PSA Secure Storage configuration section 8
 * fixes, and proves possession of it in a certification request. Only the
 * public half ever leaves the device.
 *
 * Read the limitation with the code. The Secure Storage AEAD key is SHA-256
 * over a device identifier and the entry uid, and on this part that identifier
 * is six bytes of the factory MAC, which the device broadcasts in every Wi-Fi
 * frame. The key is encrypted at rest against casual inspection and its record
 * is authenticated against unauthenticated change. It is not protected against
 * anyone who can read the flash and run a hash.
 */

#include "identity.h"

#include <zephyr/kernel.h>
#include <zephyr/settings/settings.h>
#include <string.h>
#include <stdio.h>

#ifdef CONFIG_COURSE_IDENTITY_FACTORY

#include <psa/crypto.h>
#include <mbedtls/pk.h>
#include <mbedtls/x509_csr.h>
#include <mbedtls/x509_crt.h>

/*
 * The persistent PSA key identifier for the Factory key.
 *
 * Fixed rather than allocated. The device has exactly one Factory key for its
 * life, and a key whose identifier moved would be a key the next boot could
 * not find.
 */
#define COURSE_FACTORY_KEY_ID ((psa_key_id_t)0x00000601)

/* Where the certificate is kept. Settings, not Secure Storage.
 *
 * A certificate is public by construction: the device hands it to anyone who
 * connects. Putting it inside a store whose purpose is confidentiality would
 * blur the distinction this tier exists to draw, and a Learner who saw the key
 * and the certificate handled identically would learn that "secure storage"
 * means "important storage".
 */
#define COURSE_CERT_SETTINGS_KEY "course/identity/factory-cert"
#define COURSE_CERT_MAX 800

/*
 * The Bootstrap credential extension.
 *
 * OID 1.3.6.1.4.1.99999.6.1, a synthetic identifier under a private enterprise
 * arc that belongs to nobody, invented for the same reason Tier 5 invented a
 * custom image TLV tag: the value has to live somewhere the signature covers
 * and no standard attribute means what this one means.
 *
 * The bytes below are the OID's content octets, and they must agree with
 * courseCredentialOID in internal/courseapp/tier06.go. They were taken from
 * that encoder rather than worked out by hand.
 */
static const char credential_oid[] = {
	0x2B, 0x06, 0x01, 0x04, 0x01, 0x86, 0x8D, 0x1F, 0x06, 0x01
};

static unsigned char stored_cert[COURSE_CERT_MAX];
static size_t stored_cert_len;
static char device_id[COURSE_DEVICE_ID_MAX];
static char fingerprint[2 * 32 + 1];

static int cert_settings_set(const char *name, size_t len,
			     settings_read_cb read_cb, void *cb_arg)
{
	ARG_UNUSED(name);
	if (len > sizeof(stored_cert)) {
		printk("identity.load certificate is %zu bytes, larger than %zu\n",
		       len, sizeof(stored_cert));
		return -EINVAL;
	}
	ssize_t got = read_cb(cb_arg, stored_cert, len);
	if (got < 0) {
		return (int)got;
	}
	stored_cert_len = (size_t)got;
	return 0;
}

static struct settings_handler cert_handler = {
	.name = "course/identity",
	.h_set = cert_settings_set,
};

/* Read the identifier and the fingerprint out of the certificate itself.
 *
 * One source of truth. A device that held its identifier separately could
 * report a name its certificate does not carry, which is the gap this tier is
 * closing rather than one to reopen.
 */
static int describe_certificate(void)
{
	device_id[0] = '\0';
	fingerprint[0] = '\0';
	if (stored_cert_len == 0) {
		return 0;
	}

	mbedtls_x509_crt cert;
	mbedtls_x509_crt_init(&cert);
	int err = mbedtls_x509_crt_parse_der(&cert, stored_cert, stored_cert_len);
	if (err != 0) {
		printk("identity.load stored certificate will not parse err=%d\n", err);
		mbedtls_x509_crt_free(&cert);
		stored_cert_len = 0;
		return err;
	}

	const mbedtls_x509_name *name = &cert.subject;
	while (name != NULL) {
		if (name->oid.len == 3 && name->oid.p[0] == 0x55 &&
		    name->oid.p[1] == 0x04 && name->oid.p[2] == 0x03) {
			size_t len = name->val.len;
			if (len >= sizeof(device_id)) {
				len = sizeof(device_id) - 1;
			}
			memcpy(device_id, name->val.p, len);
			device_id[len] = '\0';
			break;
		}
		name = name->next;
	}

	uint8_t digest[32];
	size_t digest_len = 0;
	if (psa_hash_compute(PSA_ALG_SHA_256, stored_cert, stored_cert_len,
			     digest, sizeof(digest), &digest_len) == PSA_SUCCESS) {
		for (size_t i = 0; i < digest_len; i++) {
			snprintf(&fingerprint[i * 2], 3, "%02x", digest[i]);
		}
	}

	mbedtls_x509_crt_free(&cert);
	return 0;
}

int course_identity_init(void)
{
	int err = settings_subsys_init();
	if (err != 0) {
		printk("identity.init settings would not start err=%d\n", err);
		return err;
	}
	err = settings_register(&cert_handler);
	if (err != 0 && err != -EEXIST) {
		printk("identity.init settings handler refused err=%d\n", err);
		return err;
	}
	err = settings_load();
	if (err != 0) {
		printk("identity.init settings would not load err=%d\n", err);
		return err;
	}
	(void)describe_certificate();

	if (stored_cert_len == 0) {
		printk("identity.state unprovisioned, no Factory certificate held\n");
	} else {
		printk("identity.state provisioned device_id=%s\n", device_id);
		printk("identity.state certificate fingerprint=sha256:%s\n", fingerprint);
	}
	return 0;
}

bool course_identity_is_provisioned(void)
{
	return stored_cert_len > 0 && device_id[0] != '\0';
}

const char *course_identity_device_id(void)
{
	if (!course_identity_is_provisioned()) {
		return NULL;
	}
	return device_id;
}

const char *course_identity_fingerprint(void)
{
	return fingerprint;
}

/* PROTOTYPE, issue #157. Two accessors the spike needs and Tier 6 did not: the
 * certificate bytes to present, and the identifier of the key that signs for
 * them. Neither hands out private key material, which is the whole point.
 */
int course_identity_certificate(const unsigned char **der, size_t *len)
{
	if (stored_cert_len == 0) {
		return -ENOENT;
	}
	*der = stored_cert;
	*len = stored_cert_len;
	return 0;
}

uint32_t course_identity_key_id(void)
{
	return (uint32_t)COURSE_FACTORY_KEY_ID;
}

static psa_status_t open_key(mbedtls_svc_key_id_t *out)
{
	psa_key_attributes_t attributes = PSA_KEY_ATTRIBUTES_INIT;
	psa_status_t status = psa_get_key_attributes(COURSE_FACTORY_KEY_ID, &attributes);
	psa_reset_key_attributes(&attributes);
	if (status == PSA_SUCCESS) {
		*out = COURSE_FACTORY_KEY_ID;
	}
	return status;
}

int course_identity_generate_key(void)
{
	mbedtls_svc_key_id_t existing;
	if (open_key(&existing) == PSA_SUCCESS) {
		printk("identity.key already present id=0x%08x, keeping it\n",
		       (unsigned int)COURSE_FACTORY_KEY_ID);
		return 0;
	}

	psa_key_attributes_t attributes = PSA_KEY_ATTRIBUTES_INIT;
	psa_set_key_id(&attributes, COURSE_FACTORY_KEY_ID);
	psa_set_key_lifetime(&attributes, PSA_KEY_LIFETIME_PERSISTENT);
	psa_set_key_type(&attributes, PSA_KEY_TYPE_ECC_KEY_PAIR(PSA_ECC_FAMILY_SECP_R1));
	psa_set_key_bits(&attributes, 256);
	/*
	 * Signing only, and deliberately no PSA_KEY_USAGE_EXPORT.
	 *
	 * Section 8 asks for private keys to be marked non-exportable at the
	 * course API boundary while saying plainly that the core storage cannot
	 * enforce that against compromised privileged firmware. Both halves are
	 * true and the tier shows both: this flag makes psa_export_key() refuse,
	 * and a flash dump reads the key anyway.
	 */
	psa_set_key_usage_flags(&attributes, PSA_KEY_USAGE_SIGN_HASH | PSA_KEY_USAGE_SIGN_MESSAGE);
	psa_set_key_algorithm(&attributes, PSA_ALG_ECDSA(PSA_ALG_SHA_256));

	mbedtls_svc_key_id_t key_id;
	psa_status_t status = psa_generate_key(&attributes, &key_id);
	psa_reset_key_attributes(&attributes);
	if (status != PSA_SUCCESS) {
		printk("identity.key generation failed status=%d\n", (int)status);
		return (int)status;
	}
	printk("identity.key generated P-256 on this device id=0x%08x\n",
	       (unsigned int)COURSE_FACTORY_KEY_ID);
	printk("identity.key the private half has not left and cannot be exported\n");
	printk("identity.key stored through PSA Secure Storage, see the boot warning above\n");
	return 0;
}

int course_identity_try_export(void)
{
	uint8_t buffer[128];
	size_t length = 0;
	psa_status_t status = psa_export_key(COURSE_FACTORY_KEY_ID, buffer,
					     sizeof(buffer), &length);
	printk("identity.export asked PSA for the private key\n");
	if (status == PSA_SUCCESS) {
		printk("identity.export SUCCEEDED, %zu bytes. This is a defect.\n", length);
		memset(buffer, 0, sizeof(buffer));
		return -EPERM;
	}
	printk("identity.export refused status=%d (PSA_ERROR_NOT_PERMITTED is -133)\n",
	       (int)status);
	printk("identity.export the key has no PSA_KEY_USAGE_EXPORT flag, so the API will not\n");
	printk("identity.export hand it over. Read this beside E-6-05, which reads the same\n");
	printk("identity.export key out of a flash dump and succeeds.\n");
	return 0;
}

int course_identity_build_csr(const char *credential, unsigned char *out,
			      size_t out_size, size_t *out_len)
{
	if (credential == NULL || out == NULL || out_len == NULL) {
		return -EINVAL;
	}
	size_t credential_len = strlen(credential);
	if (credential_len == 0 || credential_len > 127) {
		printk("identity.csr credential length %zu is out of range\n", credential_len);
		return -EINVAL;
	}

	mbedtls_svc_key_id_t key_id;
	if (open_key(&key_id) != PSA_SUCCESS) {
		printk("identity.csr no device key yet\n");
		return -ENOENT;
	}

	/*
	 * The extension value is a DER PrintableString holding the credential.
	 *
	 * Two bytes of header then the text. It must match what the station's
	 * Go decoder expects, which marshals a Go string as a PrintableString,
	 * so the tag is 0x13 and the length is a single byte for anything under
	 * 128 characters.
	 */
	unsigned char value[2 + 128];
	value[0] = 0x13;
	value[1] = (unsigned char)credential_len;
	memcpy(&value[2], credential, credential_len);

	mbedtls_pk_context pk;
	mbedtls_pk_init(&pk);
	int err = mbedtls_pk_wrap_psa(&pk, key_id);
	if (err != 0) {
		printk("identity.csr cannot wrap the PSA key err=%d\n", err);
		return err;
	}

	mbedtls_x509write_csr csr;
	mbedtls_x509write_csr_init(&csr);
	mbedtls_x509write_csr_set_md_alg(&csr, MBEDTLS_MD_SHA256);
	mbedtls_x509write_csr_set_key(&csr, &pk);

	char subject[COURSE_DEVICE_ID_MAX + 4];
	snprintf(subject, sizeof(subject), "CN=%s", CONFIG_COURSE_DEVICE_ID);
	err = mbedtls_x509write_csr_set_subject_name(&csr, subject);
	if (err == 0) {
		err = mbedtls_x509write_csr_set_extension(&csr, credential_oid,
							  sizeof(credential_oid), 0,
							  value, 2 + credential_len);
	}
	if (err != 0) {
		printk("identity.csr cannot build the request err=%d\n", err);
		goto done;
	}

	/*
	 * DER, written from the end of the buffer backwards, which is how
	 * mbedTLS writes every DER structure. The returned length is the number
	 * of bytes actually used and they sit at the end of the buffer, so the
	 * request is moved to the front before it is handed back.
	 */
	err = mbedtls_x509write_csr_der(&csr, out, out_size);
	if (err < 0) {
		printk("identity.csr cannot encode the request err=%d\n", err);
		goto done;
	}
	*out_len = (size_t)err;
	memmove(out, out + out_size - *out_len, *out_len);
	err = 0;
	printk("identity.csr built a %zu byte request, signed by the device key\n", *out_len);
	printk("identity.csr the Bootstrap credential is inside the signature, not beside it\n");

done:
	mbedtls_x509write_csr_free(&csr);
	mbedtls_pk_free(&pk);
	memset(value, 0, sizeof(value));
	return err;
}

int course_identity_store_certificate(const unsigned char *der, size_t len)
{
	if (der == NULL || len == 0 || len > sizeof(stored_cert)) {
		printk("identity.store certificate length %zu is out of range\n", len);
		return -EINVAL;
	}
	mbedtls_x509_crt cert;
	mbedtls_x509_crt_init(&cert);
	int err = mbedtls_x509_crt_parse_der(&cert, der, len);
	mbedtls_x509_crt_free(&cert);
	if (err != 0) {
		printk("identity.store refusing a certificate that will not parse err=%d\n", err);
		return err;
	}

	err = settings_save_one(COURSE_CERT_SETTINGS_KEY, der, len);
	if (err != 0) {
		printk("identity.store settings write failed err=%d\n", err);
		return err;
	}
	memcpy(stored_cert, der, len);
	stored_cert_len = len;
	(void)describe_certificate();
	printk("identity.store certificate held, device_id=%s\n", device_id);
	printk("identity.store fingerprint=sha256:%s\n", fingerprint);
	return 0;
}

int course_identity_erase(void)
{
	/*
	 * Two places, because the key and the certificate are kept differently
	 * and on purpose. Erasing one and not the other leaves a certificate
	 * describing a key that no longer exists, which looks provisioned and
	 * cannot sign anything.
	 */
	psa_status_t status = psa_destroy_key(COURSE_FACTORY_KEY_ID);
	if (status != PSA_SUCCESS && status != PSA_ERROR_INVALID_HANDLE) {
		printk("identity.erase could not destroy the key status=%d\n", (int)status);
		return (int)status;
	}
	int err = settings_delete(COURSE_CERT_SETTINGS_KEY);
	if (err != 0 && err != -ENOENT) {
		printk("identity.erase could not delete the certificate err=%d\n", err);
		return err;
	}
	stored_cert_len = 0;
	device_id[0] = '\0';
	fingerprint[0] = '\0';
	printk("identity.erase key destroyed and certificate deleted\n");
	printk("identity.erase this device is unprovisioned again, and its old record stands\n");
	return 0;
}

#else /* CONFIG_COURSE_IDENTITY_SHARED */

/*
 * The shared identity.
 *
 * One ECDSA P-256 key pair and one certificate, compiled into every image
 * built this way, beside the Wi-Fi credentials and the trust anchor. There is
 * no key generation and no Bootstrap credential: possession of the compiled-in
 * key is simultaneously the identity and the authorization to enroll, which is
 * what section 11 means by a reusable default credential remaining active.
 *
 * Nothing about this credential is cryptographically weaker than the per-device
 * ones that replace it. It is a real Factory certificate signed by the real
 * manufacturer device CA. What is wrong with it is that there is one of it.
 */

#include <psa/crypto.h>
#include <mbedtls/x509_crt.h>
#include <mbedtls/psa_util.h>

/* The fleet private key, as the SEC1 ECPrivateKey structure.
 *
 * ./course build firmware --tier 06 --variant shared writes this from the
 * identity generated for your Course environment. Without it the build falls
 * back to anchor/, which is empty, and the image can prove possession of
 * nothing and says so.
 *
 * It is kept as the whole structure rather than as a bare scalar because that
 * is what a real image would carry, and because the structure is what makes it
 * findable: ./course provision extract searches for the seven byte prefix
 * below and explains it. Thirty-two anonymous bytes could only be found by
 * already knowing where they were, which would teach the wrong lesson.
 */
static const unsigned char shared_identity_key[] = {
#include "shared_identity_key.inc"
	0x00
};

#define SHARED_IDENTITY_KEY_LEN (sizeof(shared_identity_key) - 1)

static const unsigned char shared_identity_cert[] = {
#include "shared_identity_cert.inc"
	0x00
};

#define SHARED_IDENTITY_CERT_LEN (sizeof(shared_identity_cert) - 1)

/*
 * Where the scalar sits inside the SEC1 structure.
 *
 * SEQUENCE, INTEGER 1, then an OCTET STRING of exactly 32 bytes. For a P-256
 * key with a one byte outer length that puts the scalar at offset 7. The
 * offsets are checked rather than trusted, because a silently wrong 32 bytes
 * would be a key that signs and never verifies.
 */
#define SEC1_SCALAR_OFFSET 7
#define SEC1_SCALAR_LEN 32

static char device_id[COURSE_DEVICE_ID_MAX];
static char fingerprint[2 * 32 + 1];

static bool shared_key_present(void)
{
	return SHARED_IDENTITY_KEY_LEN > SEC1_SCALAR_OFFSET + SEC1_SCALAR_LEN &&
	       shared_identity_key[0] == 0x30 &&
	       shared_identity_key[2] == 0x02 &&
	       shared_identity_key[3] == 0x01 &&
	       shared_identity_key[4] == 0x01 &&
	       shared_identity_key[5] == 0x04 &&
	       shared_identity_key[6] == SEC1_SCALAR_LEN;
}

int course_identity_init(void)
{
	device_id[0] = '\0';
	fingerprint[0] = '\0';

	printk("identity.state shared, every image built this way is this device\n");

	if (!shared_key_present() || SHARED_IDENTITY_CERT_LEN == 0) {
		printk("identity.state no fleet credential is compiled into this image\n");
		printk("identity.state build it with ./course build firmware --tier 06 --variant shared\n");
		printk("identity.state after ./course keys create shared-identity\n");
		return 0;
	}

	mbedtls_x509_crt cert;

	mbedtls_x509_crt_init(&cert);
	if (mbedtls_x509_crt_parse_der(&cert, shared_identity_cert,
				       SHARED_IDENTITY_CERT_LEN) == 0) {
		const mbedtls_x509_name *name = &cert.subject;

		while (name != NULL) {
			if (name->oid.len == 3 && name->oid.p[0] == 0x55 &&
			    name->oid.p[1] == 0x04 && name->oid.p[2] == 0x03) {
				size_t len = name->val.len;

				if (len >= sizeof(device_id)) {
					len = sizeof(device_id) - 1;
				}
				memcpy(device_id, name->val.p, len);
				device_id[len] = '\0';
				break;
			}
			name = name->next;
		}
	}
	mbedtls_x509_crt_free(&cert);

	uint8_t digest[32];
	size_t digest_len = 0;

	if (psa_hash_compute(PSA_ALG_SHA_256, shared_identity_cert, SHARED_IDENTITY_CERT_LEN,
			     digest, sizeof(digest), &digest_len) == PSA_SUCCESS) {
		for (size_t i = 0; i < digest_len; i++) {
			snprintf(&fingerprint[i * 2], 3, "%02x", digest[i]);
		}
	}

	printk("identity.state fleet identifier %s\n", device_id);
	printk("identity.state certificate fingerprint=sha256:%s\n", fingerprint);
	printk("identity.state the private half of this identity is in this image, and in\n");
	printk("identity.state every other image built the same way\n");
	return 0;
}

bool course_identity_is_provisioned(void)
{
	return device_id[0] != '\0';
}

const char *course_identity_device_id(void)
{
	if (!course_identity_is_provisioned()) {
		return NULL;
	}
	return device_id;
}

const char *course_identity_fingerprint(void)
{
	return fingerprint;
}

int course_shared_certificate(const unsigned char **der, size_t *len)
{
	if (SHARED_IDENTITY_CERT_LEN == 0) {
		return -ENOENT;
	}
	*der = shared_identity_cert;
	*len = SHARED_IDENTITY_CERT_LEN;
	return 0;
}

int course_shared_sign_nonce(const unsigned char *nonce, size_t nonce_len,
			     unsigned char *out, size_t out_size, size_t *out_len)
{
	if (nonce == NULL || out == NULL || out_len == NULL) {
		return -EINVAL;
	}
	if (!shared_key_present()) {
		printk("identity.sign no fleet key is compiled into this image\n");
		return -ENOENT;
	}

	/* Volatile, because the key already lives in the image. Importing it
	 * into Secure Storage would put a copy of a credential every device
	 * shares into the one place this tier is arguing should hold something
	 * unique.
	 */
	psa_key_attributes_t attributes = PSA_KEY_ATTRIBUTES_INIT;

	psa_set_key_type(&attributes, PSA_KEY_TYPE_ECC_KEY_PAIR(PSA_ECC_FAMILY_SECP_R1));
	psa_set_key_bits(&attributes, 256);
	psa_set_key_usage_flags(&attributes, PSA_KEY_USAGE_SIGN_HASH);
	psa_set_key_algorithm(&attributes, PSA_ALG_ECDSA(PSA_ALG_SHA_256));

	mbedtls_svc_key_id_t key_id;
	psa_status_t status = psa_import_key(&attributes,
					     &shared_identity_key[SEC1_SCALAR_OFFSET],
					     SEC1_SCALAR_LEN, &key_id);

	psa_reset_key_attributes(&attributes);
	if (status != PSA_SUCCESS) {
		printk("identity.sign cannot import the fleet key status=%d\n", (int)status);
		return (int)status;
	}

	uint8_t digest[32];
	size_t digest_len = 0;
	int err = 0;

	status = psa_hash_compute(PSA_ALG_SHA_256, nonce, nonce_len, digest,
				  sizeof(digest), &digest_len);
	if (status != PSA_SUCCESS) {
		err = (int)status;
		goto done;
	}

	/* PSA returns the raw r||s pair. The station verifies an ASN.1
	 * sequence, which is what every X.509 tool produces, so the conversion
	 * happens here rather than the station being taught a second format.
	 */
	uint8_t raw[64];
	size_t raw_len = 0;

	status = psa_sign_hash(key_id, PSA_ALG_ECDSA(PSA_ALG_SHA_256), digest, digest_len,
			       raw, sizeof(raw), &raw_len);
	if (status != PSA_SUCCESS) {
		printk("identity.sign cannot sign the nonce status=%d\n", (int)status);
		err = (int)status;
		goto done;
	}

	err = mbedtls_ecdsa_raw_to_der(256, raw, raw_len, out, out_size, out_len);
	if (err != 0) {
		printk("identity.sign cannot encode the signature err=%d\n", err);
	}

done:
	psa_destroy_key(key_id);
	return err;
}

#endif /* CONFIG_COURSE_IDENTITY_FACTORY */
```

## src/identity.h
```c
/*
 * Tier 6 device identity.
 *
 * Two identity models live behind this interface, selected by the Kconfig
 * choice in Kconfig. The shared model carries one key compiled into every
 * image; the factory model generates a key on the device and never lets the
 * private half leave. Everything above this header asks the same questions of
 * both, which is what makes the two builds comparable.
 */

#ifndef COURSE_IDENTITY_H
#define COURSE_IDENTITY_H

#include <stddef.h>
#include <stdbool.h>
#include <stdint.h>

/* The longest device identifier the course issues, plus a terminator. */
#define COURSE_DEVICE_ID_MAX 64

/*
 * Bring up the identity subsystem.
 *
 * For the factory build this mounts settings, which is also what the PSA
 * Secure Storage ITS store writes through, and loads any certificate already
 * held. It reports success even when the device is unprovisioned: having no
 * identity is a state, not a failure.
 */
int course_identity_init(void);

/* Whether this device holds a usable identity. */
bool course_identity_is_provisioned(void);

/*
 * The identifier this device reports.
 *
 * For the factory build it is read out of the subject of the stored Factory
 * certificate, so the certificate is the one source of truth and the device
 * cannot report a name it cannot prove. For the shared build it is the
 * compiled-in name that every image shares.
 *
 * Returns NULL when the device is unprovisioned. A caller that treats NULL as
 * "use the old shared name" has reintroduced the fallback section 11 forbids,
 * so every caller is expected to handle it as a refusal to speak.
 */
const char *course_identity_device_id(void);

/* Fingerprint of the identity's certificate, for the boot banner. */
const char *course_identity_fingerprint(void);

#ifdef CONFIG_COURSE_IDENTITY_FACTORY

/*
 * Generate the device key, if there is not one already.
 *
 * The key is marked non-exportable at the PSA boundary. That marking is real
 * and it is not a boundary against a flash attacker: see
 * course_identity_try_export(), which exists so a Learner can watch both
 * halves of that sentence being true at once.
 */
int course_identity_generate_key(void);

/*
 * Build a certification request for the device key, carrying the Bootstrap
 * credential inside the signed structure.
 *
 * The credential goes inside rather than beside it so that it is covered by
 * the request's own self-signature and cannot be lifted onto another key.
 */
int course_identity_build_csr(const char *credential, unsigned char *out,
			      size_t out_size, size_t *out_len);

/* Store a Factory certificate issued by the provisioning station. */
int course_identity_store_certificate(const unsigned char *der, size_t len);

/*
 * Ask the course API to hand over the device private key.
 *
 * This always fails, and it is here to be run rather than to be useful. It is
 * evidence row E-6-04, and it is read beside E-6-05, which reads the same key
 * out of a flash dump and succeeds.
 */
int course_identity_try_export(void);

/*
 * PROTOTYPE, issue #157. The stored Factory certificate, for the spike to
 * present as a TLS client certificate. Borrowed, not copied: the buffer is
 * static and outlives the connection, which matters because mbedTLS parses it
 * without copying.
 */
int course_identity_certificate(const unsigned char **der, size_t *len);

/*
 * PROTOTYPE, issue #157. The PSA identifier of the Factory key.
 *
 * A uint32_t rather than psa_key_id_t so this header stays free of psa/crypto.h,
 * the way it was before the spike.
 */
uint32_t course_identity_key_id(void);

/*
 * Erase the identity, for remanufacturing.
 *
 * Two places, because the key lives in Secure Storage and the certificate does
 * not. Erasing one and not the other leaves a certificate for a key that no
 * longer exists, which is why this is one call rather than two.
 */
int course_identity_erase(void);

#endif /* CONFIG_COURSE_IDENTITY_FACTORY */

#ifdef CONFIG_COURSE_IDENTITY_SHARED

/*
 * The fleet certificate this image carries, for the station to check the nonce
 * signature against.
 *
 * Every image built in this variant returns the same bytes, which is the whole
 * argument of the tier.
 */
int course_shared_certificate(const unsigned char **der, size_t *len);

/*
 * Sign a station nonce with the compiled-in fleet key.
 *
 * This is a real proof of possession and it is not weaker than the one the
 * factory build performs. It is the same question, asked of a key every device
 * in the fleet already knows the answer to.
 *
 * The signature comes back as the ASN.1 sequence the station's verifier
 * expects, not as the raw r||s pair PSA produces.
 */
int course_shared_sign_nonce(const unsigned char *nonce, size_t nonce_len,
			     unsigned char *out, size_t out_size, size_t *out_len);

#endif /* CONFIG_COURSE_IDENTITY_SHARED */

/*
 * Decide whether the provisioning interface runs at all, and start it if so.
 *
 * Open when the device holds no identity, or when the BOOT button is held at
 * reset. Closed otherwise, and closed again the moment enrollment succeeds.
 */
void course_identity_gate(void);

#endif /* COURSE_IDENTITY_H */
```

## src/opaque_tls.h
```c
/*
 * PROTOTYPE. Throwaway spike code for issue #157. Not production firmware.
 */

#ifndef COURSE_OPAQUE_TLS_H
#define COURSE_OPAQUE_TLS_H

#include <stdbool.h>
#include <stdint.h>

/*
 * The protocol number this socket implementation answers on.
 *
 * Outside the 256 to 259 and 272 to 273 ranges Zephyr's own protocol_check()
 * claims, so zsock_socket() reaches this implementation and not that one.
 */
#define IPPROTO_COURSE_OPAQUE_TLS 260

struct course_opaque_tls_result {
	bool completed;
	int mbedtls_error;
	uint32_t verify_flags;
	char ciphersuite[64];
	char version[16];
};

/* The name to require of the service, set before connect(). */
void course_opaque_tls_set_hostname(const char *name);

/* What the last handshake attempt did. */
const struct course_opaque_tls_result *course_opaque_tls_last_result(void);

/*
 * Issue #158. Which branch of the poll implementation fired, and how often.
 *
 * The two cases that matter are the two a naive forwarding poll gets wrong:
 * update_buffered counts the polls answered from bytes mbedTLS had already
 * decrypted, which the TCP descriptor can no longer signal and which hang a
 * forwarding-only poll forever, and update_partial_record counts the polls
 * where the TCP descriptor was readable but no record completed, which a
 * forwarding-only poll reports as readable and sends the caller into a
 * blocking read.
 */
struct course_opaque_tls_poll_stats {
	unsigned int prepare_forwarded;
	unsigned int prepare_already;
	unsigned int update_decrypted;
	unsigned int update_buffered;
	unsigned int update_partial_record;
};

const struct course_opaque_tls_poll_stats *course_opaque_tls_poll_stats(void);
void course_opaque_tls_reset_poll_stats(void);

/* Run the spike: one mutually authenticated connection, then report. */
void course_opaque_tls_spike(void);

#endif /* COURSE_OPAQUE_TLS_H */
```
