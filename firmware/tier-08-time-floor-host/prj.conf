## CMakeLists.txt
```
# SPDX-License-Identifier: Apache-2.0
#
# A host build of Tier 8's Time floor (#262), for native_sim.
#
# It compiles the Tier 8 firmware's own time_floor.c, release_policy.c and
# recovery_state.c, unchanged and from their own directory, so the host result
# is the firmware's code judging, not a copy of it. Only identity.c is
# replaced, by src/identity_host.c, because identity.c needs the ESP32-C6's
# Secure Storage and a claimed board. ./course service bypass e-8-11 builds and
# runs this; it is never flashed and it opens no socket.

cmake_minimum_required(VERSION 3.20.0)

find_package(Zephyr REQUIRED HINTS $ENV{ZEPHYR_BASE})
project(tier_08_time_floor_host)

set(TIER08_SRC ${CMAKE_CURRENT_SOURCE_DIR}/../tier-08-credential-lifecycle/src)

# The inputs are generated per run by ./course service bypass e-8-11: a
# throwaway release verification key, two manifests signed with its private
# half, and two synthetic Operational certificates. They arrive in the
# environment for the reason the Tier 8 build gives in its own CMakeLists.txt.
# Without them this build fails, rather than judging nothing.
if(NOT DEFINED ENV{COURSE_TIME_FLOOR_HOST_INPUTS})
	message(FATAL_ERROR "COURSE_TIME_FLOOR_HOST_INPUTS is not set; run ./course service bypass e-8-11, which generates the inputs")
endif()
zephyr_include_directories($ENV{COURSE_TIME_FLOOR_HOST_INPUTS})
zephyr_include_directories(${TIER08_SRC})

target_sources(app PRIVATE
	src/main.c
	src/identity_host.c
	${TIER08_SRC}/recovery_state.c
	${TIER08_SRC}/release_policy.c
	${TIER08_SRC}/time_floor.c
)
```

## Kconfig
```
# The Tier 8 firmware's own options, with their own defaults, so the floor's
# seed and the release policy's counter and channel mean here what they mean
# on the board. That file ends by sourcing Kconfig.zephyr.
rsource "../tier-08-credential-lifecycle/Kconfig"
```

## prj.conf
```kconfig
# The host build of Tier 8's Time floor, for native_sim/native/64.
#
# What the three firmware files need, and nothing that reaches a network.
# The mbedTLS and PSA choices follow the Tier 8 prj.conf, including
# CONFIG_MBEDTLS_HAVE_TIME_DATE=n: the floor's comparison,
# mbedtls_x509_time_cmp(), does not depend on it, and a host build that turned
# it on would be judging with a clock the board does not have.
CONFIG_PRINTK=y
CONFIG_MAIN_STACK_SIZE=16384
CONFIG_JSON_LIBRARY=y

CONFIG_MBEDTLS=y
CONFIG_MBEDTLS_HAVE_TIME_DATE=n
CONFIG_MBEDTLS_X509_CRT_PARSE_C=y
CONFIG_MBEDTLS_X509_USE_C=y
CONFIG_MBEDTLS_ENABLE_HEAP=y
CONFIG_MBEDTLS_HEAP_SIZE=32768
CONFIG_PSA_CRYPTO=y
CONFIG_PSA_WANT_ALG_ECDSA=y
CONFIG_PSA_WANT_ECC_SECP_R1_256=y
CONFIG_PSA_WANT_ALG_SHA_256=y
CONFIG_PSA_WANT_KEY_TYPE_ECC_PUBLIC_KEY=y

# Records 4 and 5 live in the settings NVS instance, as they do on the board.
# native_sim's flash simulator holds the storage partition.
CONFIG_FLASH=y
CONFIG_FLASH_MAP=y
CONFIG_FLASH_PAGE_LAYOUT=y
CONFIG_NVS=y
CONFIG_SETTINGS=y
CONFIG_SETTINGS_NVS=y
```

## src/main.c
```c
/*
 * E-8-11, a host build of Tier 8's Time floor (#262).
 *
 * Whoever holds the release signing key can end every Operational credential
 * by dating a manifest in the future (#217). This program shows it with the
 * firmware's own code: time_floor.c, release_policy.c and recovery_state.c are
 * compiled unchanged from firmware/tier-08-credential-lifecycle/src. The
 * manifest path below is the three calls ota_client_fetch_manifest() makes
 * after the download, in its order: verify the signature over the exact bytes,
 * parse them, raise the Time floor, then admit or refuse by policy.
 *
 * It must never run on a board, and it cannot: it is built for native_sim,
 * it opens no socket, and the only key it verifies against is a throwaway one
 * that ./course service bypass e-8-11 generated for this run and never wrote
 * down. A board would keep the floor ahead for good, and refuse every
 * certificate issued before that date, which is what the second boot shows.
 *
 * The runner starts this program twice on one simulated flash file, with
 * -testargs naming the boot. What survives between the two is record 4 in NVS,
 * exactly what survives a reset on the board.
 */

#include <errno.h>
#include <string.h>
#include <zephyr/kernel.h>

#include <cmdline.h>
#include <nsi_main.h>

#include "identity_host.h"
#include "recovery_state.h"
#include "release_policy.h"
#include "time_floor.h"

/* Generated per run. See the runner in internal/courseapp/tier08_time_floor.go. */
static const uint8_t operational_cert[] = {
#include "operational_cert.inc"
};
static const uint8_t recovered_cert[] = {
#include "recovered_cert.inc"
};
static const char far_manifest[] = {
#include "far_manifest.inc"
	0x00
};
static const uint8_t far_manifest_sig[] = {
#include "far_manifest_sig.inc"
};
/* The same far-future bytes, signed by a key this build does not trust. */
static const uint8_t untrusted_manifest_sig[] = {
#include "untrusted_manifest_sig.inc"
};
static const char ordinary_manifest[] = {
#include "ordinary_manifest.inc"
	0x00
};
static const uint8_t ordinary_manifest_sig[] = {
#include "ordinary_manifest_sig.inc"
};

/* The parser rewrites the buffer it reads, as it does on the board. */
static char manifest_buf[1024];

/* Which boot this is, from -testargs. */
enum boot {
	BOOT_UNKNOWN,
	BOOT_FIRST,
	BOOT_AFTER_RECOVERY,
};

static enum boot which_boot(void)
{
	int argc = 0;
	char **argv = NULL;

	native_get_test_cmd_line_args(&argc, &argv);
	if (argc == 1 && strcmp(argv[0], "first") == 0) {
		return BOOT_FIRST;
	}
	if (argc == 1 && strcmp(argv[0], "after-recovery") == 0) {
		return BOOT_AFTER_RECOVERY;
	}
	return BOOT_UNKNOWN;
}

/* What the TLS layer would be handed for the Operational identity. */
static int report_presentation(void)
{
	const unsigned char *der = NULL;
	size_t len = 0;
	int err = host_identity_present(&der, &len);

	if (err == 0) {
		printk("host.present operational certificate presented, %zu bytes\n", len);
	} else if (err == -EKEYEXPIRED) {
		printk("host.present operational certificate refused err=-EKEYEXPIRED\n");
	} else {
		printk("host.present no operational certificate err=%d\n", err);
	}
	return err;
}

/*
 * ota_client_fetch_manifest() after its two downloads, line for line: the
 * signature over the exact bytes first, then the parse, then the floor, then
 * the policy.
 */
static int receive_manifest(const char *body, const uint8_t *sig, size_t sig_len)
{
	struct release_manifest manifest;
	size_t len = strlen(body);
	int err;

	if (len >= sizeof(manifest_buf)) {
		printk("host.manifest the generated manifest is %zu bytes, too long\n", len);
		return -EMSGSIZE;
	}
	memcpy(manifest_buf, body, len);
	manifest_buf[len] = '\0';

	err = release_policy_verify((const uint8_t *)manifest_buf, len, sig, sig_len);
	if (err != 0) {
		return err;
	}
	err = release_policy_parse(manifest_buf, len, &manifest);
	if (err != 0) {
		return err;
	}
	printk("host.manifest release %s, created_at %s, signature verified\n",
	       manifest.release_id, manifest.created_at);
	time_floor_observe(manifest.created_at, manifest.release_id);
	err = release_policy_admit(&manifest, manifest.release_id);
	printk("host.manifest release policy answered %d; the floor saw this manifest first\n", err);
	return 0;
}

static int first_boot(void)
{
	printk("host.boot first: a synthetic Operational certificate issued today\n");
	if (host_identity_load(operational_cert, sizeof(operational_cert)) != 0) {
		return -EINVAL;
	}
	if (time_floor_init() != 0) {
		return -EINVAL;
	}
	if (report_presentation() != 0) {
		printk("host.result the certificate was refused before any manifest; nothing is shown\n");
		return -EALREADY;
	}

	printk("host.boot the far-future manifest, signed by a key this image does not trust\n");
	if (receive_manifest(far_manifest, untrusted_manifest_sig, sizeof(untrusted_manifest_sig)) == 0) {
		printk("host.result a manifest this image cannot verify was accepted\n");
		return -EPERM;
	}
	if (report_presentation() != 0) {
		printk("host.result an unverified manifest moved the floor\n");
		return -EPERM;
	}

	printk("host.boot the same manifest, signed with the release key\n");
	if (receive_manifest(far_manifest, far_manifest_sig, sizeof(far_manifest_sig)) != 0) {
		printk("host.result the far-future manifest did not verify; the floor never saw it\n");
		return -EACCES;
	}
	return report_presentation() == -EKEYEXPIRED ? 0 : -EPERM;
}

static int after_recovery(void)
{
	printk("host.boot after a reset: a fresh certificate, as a recovery would issue today\n");
	if (host_identity_load(recovered_cert, sizeof(recovered_cert)) != 0) {
		return -EINVAL;
	}
	if (time_floor_init() != 0) {
		return -EINVAL;
	}

	printk("host.boot an ordinary manifest, created now, signed with the same key\n");
	if (receive_manifest(ordinary_manifest, ordinary_manifest_sig,
			     sizeof(ordinary_manifest_sig)) != 0) {
		printk("host.result the ordinary manifest did not verify\n");
		return -EACCES;
	}
	return report_presentation() == -EKEYEXPIRED ? 0 : -EPERM;
}

int main(void)
{
	enum boot boot = which_boot();
	int err;

	if (boot == BOOT_UNKNOWN) {
		printk("host.result run with -testargs first, then -testargs after-recovery\n");
		nsi_exit(2);
	}
	err = recovery_state_init();
	if (err != 0) {
		printk("host.result the simulated storage partition would not mount err=%d\n", err);
		nsi_exit(1);
	}

	err = boot == BOOT_FIRST ? first_boot() : after_recovery();
	printk("host.result %s err=%d\n", err == 0 ? "refused" : "not-refused", err);
	nsi_exit(err == 0 ? 0 : 1);
	return 0;
}
```

## src/identity_host.c
```c
/*
 * The host's stand-in for identity.c, and the only Tier 8 file this build
 * replaces.
 *
 * identity.c keeps the Operational key in the ESP32-C6's Secure Storage and
 * its certificate in settings, and a host has neither. This file keeps one
 * certificate in RAM instead and answers the same questions time_floor.c asks,
 * with identity.c's own semantics: valid_to comes from mbedtls_x509_crt_parse_der()
 * over the stored DER, exactly as describe_slot() takes it; a refused
 * certificate is still held; and the credential accessor then answers
 * -EKEYEXPIRED, which is what stops ota_connect() presenting it on the board.
 *
 * It holds no candidate. The floor's candidate branch is not what this row is
 * about, and a stand-in that invented one would be testing itself.
 */

#include "identity.h"
#include "identity_host.h"

#include <errno.h>
#include <string.h>
#include <zephyr/kernel.h>

#include <mbedtls/x509_crt.h>

static const uint8_t *held_cert;
static size_t held_len;
static mbedtls_x509_time held_valid_to;
static bool operational_expired;

int host_identity_load(const uint8_t *der, size_t len)
{
	mbedtls_x509_crt cert;
	int err;

	held_cert = NULL;
	held_len = 0;
	operational_expired = false;

	mbedtls_x509_crt_init(&cert);
	err = mbedtls_x509_crt_parse_der(&cert, der, len);
	if (err != 0) {
		printk("identity.load the synthetic Operational certificate will not parse err=%d\n",
		       err);
		mbedtls_x509_crt_free(&cert);
		return err;
	}
	held_valid_to = cert.valid_to;
	mbedtls_x509_crt_free(&cert);
	held_cert = der;
	held_len = len;
	return 0;
}

int host_identity_present(const unsigned char **der, size_t *len)
{
	if (held_len == 0) {
		return -ENOENT;
	}
	if (operational_expired) {
		return -EKEYEXPIRED;
	}
	*der = held_cert;
	*len = held_len;
	return 0;
}

int course_identity_operational_valid_to(struct mbedtls_x509_time *out)
{
	if (held_len == 0) {
		return -ENOENT;
	}
	*out = held_valid_to;
	return 0;
}

int course_identity_candidate_valid_to(struct mbedtls_x509_time *out)
{
	ARG_UNUSED(out);
	return -ENOENT;
}

void course_identity_discard_candidate(void)
{
}

void course_identity_refuse_expired_operational(void)
{
	operational_expired = true;
}

bool course_identity_operational_expired(void)
{
	return operational_expired && held_len > 0;
}
```

## src/identity_host.h
```c
/* The host stand-in's two extra calls. See identity_host.c. */

#ifndef COURSE_IDENTITY_HOST_H
#define COURSE_IDENTITY_HOST_H

#include <stddef.h>
#include <stdint.h>

/* Hold this DER as the current Operational certificate, as a boot or a
 * recovery would, with no refusal yet.
 */
int host_identity_load(const uint8_t *der, size_t len);

/* What identity.c's credential accessor answers: the certificate, -ENOENT with
 * none, or -EKEYEXPIRED once the Time floor has refused it.
 */
int host_identity_present(const unsigned char **der, size_t *len);

#endif /* COURSE_IDENTITY_HOST_H */
```
