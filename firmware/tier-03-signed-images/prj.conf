## CMakeLists.txt
```
# SPDX-License-Identifier: Apache-2.0

cmake_minimum_required(VERSION 3.20.0)

list(APPEND EXTRA_ZEPHYR_MODULES ${CMAKE_CURRENT_SOURCE_DIR}/../common)

find_package(Zephyr REQUIRED HINTS $ENV{ZEPHYR_BASE})
project(tier_03_signed_images)

test_sysbuild()

# The trust anchor is compiled into the image, the same way the Wi-Fi
# credentials are. ./course build firmware writes course_ca_der.inc from the
# Course certificate authority in .course-secrets/, and passes the directory
# here.
#
# Without it the build falls back to anchor/, which holds an empty anchor. The
# repository then still builds standalone, and the resulting image refuses to
# connect and says why. An image that trusts nothing is the right failure: the
# alternative is an image that trusts anything.
# The directory arrives in the environment rather than as a CMake cache
# variable. Sysbuild keeps an image-scoped -D<image>_VAR in its own cache and
# does not forward an arbitrary one into the image build, so a cache variable
# silently produced an image with no anchor. The environment reaches every
# image's configure step.
if(DEFINED ENV{COURSE_CA_INC_DIR})
	zephyr_include_directories($ENV{COURSE_CA_INC_DIR})
else()
	zephyr_include_directories(anchor)
endif()

target_sources(app PRIVATE
	src/main.c
	src/ota_client.c
)
```

## Kconfig
```
# Configuration Tier 2 adds on top of the shared options in firmware/common.

menu "Tier 2 authenticated service"

config COURSE_OTA_SERVICE_NAME
	string "Name the service certificate must carry"
	default "ota.course.example"
	help
	  The device connects to CONFIG_COURSE_OTA_HOST, a literal address, and
	  then requires the certificate presented there to carry this name.

	  The name is never resolved. There is no DNS resolver in this image.
	  It is the value the TLS layer compares the certificate against, which
	  is why a wrong name is refused even though the address was right.

config COURSE_OTA_TLS_PORT
	int "OTA service TLS port"
	default 8443
	help
	  Tier 2 moves release records, firmware bytes, and status events to
	  this port. Health and the Course environment marker stay on the plain
	  HTTP port, because a safety check must not depend on the control it
	  is used to test.

config COURSE_TRUST_ANCHOR_FINGERPRINT
	string "Fingerprint of the trust anchor compiled into this image"
	default "unknown"
	help
	  Printed at boot so a stale trust anchor diagnoses itself instead of
	  looking like a broken network. ./course build firmware writes this
	  value, and ./course service certificate prints the same one.

	  The device does not compute it. Computing a digest on the board to
	  describe material the board already holds would prove nothing that the
	  build cannot state.

endmenu

source "Kconfig.zephyr"

config COURSE_SIGNING_KEY_FINGERPRINT
	string "Fingerprint of the image verification key this image was built beside"
	default "unknown"
	help
	  Printed at boot so a Learner can see which key the build trusted, and
	  so a key regenerated after flashing diagnoses itself instead of looking
	  like a broken image.

	  Read the wording in main.c before changing this. The application cannot
	  see what the bootloader actually holds. This value comes from the same
	  build that produced the bootloader, so it is a claim about the build and
	  not an observation of the device. Verifying the bootloader itself is
	  Advanced Tier A's subject.
```

## sysbuild.conf
```
SB_CONFIG_BOOTLOADER_MCUBOOT=y

# Sysbuild is told there is no signing, and that is deliberate.
#
# Sysbuild has one setting for a signing key, and it feeds two different jobs.
# The bootloader runs "imgtool getpub" on it, which needs only the public half.
# The application build runs "imgtool sign" on it, which needs the private
# half. One value cannot be both, and pointing it at the private key would name
# the Release signing key in a firmware build command, which
# docs/fixture-safety-contract.md forbids in as many words.
#
# So the two jobs are split, and so are the builds. This setting keeps the
# application image unsigned, exactly as Tier 0 and Tier 2 build it today, and
# the bootloader sysbuild produces here is discarded. The bootloader that ships
# is built separately from bootloader/mcuboot.conf, which names only the public
# half, so no firmware build command ever names the Release signing key.
#
# The two bootloaders were compared: the separately built one resolves to a
# byte-identical Kconfig and the same 47,872 byte binary, so nothing is lost by
# building it outside sysbuild.
#
# Signing is a step the Learner runs afterwards, with the private key, on an
# image the build has already finished with.
SB_CONFIG_BOOT_SIGNATURE_TYPE_NONE=y

# The course uses swap-using-offset in every tier. See Tier 0 and Tier 2 for
# the reasoning, which Tier 3 does not change.
SB_CONFIG_MCUBOOT_MODE_SWAP_USING_OFFSET=y
```

## prj.conf
```kconfig
CONFIG_PRINTK=y
CONFIG_ESPTOOLPY_FLASHSIZE_4MB=y
CONFIG_MAIN_STACK_SIZE=8192
CONFIG_REBOOT=y

# Wi-Fi station and IPv4. Tier 2 speaks HTTPS to one literal address and checks
# the certificate against a name, so it still needs no name resolution. The
# name is compared, never looked up, and there is no resolver in this image.
CONFIG_NETWORKING=y
CONFIG_WIFI=y
CONFIG_NET_IPV4=y
CONFIG_NET_IPV6=n
CONFIG_NET_DHCPV4=y
CONFIG_NET_TCP=y
CONFIG_NET_SOCKETS=y
CONFIG_NET_MGMT=y
CONFIG_NET_MGMT_EVENT=y
CONFIG_NET_MGMT_EVENT_INFO=y
CONFIG_NET_MGMT_EVENT_STACK_SIZE=4096
CONFIG_ESP32_WIFI_STA_AUTO_DHCPV4=y

CONFIG_NET_PKT_RX_COUNT=16
CONFIG_NET_PKT_TX_COUNT=16
CONFIG_NET_BUF_RX_COUNT=32
CONFIG_NET_BUF_TX_COUNT=32
CONFIG_NET_MAX_CONTEXTS=8

CONFIG_HTTP_CLIENT=y
CONFIG_JSON_LIBRARY=y

# TLS for the update and status connection.
#
# CONFIG_MBEDTLS is already on in Tier 0, because the Wi-Fi driver needs it.
# Tier 2 adds the socket layer, the credential store, and one ciphersuite.
CONFIG_NET_SOCKETS_SOCKOPT_TLS=y
CONFIG_TLS_CREDENTIALS=y
CONFIG_MBEDTLS_CIPHERSUITE_TLS_ECDHE_ECDSA_WITH_AES_128_GCM_SHA256=y
CONFIG_MBEDTLS_ENABLE_HEAP=y
CONFIG_MBEDTLS_HEAP_SIZE=49152
# A TLS record can be 16 KiB, and the peer decides how big it makes one.
#
# This was 2048 while Tier 3 was being built, because every response Tier 2
# had ever fetched over TLS was a small JSON record that fitted. Tier 3 is the
# first tier to download a firmware image over the verified connection, and the
# Go service sends that in full sized records. The client cannot hold one,
# mbedTLS treats it as fatal, and the socket layer returns -ECONNABORTED before
# a single byte reaches the flash writer.
#
# The symptom is misleading: "ota.request failed err=-113" after a handshake
# the same log line says succeeded. Nothing in the failure mentions buffers.
#
# Tier 2 now sets 16384 for the same reason. See issue #62.
CONFIG_MBEDTLS_SSL_MAX_CONTENT_LEN=16384
CONFIG_NET_SOCKETS_TLS_MAX_CONTEXTS=2

# The trust anchor is compiled in as DER, so the PEM parser is not needed.
CONFIG_MBEDTLS_PEM_PARSE_C=n

# Certificate validity dates are deliberately not checked.
#
# This board has no real-time clock. With CONFIG_MBEDTLS_HAVE_TIME_DATE=y and
# no time source the clock reads 1970, every certificate is "not yet valid",
# and every handshake fails forever. The option is orthogonal to chain and name
# checking, so leaving it off costs neither of those.
#
# The consequence is real and belongs in the Weakness ledger: this device would
# accept an expired certificate. Tier 8 is where credential lifetime becomes
# the subject.
CONFIG_MBEDTLS_HAVE_TIME_DATE=n

# Reading the verification flags after a refusal, so the device can say which
# check failed instead of only that something did.
CONFIG_MBEDTLS_X509_CRT_PARSE_C=y

# Writing the downloaded image into the secondary slot and asking MCUboot to
# swap it in. Tier 0 deliberately adds no authenticity check here.
CONFIG_FLASH=y
CONFIG_FLASH_MAP=y
CONFIG_STREAM_FLASH=y
CONFIG_IMG_MANAGER=y
CONFIG_IMG_ERASE_PROGRESSIVELY=y
CONFIG_MCUBOOT_IMG_MANAGER=y

# The course network may publish the same name on 2.4 GHz and 5 GHz. Scanning
# every channel makes the board pick the 2.4 GHz radio it can actually use.
CONFIG_ESP32_WIFI_STA_SCAN_ALL=y
CONFIG_ESP32_WIFI_STA_RECONNECT=y

# The onboard status beacon. The DevKitC-1 shows the machine state on its
# WS2812 RGB LED as well as on the console; CONFIG_COURSE_BEACON_LED in
# firmware/common turns that off again for a board that has no such LED.
CONFIG_LED_STRIP=y
```

## src/main.c
```c
#include <course/beacon.h>
#include <course/net_link.h>
#include "ota_client.h"

#include <string.h>
#include <zephyr/devicetree.h>
#include <zephyr/kernel.h>
#include <zephyr/net/net_ip.h>
#include <zephyr/sys/util.h>

#include <esp_rom_sys.h>

#define ASSERT_PARTITION(node, expected_offset, expected_size) \
	BUILD_ASSERT(DT_REG_ADDR(DT_NODELABEL(node)) == (expected_offset)); \
	BUILD_ASSERT(DT_REG_SIZE(DT_NODELABEL(node)) == (expected_size))

BUILD_ASSERT(DT_REG_SIZE(DT_NODELABEL(flash0)) == 0x400000);
ASSERT_PARTITION(boot_partition, 0x000000, 0x010000);
ASSERT_PARTITION(sys_partition, 0x010000, 0x010000);
ASSERT_PARTITION(slot0_partition, 0x020000, 0x1c0000);
ASSERT_PARTITION(slot1_partition, 0x1e0000, 0x1c0000);
ASSERT_PARTITION(slot0_lpcore_partition, 0x3a0000, 0x008000);
ASSERT_PARTITION(slot1_lpcore_partition, 0x3a8000, 0x008000);
ASSERT_PARTITION(storage_partition, 0x3b0000, 0x030000);
ASSERT_PARTITION(scratch_partition, 0x3e0000, 0x01f000);
ASSERT_PARTITION(coredump_partition, 0x3ff000, 0x001000);

static void announce(enum beacon_state state)
{
	printk("ESP32-C6 Reference product: Tier 3, signed firmware images\n");
	printk("Image label: %s\n", CONFIG_COURSE_IMAGE_LABEL);
	printk("Running release: %s\n", CONFIG_COURSE_RELEASE_ID);
	printk("Board: %s\n", CONFIG_BOARD_TARGET);
	printk("Tier 3 boot mode: signed MCUboot images, swap using offset, no test boot, no rollback\n");
	printk("Image verification key this build trusted: %s\n",
	       CONFIG_COURSE_SIGNING_KEY_FINGERPRINT);
	printk("That is the key the build used. This application cannot read what the bootloader holds.\n");
	printk("Tier 3 checks who published this image. It does not check the bytes it downloads.\n");
	printk("Synthetic shared device identifier: %s\n", CONFIG_COURSE_DEVICE_ID);
	printk("OTA service: https://%s:%d at address %s\n",
	       CONFIG_COURSE_OTA_SERVICE_NAME, CONFIG_COURSE_OTA_TLS_PORT,
	       CONFIG_COURSE_OTA_HOST);
	printk("Trust anchor: %s\n", ota_client_anchor_description());
	printk("Beacon state: %s, toggle period: %u ms\n",
	       beacon_state_name(state), beacon_toggle_period_ms(state));
	printk("Hardware note: %s\n", beacon_led_note());
}

/* Restart the whole chip, not only the processor.
 *
 * Zephyr's sys_reboot() ends in esp_restart(), which resets the processor but
 * deliberately leaves the BBPLL running so the ROM can keep logging. MCUboot
 * then tries to configure a PLL that is already on, and hangs inside its clock
 * setup before it reaches any of its own code. An update installed that way
 * never starts, and the board only recovers by a manual reset.
 *
 * The ROM's system reset returns the clocks to their power-on state, so
 * MCUboot starts exactly as it does after a power cycle.
 */
static void course_reset_system(void)
{
	esp_rom_software_reset_system();

	/* The reset is immediate. This loop only satisfies the compiler. */
	while (true) {
		k_sleep(K_FOREVER);
	}
}

/* One poll: report status, read the assignment, and install it when it names
 * a different release. Returns true when the device should reboot into a
 * freshly installed image.
 */
static bool poll_once(enum beacon_state state)
{
	struct ota_release release;
	const char *state_name = beacon_state_name(state);

	/* A rejected status report must not stop the update check: the two
	 * exchanges are independent, and Tier 0 gates neither on the other.
	 */
	(void)ota_client_report("status.observed", state_name, CONFIG_COURSE_RELEASE_ID,
				"verified service, shared identifier");

	if (ota_client_fetch_assignment(&release) != 0) {
		return false;
	}

	printk("ota.assignment release_id=%s version=%s image=%s\n",
	       release.release_id, release.version, release.image_path);

	if (!ota_release_differs(&release)) {
		printk("ota.assignment matches the running release, nothing to install\n");
		return false;
	}

	printk("ota.assignment differs from running release %s, installing without any check\n",
	       CONFIG_COURSE_RELEASE_ID);

	if (ota_client_install(&release) != 0) {
		(void)ota_client_report("update.failed", state_name,
					CONFIG_COURSE_RELEASE_ID, release.release_id);
		return false;
	}

	(void)ota_client_report("update.installed", state_name, CONFIG_COURSE_RELEASE_ID,
				release.release_id);
	return true;
}

int main(void)
{
	enum beacon_state state = beacon_configured_state();
	char address[NET_IPV4_ADDR_LEN];

	/* Before the banner, so the banner's hardware note can report whether
	 * the LED really started rather than whether it was asked to.
	 */
	beacon_led_start(state);
	announce(state);

	if (net_link_connect() != 0) {
		printk("Offline mode: no OTA exchange is possible\n");
		printk("Hardware note: Wi-Fi, HTTP transfer, and OTA install remain unobserved\n");
		while (true) {
			k_sleep(K_SECONDS(CONFIG_COURSE_POLL_INTERVAL_SECONDS));
			printk("status.offline device_id=%s machine_state=%s\n",
			       CONFIG_COURSE_DEVICE_ID, beacon_state_name(state));
		}
	}

	if (net_link_address(address, sizeof(address)) == 0) {
		printk("wifi.address %s assigned by DHCP\n", address);
	}

	while (true) {
		if (poll_once(state)) {
			printk("Rebooting into the newly installed image\n");
			k_sleep(K_MSEC(200));
			course_reset_system();
		}
		k_sleep(K_SECONDS(CONFIG_COURSE_POLL_INTERVAL_SECONDS));
	}
}
```

## src/ota_client.c
```c
#include "ota_client.h"

#include <stdio.h>
#include <string.h>
#include <zephyr/data/json.h>
#include <zephyr/dfu/flash_img.h>
#include <zephyr/dfu/mcuboot.h>
#include <zephyr/kernel.h>
#include <zephyr/net/http/client.h>
#include <zephyr/net/socket.h>
#include <zephyr/net/tls_credentials.h>

#include <mbedtls/x509.h>

/* The Course certificate authority, compiled into this image.
 *
 * ./course build firmware writes course_ca_der.inc from the authority
 * generated for your Course environment. Without it the build falls back to
 * anchor/course_ca_der.inc, which is empty, and this image then trusts nothing
 * and says so on the console.
 *
 * The trailing zero keeps the array from being zero length when the anchor is
 * empty, so the length is one less than the array.
 */
static const unsigned char course_ca_der[] = {
#include "course_ca_der.inc"
	0x00
};

#define COURSE_CA_DER_LEN (sizeof(course_ca_der) - 1)

/* One tag identifies the trust anchor in Zephyr's credential store. */
#define COURSE_CA_TAG 1

#define OTA_REQUEST_TIMEOUT_MS 15000
#define OTA_DOWNLOAD_TIMEOUT_MS 120000
#define OTA_RECV_BUF_SIZE 1024
#define OTA_BODY_BUF_SIZE 768
#define OTA_EVENT_PATH "/v1/devices/" CONFIG_COURSE_DEVICE_ID "/events"

static uint8_t recv_buf[OTA_RECV_BUF_SIZE];

/* The JSON parser stores each string as a pointer into the response buffer,
 * so parsing needs its own struct of pointers. The values are copied into the
 * caller's fixed-size record before that buffer goes out of scope.
 *
 * Only the fields Tier 0 acts on appear here. json_obj_parse skips the rest of
 * the release record, so adding fields to the service does not break the
 * device.
 */
struct release_json {
	const char *release_id;
	const char *version;
	const char *image_path;
	const char *image_sha256;
	int image_size;
};

static const struct json_obj_descr release_descr[] = {
	JSON_OBJ_DESCR_PRIM(struct release_json, release_id, JSON_TOK_STRING),
	JSON_OBJ_DESCR_PRIM(struct release_json, version, JSON_TOK_STRING),
	JSON_OBJ_DESCR_PRIM(struct release_json, image_path, JSON_TOK_STRING),
	JSON_OBJ_DESCR_PRIM(struct release_json, image_sha256, JSON_TOK_STRING),
	JSON_OBJ_DESCR_PRIM(struct release_json, image_size, JSON_TOK_NUMBER),
};

static void copy_field(char *target, size_t len, const char *value)
{
	if (value == NULL) {
		target[0] = '\0';
		return;
	}
	strncpy(target, value, len - 1);
	target[len - 1] = '\0';
}

struct body_capture {
	char *buf;
	size_t len;
	size_t used;
};

struct status_capture {
	int code;
};

struct image_writer {
	struct flash_img_context ctx;
	size_t written;
	int err;
};

/* Register the trust anchor once. The credential store keeps a pointer rather
 * than a copy, which is why course_ca_der has static storage.
 */
static int ota_install_trust_anchor(void)
{
	static bool installed;
	int err;

	if (installed) {
		return 0;
	}
	if (COURSE_CA_DER_LEN == 0) {
		printk("ota.tls no trust anchor is compiled into this image\n");
		printk("ota.tls this image trusts nothing and will refuse every service\n");
		printk("ota.tls run ./course setup and build again\n");
		return -ENOENT;
	}
	err = tls_credential_add(COURSE_CA_TAG, TLS_CREDENTIAL_CA_CERTIFICATE,
				 course_ca_der, COURSE_CA_DER_LEN);
	if (err != 0 && err != -EEXIST) {
		printk("ota.tls trust anchor rejected err=%d\n", err);
		return err;
	}
	installed = true;
	return 0;
}

/* Say which check failed, not just that something did.
 *
 * A device that stops without explaining teaches nothing, and "connection
 * failed" is indistinguishable from a cable problem. This reconnects once with
 * verification set to optional, purely to read the verification flags, and
 * closes the socket immediately. No request is ever sent on it and no data ever
 * crosses it.
 *
 * The connection that carries data, above, always requires verification. This
 * one exists so the refusal can be read out loud.
 */
static void ota_explain_refusal(struct sockaddr_in *addr)
{
	sec_tag_t tags[] = {COURSE_CA_TAG};
	int optional = TLS_PEER_VERIFY_OPTIONAL;
	uint32_t result = 0;
	socklen_t len = sizeof(result);
	int sock;

	sock = zsock_socket(AF_INET, SOCK_STREAM, IPPROTO_TLS_1_2);
	if (sock < 0) {
		return;
	}
	(void)zsock_setsockopt(sock, SOL_TLS, TLS_SEC_TAG_LIST, tags, sizeof(tags));
	(void)zsock_setsockopt(sock, SOL_TLS, TLS_HOSTNAME,
			       CONFIG_COURSE_OTA_SERVICE_NAME,
			       sizeof(CONFIG_COURSE_OTA_SERVICE_NAME));
	(void)zsock_setsockopt(sock, SOL_TLS, TLS_PEER_VERIFY, &optional, sizeof(optional));
	if (zsock_connect(sock, (struct sockaddr *)addr, sizeof(*addr)) == 0 &&
	    zsock_getsockopt(sock, SOL_TLS, TLS_CERT_VERIFY_RESULT, &result, &len) == 0) {
		printk("ota.tls verification flags 0x%08x\n", result);
		if (result & MBEDTLS_X509_BADCERT_NOT_TRUSTED) {
			printk("ota.tls  the certificate was not issued by the trust anchor in this image\n");
			printk("ota.tls  compared: the certificate issuer against the Course certificate authority\n");
		}
		if (result & MBEDTLS_X509_BADCERT_CN_MISMATCH) {
			printk("ota.tls  the certificate does not carry the name this device requires\n");
			printk("ota.tls  compared: the certificate names against %s\n",
			       CONFIG_COURSE_OTA_SERVICE_NAME);
		}
		if (result & (MBEDTLS_X509_BADCERT_EXPIRED | MBEDTLS_X509_BADCERT_FUTURE)) {
			printk("ota.tls  the certificate validity window was rejected\n");
		}
		if (result == 0) {
			printk("ota.tls  the certificate verified; the failure was not the certificate\n");
		}
	}
	zsock_close(sock);
}

static int ota_connect(void)
{
	struct sockaddr_in addr = {
		.sin_family = AF_INET,
		.sin_port = htons(CONFIG_COURSE_OTA_TLS_PORT),
	};
	sec_tag_t tags[] = {COURSE_CA_TAG};
	int required = TLS_PEER_VERIFY_REQUIRED;
	int sock;
	int err;

	if (net_addr_pton(AF_INET, CONFIG_COURSE_OTA_HOST, &addr.sin_addr) != 0) {
		printk("ota.target invalid address %s\n", CONFIG_COURSE_OTA_HOST);
		return -EINVAL;
	}

	err = ota_install_trust_anchor();
	if (err != 0) {
		return err;
	}

	sock = zsock_socket(AF_INET, SOCK_STREAM, IPPROTO_TLS_1_2);
	if (sock < 0) {
		printk("ota.socket failed errno=%d\n", errno);
		return -errno;
	}

	/* The three options that make this a check rather than an encryption
	 * tunnel. The anchor to verify against, the name to require, and the
	 * demand that verification succeed.
	 *
	 * Zephyr already requires verification for clients by default, and sets
	 * an empty hostname when the application sets none, so a forgotten
	 * option fails loudly rather than accepting anything. This code states
	 * the requirement anyway, because a control that depends on a default
	 * is a control nobody can see.
	 */
	if (zsock_setsockopt(sock, SOL_TLS, TLS_SEC_TAG_LIST, tags, sizeof(tags)) < 0 ||
	    zsock_setsockopt(sock, SOL_TLS, TLS_HOSTNAME, CONFIG_COURSE_OTA_SERVICE_NAME,
			     sizeof(CONFIG_COURSE_OTA_SERVICE_NAME)) < 0 ||
	    zsock_setsockopt(sock, SOL_TLS, TLS_PEER_VERIFY, &required, sizeof(required)) < 0) {
		printk("ota.tls could not configure verification errno=%d\n", errno);
		zsock_close(sock);
		return -errno;
	}

	if (zsock_connect(sock, (struct sockaddr *)&addr, sizeof(addr)) < 0) {
		int connect_errno = errno;

		printk("ota.tls refused the connection to %s:%d errno=%d\n",
		       CONFIG_COURSE_OTA_HOST, CONFIG_COURSE_OTA_TLS_PORT, connect_errno);
		printk("ota.tls required name %s issued by the trust anchor in this image\n",
		       CONFIG_COURSE_OTA_SERVICE_NAME);
		zsock_close(sock);
		ota_explain_refusal(&addr);
		printk("ota.tls no release data was read, and the running image is unchanged\n");
		return -connect_errno;
	}
	printk("ota.tls verified %s at %s:%d, connection established\n",
	       CONFIG_COURSE_OTA_SERVICE_NAME, CONFIG_COURSE_OTA_HOST,
	       CONFIG_COURSE_OTA_TLS_PORT);
	return sock;
}

static int capture_body(struct http_response *rsp, enum http_final_call final,
			void *user_data)
{
	struct body_capture *capture = user_data;
	size_t room;

	ARG_UNUSED(final);

	if (rsp->body_frag_len == 0) {
		return 0;
	}
	room = capture->len - capture->used - 1;
	if (rsp->body_frag_len < room) {
		room = rsp->body_frag_len;
	}
	memcpy(capture->buf + capture->used, rsp->body_frag_start, room);
	capture->used += room;
	capture->buf[capture->used] = '\0';
	return 0;
}

/* http_client_req refuses a request with no response callback, so even a
 * fire-and-forget POST needs one. This records the status line so the caller
 * can tell a rejected report from a delivered one.
 */
static int capture_status(struct http_response *rsp, enum http_final_call final,
			  void *user_data)
{
	struct status_capture *capture = user_data;

	ARG_UNUSED(final);

	if (capture != NULL) {
		capture->code = rsp->http_status_code;
	}
	return 0;
}

static int write_image(struct http_response *rsp, enum http_final_call final,
		       void *user_data)
{
	struct image_writer *writer = user_data;

	if (writer->err != 0) {
		return writer->err;
	}
	if (rsp->body_frag_len > 0) {
		writer->err = flash_img_buffered_write(&writer->ctx,
						       rsp->body_frag_start,
						       rsp->body_frag_len, false);
		if (writer->err != 0) {
			printk("ota.write failed offset=%zu err=%d\n",
			       writer->written, writer->err);
			return writer->err;
		}
		writer->written += rsp->body_frag_len;
	}
	if (final == HTTP_DATA_FINAL) {
		writer->err = flash_img_buffered_write(&writer->ctx, NULL, 0, true);
		if (writer->err != 0) {
			printk("ota.flush failed err=%d\n", writer->err);
			return writer->err;
		}
	}
	return 0;
}

static int run_request(struct http_request *req, int32_t timeout_ms, void *user_data)
{
	int sock = ota_connect();
	int err;

	if (sock < 0) {
		return sock;
	}
	/* The Host header names the service, the socket connects to an address.
	 * The name is never resolved: it is what the certificate is checked
	 * against, and what the service is called.
	 */
	req->host = CONFIG_COURSE_OTA_SERVICE_NAME;
	req->protocol = "HTTP/1.1";
	req->recv_buf = recv_buf;
	req->recv_buf_len = sizeof(recv_buf);

	err = http_client_req(sock, req, timeout_ms, user_data);
	zsock_close(sock);

	if (err < 0) {
		printk("ota.request failed url=%s err=%d\n", req->url, err);
		return err;
	}
	return 0;
}

int ota_client_fetch_assignment(struct ota_release *release)
{
	char body[OTA_BODY_BUF_SIZE];
	struct body_capture capture = {.buf = body, .len = sizeof(body)};
	struct release_json parsed = {0};
	struct http_request req = {
		.method = HTTP_GET,
		.url = "/v1/releases/current",
		.response = capture_body,
	};
	int err;

	body[0] = '\0';
	err = run_request(&req, OTA_REQUEST_TIMEOUT_MS, &capture);
	if (err != 0) {
		return err;
	}
	if (capture.used == 0) {
		printk("ota.assignment empty response\n");
		return -ENODATA;
	}

	err = json_obj_parse(body, capture.used, release_descr,
			     ARRAY_SIZE(release_descr), &parsed);
	if (err < 0) {
		printk("ota.assignment unreadable err=%d\n", err);
		return err;
	}

	memset(release, 0, sizeof(*release));
	copy_field(release->release_id, sizeof(release->release_id), parsed.release_id);
	copy_field(release->version, sizeof(release->version), parsed.version);
	copy_field(release->image_path, sizeof(release->image_path), parsed.image_path);
	copy_field(release->image_sha256, sizeof(release->image_sha256), parsed.image_sha256);
	release->image_size = parsed.image_size;

	if (release->release_id[0] == '\0' || release->image_path[0] == '\0') {
		printk("ota.assignment missing release_id or image_path\n");
		return -EINVAL;
	}
	return 0;
}

int ota_client_report(const char *event, const char *machine_state,
		      const char *release_id, const char *detail)
{
	char payload[320];
	const char *headers[] = {"Content-Type: application/json\r\n", NULL};
	struct status_capture status = {0};
	struct http_request req = {
		.method = HTTP_POST,
		.url = OTA_EVENT_PATH,
		.header_fields = headers,
		.response = capture_status,
	};
	int len;
	int err;

	len = snprintf(payload, sizeof(payload),
		       "{\"device_id\":\"%s\",\"event\":\"%s\",\"machine_state\":\"%s\","
		       "\"running_release_id\":\"%s\",\"detail\":\"%s\","
		       "\"transport\":\"https\",\"synthetic_data\":true}",
		       CONFIG_COURSE_DEVICE_ID, event, machine_state, release_id,
		       detail == NULL ? "" : detail);
	if (len < 0 || len >= (int)sizeof(payload)) {
		return -ENOMEM;
	}
	req.payload = payload;
	req.payload_len = len;

	err = run_request(&req, OTA_REQUEST_TIMEOUT_MS, &status);
	if (err != 0) {
		return err;
	}
	if (status.code < 200 || status.code >= 300) {
		printk("ota.report rejected status=%d\n", status.code);
		return -EIO;
	}
	return 0;
}

bool ota_release_differs(const struct ota_release *release)
{
	return strcmp(release->release_id, CONFIG_COURSE_RELEASE_ID) != 0;
}

int ota_client_install(const struct ota_release *release)
{
	char url[OTA_FIELD_MAX + 16];
	struct image_writer writer = {0};
	struct http_request req = {
		.method = HTTP_GET,
		.response = write_image,
	};
	int err;

	if (snprintf(url, sizeof(url), "/v1/firmware/%s", release->image_path) >=
	    (int)sizeof(url)) {
		return -ENOMEM;
	}
	req.url = url;

	printk("ota.install starting release_id=%s version=%s size=%d\n",
	       release->release_id, release->version, release->image_size);
	printk("ota.install declared_sha256=%s (Tier 0 does not check it)\n",
	       release->image_sha256);

	err = flash_img_init(&writer.ctx);
	if (err != 0) {
		printk("ota.slot unavailable err=%d\n", err);
		return err;
	}

	err = run_request(&req, OTA_DOWNLOAD_TIMEOUT_MS, &writer);
	if (err != 0) {
		return err;
	}
	if (writer.err != 0) {
		return writer.err;
	}
	if (writer.written == 0) {
		printk("ota.install received no image bytes\n");
		return -ENODATA;
	}
	if (release->image_size > 0 && writer.written != (size_t)release->image_size) {
		printk("ota.install size mismatch declared=%d received=%zu\n",
		       release->image_size, writer.written);
		return -EMSGSIZE;
	}

	printk("ota.install wrote %zu bytes to the secondary slot\n", writer.written);

	err = boot_request_upgrade(BOOT_UPGRADE_PERMANENT);
	if (err != 0) {
		printk("ota.upgrade request failed err=%d\n", err);
		return err;
	}
	printk("ota.upgrade requested a permanent swap, no test boot, no rollback\n");
	return 0;
}

const char *ota_client_anchor_description(void)
{
	if (COURSE_CA_DER_LEN == 0) {
		return "none compiled in, this image trusts nothing";
	}
	return CONFIG_COURSE_TRUST_ANCHOR_FINGERPRINT;
}
```
