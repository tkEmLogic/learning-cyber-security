## CMakeLists.txt
```
# SPDX-License-Identifier: Apache-2.0

cmake_minimum_required(VERSION 3.20.0)

list(APPEND EXTRA_ZEPHYR_MODULES ${CMAKE_CURRENT_SOURCE_DIR}/../common)

find_package(Zephyr REQUIRED HINTS $ENV{ZEPHYR_BASE})
project(tier_06_factory_identity)

test_sysbuild()

# The trust anchor is compiled into the image, the same way the Wi-Fi
# credentials are. ./course build firmware writes course_ca_der.inc from the
# Course certificate authority in .course-secrets/, and passes the directory
# here.
#
# Without it the build falls back to anchor/, which holds an empty anchor. The
# repository then still builds standalone, and the resulting image refuses to
# connect and says why. An image that trusts nothing is the right failure: the
# alternative is an image that trusts anything.
# The directory arrives in the environment rather than as a CMake cache
# variable. Sysbuild keeps an image-scoped -D<image>_VAR in its own cache and
# does not forward an arbitrary one into the image build, so a cache variable
# silently produced an image with no anchor. The environment reaches every
# image's configure step.
if(DEFINED ENV{COURSE_CA_INC_DIR})
	zephyr_include_directories($ENV{COURSE_CA_INC_DIR})
else()
	zephyr_include_directories(anchor)
endif()

# The release manifest verification key arrives the same way, from
# ./course build firmware, which writes release_pubkey.inc from the public half
# of the Learner's Release signing key. It has its own variable because it is
# its own decision: the certificate authority says which service to talk to,
# and this key says whose release metadata to believe. Nothing about one
# implies the other.
#
# Without it the build falls back to anchor/, which holds no key, and the
# resulting image verifies no manifest and says so at boot and at every
# refusal. That is the same honest failure the empty trust anchor produces.
if(DEFINED ENV{COURSE_RELEASE_KEY_INC_DIR})
	zephyr_include_directories($ENV{COURSE_RELEASE_KEY_INC_DIR})
else()
	zephyr_include_directories(anchor)
endif()

# The fleet identity, compiled into the shared image only.
#
# ./course build firmware --tier 06 --variant shared writes these and sets the
# variable. It is the one build in the course that is handed a private key, and
# the variable is set for that one variant, so the factory build does not have
# the key on its include path at all. See the Tier 6 section of
# docs/fixture-safety-contract.md for the bound on that exception.
#
# Without it the build falls back to anchor/, which is empty, and the shared
# image can prove possession of nothing and says so. That is the same honest
# failure the empty trust anchor produces.
if(DEFINED ENV{COURSE_SHARED_IDENTITY_INC_DIR})
	zephyr_include_directories($ENV{COURSE_SHARED_IDENTITY_INC_DIR})
else()
	zephyr_include_directories(anchor)
endif()

target_sources(app PRIVATE
	src/health_gate.c
	src/identity.c
	src/main.c
	src/ota_client.c
	src/recovery_state.c
	src/release_policy.c
)

target_sources_ifdef(CONFIG_COURSE_PROVISIONING_SHELL app PRIVATE
	src/provisioning_shell.c
)

target_sources_ifdef(CONFIG_COURSE_SHARED_SHELL app PRIVATE
	src/shared_shell.c
)
```

## Kconfig
```
# Configuration Tier 5 adds on top of the shared options in firmware/common.
#
# The first block is inherited from Tier 2, which taught the device to verify
# the service it talks to. Tier 4 keeps every word of it: the manifest is
# fetched over that same verified connection, and a signed manifest does not
# make an unverified connection acceptable.

menu "Tier 2 authenticated service"

config COURSE_OTA_SERVICE_NAME
	string "Name the service certificate must carry"
	default "ota.course.example"
	help
	  The device connects to CONFIG_COURSE_OTA_HOST, a literal address, and
	  then requires the certificate presented there to carry this name.

	  The name is never resolved. There is no DNS resolver in this image.
	  It is the value the TLS layer compares the certificate against, which
	  is why a wrong name is refused even though the address was right.

config COURSE_OTA_TLS_PORT
	int "OTA service TLS port"
	default 8443
	help
	  Tier 2 moves release records, firmware bytes, and status events to
	  this port. Health and the Course environment marker stay on the plain
	  HTTP port, because a safety check must not depend on the control it
	  is used to test.

config COURSE_TRUST_ANCHOR_FINGERPRINT
	string "Fingerprint of the trust anchor compiled into this image"
	default "unknown"
	help
	  Printed at boot so a stale trust anchor diagnoses itself instead of
	  looking like a broken network. ./course build firmware writes this
	  value, and ./course service certificate prints the same one.

	  The device does not compute it. Computing a digest on the board to
	  describe material the board already holds would prove nothing that the
	  build cannot state.

endmenu

menu "Tier 4 release policy"

config COURSE_SECURITY_COUNTER
	int "Security counter of the running image"
	default 1
	help
	  The anti-rollback counter this image was signed with. The same value
	  goes into the signed MCUboot image TLV and into the signed Release
	  manifest, and ./course build firmware writes it from the one constant
	  in internal/courseapp/tier04.go so the two cannot disagree.

	  The application refuses a manifest whose counter is lower than this
	  one. Equal is allowed; lower never is. That check saves a wasted
	  download and is not the boundary: the bootloader is what actually
	  stops a downgrade, by comparing the candidate's counter against the
	  counter in the image already in the primary slot.

	  It is deliberately not derived from the human-readable version.
	  "Human-readable versions override the security counter" is the
	  failure this tier is about.

config COURSE_HARDWARE_REVISION
	int "Product hardware revision this build asserts"
	default 1
	help
	  The product hardware revision a release is targeted at, compared
	  against the manifest's signed hardware_revision_min..max range.

	  It is asserted, not read. The chip reports its silicon stepping from
	  eFuse and the boot banner prints that beside this value, but nothing
	  on this part reports which product a board was built into. Product
	  identity is asserted and protected; a value the device reads is not a
	  claim anybody signed.

config COURSE_RELEASE_CHANNEL
	string "Release channel this device follows"
	default "stable"
	help
	  One of stable or candidate. The device refuses a manifest published
	  to any other channel, even a correctly signed one.

	  This is the check that has no attacker behind it. Nobody without the
	  Release signing key can produce a manifest that gets this far, so a
	  channel mismatch means whoever holds the key published something for
	  the wrong devices. The device cannot tell that from a leaked key, and
	  refusing is the same either way.

endmenu

menu "Tier 5 recoverable install"

choice COURSE_TRIAL_BEHAVIOUR
	prompt "How this image behaves during its trial boot"
	default COURSE_TRIAL_HEALTHY
	help
	  Tier 5 publishes five images from this one source tree. They differ
	  only in what happens between the trial boot and the confirmation,
	  which is the whole subject of the tier, so the difference a Learner
	  has to understand is one conditional rather than a diff between five
	  directories.

	  Every one of them is a real, correctly signed image. None of them is
	  hostile: an unhealthy release is the manufacturer publishing something
	  that does not work, which section 11 names beside the attacks.

config COURSE_TRIAL_HEALTHY
	bool "Healthy: pass every check and confirm"
	help
	  The release that works. It passes the four health checks, survives the
	  60 second window, and calls boot_write_img_confirmed().

config COURSE_TRIAL_CRASH
	bool "Crash: fault before the health gate starts"
	help
	  Faults deliberately before the gate runs, so it is distinct from
	  FAIL_HEALTH, which requires the gate to have run. The image never
	  reaches the code that could record why, so the device identifies it by
	  reset cause and by the absence of a written reason.

config COURSE_TRIAL_HANG
	bool "Hang: stop in the thread that feeds the watchdog"
	help
	  An ordinary loop, in main. Interrupts keep being serviced and the
	  beacon thread keeps running; what stops is the watchdog feed, because
	  main is the only thing that ever performs one.

	  Feeding from the thread that does the work, rather than from a timer,
	  is what makes this catchable at all. A feed on a timer keeps running
	  while the thread it vouches for is dead, and the watchdog would be
	  guarding nothing.

	  This was checked on the board. The driver programs stage 0 as an
	  interrupt whose handler is documented as clearing the interrupt and
	  feeding the watchdog, which would mean only a hang that also blocked
	  interrupts ever reached the resetting stage. It does not work out that
	  way: that function must be called with write protection disabled, and
	  wdt_esp32_isr() does not disable it, so its feed has no effect and
	  stage 1 resets the chip. That is a property of this driver rather than
	  a guarantee, and an upstream fix would change it silently.

config COURSE_TRIAL_FAIL_HEALTH
	bool "Fail health: fail one named check"
	help
	  Fails a single named check while the other three visibly pass, so the
	  cause is read rather than inferred from where the output stopped.

config COURSE_TRIAL_TIMEOUT_HEALTH
	bool "Timeout health: never reach a verdict"
	help
	  Leaves one check unsatisfied so the 60 second window expires without a
	  verdict. Distinct from FAIL_HEALTH: the specification separates a
	  failed check from an expired timer, and these two images are what make
	  that separation observable.

endchoice

config COURSE_TRIAL_BEHAVIOUR_NAME
	string
	default "healthy" if COURSE_TRIAL_HEALTHY
	default "crash" if COURSE_TRIAL_CRASH
	default "hang" if COURSE_TRIAL_HANG
	default "fail-health" if COURSE_TRIAL_FAIL_HEALTH
	default "timeout-health" if COURSE_TRIAL_TIMEOUT_HEALTH
	help
	  The name this image prints for its own trial behaviour. Not settable:
	  it follows the choice above so the two cannot disagree.

config COURSE_HEALTH_GATE_SECONDS
	int "Length of the local health window"
	default 60
	help
	  Section 6 fixes this at 60 seconds. It is measured from the end of the
	  boot-time checks rather than from boot, so a slow boot cannot eat the
	  window and make the gate's length depend on something it is not
	  measuring.

config COURSE_TRIAL_FAILURE_LIMIT
	int "How many trials of one release before it is refused"
	default 3
	help
	  Bounds the revert loop. A release that installs cleanly and then fails
	  its trial would otherwise be offered, installed, fail and revert
	  forever, because nothing about it is invalid.

	  The count is incremented when a trial begins, never when one fails. A
	  crashing image never reaches code that could record a failure, and a
	  hung one is reset from interrupt context where an NVS write is not
	  safe, so a count kept on failure would miss exactly the two failures
	  that most need counting.

	  This is persistent state about a release, and it is not the
	  application-managed accepted-image database section 6 forbids. That
	  prohibition exists so a failed trial can always revert to the
	  previously confirmed image. This count never blocks a revert; it only
	  stops the device re-attempting a release it has already proven bad.

config COURSE_SOURCE_REVISION
	string "Source revision this image was built from"
	default "unknown"
	help
	  The git hash of the tree this image was built from, with -dirty
	  appended when the tree was dirty, exactly as git describe --dirty
	  reports it.

	  It also travels in a protected MCUboot TLV at tag 0x00A0, so it is
	  covered by the image signature and cannot be rewritten without
	  invalidating the image. This Kconfig value is what the build put in
	  that TLV.

	  It identifies the build and not the release. A Learner's own build
	  carries their hash and will usually be dirty, and will not match a
	  published one. The course claims no reproducible builds, and this
	  value is not evidence of any.

	  What it answers is "what am I running" after a revert, when the
	  Release manifest that described the image was consumed long ago and
	  the device no longer holds it.

endmenu

menu "Tier 6 factory identity"

choice COURSE_IDENTITY
	prompt "Which identity this image carries"
	default COURSE_IDENTITY_FACTORY
	help
	  Tier 6 publishes two images from this one source tree. They differ in
	  where the device's identity comes from, which is the whole subject of
	  the tier, so the difference a Learner has to understand is one
	  conditional rather than a diff between two directories.

	  There is deliberately no third option that generates a key when it can
	  and falls back to the shared identity when it cannot. "Failed
	  enrollment silently falls back to shared identity" is a stated failure
	  criterion in section 11, and an image that does it is the thing this
	  tier exists to argue against.

config COURSE_IDENTITY_SHARED
	bool "Shared: one identity compiled into every image"
	help
	  The before state. One ECDSA P-256 key pair and one certificate,
	  identical in every image, compiled in beside the Wi-Fi credentials and
	  the trust anchor.

	  Possession of this key is simultaneously the identity and the
	  authorization to enroll. There is no Bootstrap credential at all,
	  which is exactly what section 11 means by a reusable default
	  credential remaining active, and the hardening splits those two roles
	  rather than swapping one credential for another.

	  This is the one place in the whole course where a private key is
	  deliberately compiled into a firmware image. It is a throwaway
	  credential generated locally for the exercise, it is never committed,
	  and it exists because a credential a Learner cannot extract from their
	  own image cannot teach why shared credentials fail. See the Tier 6
	  section of docs/fixture-safety-contract.md.

config COURSE_IDENTITY_FACTORY
	bool "Factory: a key generated on this device"
	help
	  The after state. The device generates its own P-256 key with the
	  platform random number generator, stores it through the limited PSA
	  Secure Storage configuration in section 8, and proves possession of it
	  in a certification request.

	  Only the public half ever leaves. The backend never sees the private
	  key, which section 11 names as a failure criterion if it is broken.

endchoice

config COURSE_IDENTITY_NAME
	string
	default "shared" if COURSE_IDENTITY_SHARED
	default "factory" if COURSE_IDENTITY_FACTORY
	help
	  The name this image prints for its own identity model. Not settable:
	  it follows the choice above so the two cannot disagree.

config COURSE_PROVISIONING_SHELL
	bool "Offer the provisioning shell while unprovisioned"
	default y
	depends on COURSE_IDENTITY_FACTORY
	help
	  The enrollment interface. It is a Zephyr shell rather than a private
	  protocol on purpose: a hidden framing is obscurity and not security,
	  and both are exposed on exactly the same terms once the gating below
	  is in place.

	  What makes it defensible is that it is reduced and closed. SHELL_MINIMAL
	  turns off the kernel module, the built-in commands, history, tab
	  completion and VT100 handling, all of which are gated on the same
	  condition, so an attacker finding this shell finds two provisioning
	  commands and nothing else. SHELL_AUTOSTART is off, so the application
	  decides when it runs, and it stops it the moment enrollment succeeds.

	  A Learner can check both halves: type a command after enrolling and
	  watch nothing happen.

config COURSE_SHARED_SHELL
	bool "Offer the registration interface on the shared image"
	default y
	depends on COURSE_IDENTITY_SHARED
	help
	  The before state's console interface, and the counterpart of
	  COURSE_PROVISIONING_SHELL on the factory image.

	  It is reduced by the same SHELL_MINIMAL and started by the same
	  application decision, so the two images are compared on what they can
	  prove rather than on how much shell they expose.

	  What differs is that this one never closes. The factory image shuts its
	  interface the moment enrollment succeeds, because enrollment is a thing
	  that finishes. A shared image has nothing to finish: it was already the
	  device when it was flashed, so there is no state change for an interface
	  to close after.

config COURSE_PROVISIONING_BUTTON_REOPENS
	bool "Let the BOOT button reopen provisioning on an enrolled device"
	default y
	depends on COURSE_PROVISIONING_SHELL
	help
	  Without this the interface closes permanently on enrollment, and there
	  is then no way to send the erase command that remanufacturing needs.
	  Reflashing does not help: Secure Storage lives in the storage
	  partition and survives a slot 0 flash, exactly the way MCUboot's
	  trailer does.

	  The cost is a weakness worth naming rather than hiding: anyone with
	  physical access and this button can put the device back into
	  provisioning mode. That is a deliberate trade for recoverability, and
	  Advanced Tier A is where the debug and download paths around it are
	  closed.

config COURSE_PROVISIONING_BUTTON_HOLD_SECONDS
	int "Seconds the BOOT button must be held to reopen provisioning"
	default 10
	range 2 60
	depends on COURSE_PROVISIONING_BUTTON_REOPENS
	help
	  The button is read while the application runs, not at reset.

	  Reading it at reset cannot work on this part: sw0 is GPIO9, the
	  ESP32-C6 strapping pin, so holding it through the reset edge straps
	  the chip into the ROM download loader and the application never runs
	  at all. The only window was therefore after the reset and before the
	  gate, which is a fraction of a second, and hitting it reliably was not
	  something a Learner should have to practise.

	  So the button is armed with an interrupt instead, and a deliberate
	  long press reopens the interface in place, with no reset and no
	  re-enumeration of the USB device. A sustained hold is also harder to
	  trigger by accident than a press during boot.

endmenu

source "Kconfig.zephyr"

config COURSE_SIGNING_KEY_FINGERPRINT
	string "Fingerprint of the image verification key this image was built beside"
	default "unknown"
	help
	  Printed at boot so a Learner can see which key the build trusted, and
	  so a key regenerated after flashing diagnoses itself instead of looking
	  like a broken image.

	  Read the wording in main.c before changing this. The application cannot
	  see what the bootloader actually holds. This value comes from the same
	  build that produced the bootloader, so it is a claim about the build and
	  not an observation of the device. Verifying the bootloader itself is
	  Advanced Tier A's subject.

	  From Tier 4 the same fingerprint also describes the release manifest
	  verification key compiled into the application, because section 7 fixes
	  that one key signs both. Unlike the bootloader's copy, that one this
	  application does hold, and release_policy.c reports when it is absent.
```

## prj.conf
```kconfig
CONFIG_PRINTK=y
CONFIG_ESPTOOLPY_FLASHSIZE_4MB=y
CONFIG_MAIN_STACK_SIZE=8192
CONFIG_REBOOT=y

# Wi-Fi station and IPv4. Tier 2 speaks HTTPS to one literal address and checks
# the certificate against a name, so it still needs no name resolution. The
# name is compared, never looked up, and there is no resolver in this image.
#
# Tier 4 fetches two more objects over that same connection, the Release
# manifest and its detached signature. Verifying the manifest does not make an
# unverified connection acceptable, so nothing here is relaxed.
CONFIG_NETWORKING=y
CONFIG_WIFI=y
CONFIG_NET_IPV4=y
CONFIG_NET_IPV6=n
CONFIG_NET_DHCPV4=y
CONFIG_NET_TCP=y
CONFIG_NET_SOCKETS=y
CONFIG_NET_MGMT=y
CONFIG_NET_MGMT_EVENT=y
CONFIG_NET_MGMT_EVENT_INFO=y
CONFIG_NET_MGMT_EVENT_STACK_SIZE=4096
CONFIG_ESP32_WIFI_STA_AUTO_DHCPV4=y

CONFIG_NET_PKT_RX_COUNT=16
CONFIG_NET_PKT_TX_COUNT=16
CONFIG_NET_BUF_RX_COUNT=32
CONFIG_NET_BUF_TX_COUNT=32
CONFIG_NET_MAX_CONTEXTS=8

CONFIG_HTTP_CLIENT=y
CONFIG_JSON_LIBRARY=y

# TLS for the update and status connection.
#
# CONFIG_MBEDTLS is already on in Tier 0, because the Wi-Fi driver needs it.
# Tier 2 adds the socket layer, the credential store, and one ciphersuite.
CONFIG_NET_SOCKETS_SOCKOPT_TLS=y
CONFIG_TLS_CREDENTIALS=y
CONFIG_MBEDTLS_CIPHERSUITE_TLS_ECDHE_ECDSA_WITH_AES_128_GCM_SHA256=y
CONFIG_MBEDTLS_ENABLE_HEAP=y
CONFIG_MBEDTLS_HEAP_SIZE=49152
# A TLS record can be 16 KiB, and the peer decides how big it makes one.
#
# This was 2048 while Tier 3 was being built, because every response Tier 2
# had ever fetched over TLS was a small JSON record that fitted. Tier 3 is the
# first tier to download a firmware image over the verified connection, and the
# Go service sends that in full sized records. The client cannot hold one,
# mbedTLS treats it as fatal, and the socket layer returns -ECONNABORTED before
# a single byte reaches the flash writer.
#
# The symptom is misleading: "ota.request failed err=-113" after a handshake
# the same log line says succeeded. Nothing in the failure mentions buffers.
#
# Tier 2 now sets 16384 for the same reason. See issue #62.
CONFIG_MBEDTLS_SSL_MAX_CONTENT_LEN=16384
CONFIG_NET_SOCKETS_TLS_MAX_CONTEXTS=2

# The trust anchor is compiled in as DER, so the PEM parser is not needed.
#
# Tier 4 adds a second compiled-in key, the release manifest verification key,
# and it stays off for that too. The build strips it to a bare 65-byte EC point
# that PSA imports directly. Measured on issue #65: turning PEM parsing back on
# costs 1696 bytes of .text and 228 of .flash.rodata to do at run time what the
# build does for free, and puts a text parser on the path to a trust decision.
CONFIG_MBEDTLS_PEM_PARSE_C=n

# Verifying the Release manifest needs no new Kconfig symbol at all.
#
# psa_hash_compute, mbedtls_ecdsa_der_to_raw, psa_import_key and
# psa_verify_hash are already linked into the untouched Tier 3 image, pulled in
# by two lines nobody set for this purpose: the ciphersuite above selects
# PSA_WANT_ALG_ECDSA, PSA_WANT_ALG_SHA_256 and the ECC key types and implies
# PSA_WANT_ECC_SECP_R1_256, and CONFIG_NET_SOCKETS_SOCKOPT_TLS does
# "select PSA_CRYPTO". psa_crypto_init() is already called from Zephyr's own
# SYS_INIT.
#
# The two lines below are assertions, not requests. They are already y, they
# change no bytes, and they are here so that a future change to the ciphersuite
# fails the build rather than quietly removing a verifier. release_policy.c
# carries the same statement as compile-time #error probes, because a symbol
# being set is not the same as a driver being present.
#
# Do not reach for CONFIG_MBEDTLS_ECDSA_C, CONFIG_MBEDTLS_ECP_C or
# CONFIG_MBEDTLS_ECP_DP_SECP256R1_ENABLED. This tree is Mbed TLS 4.1.0 with the
# separate tf-psa-crypto module and those symbols do not exist here; curves and
# algorithms are selected only through PSA_WANT_*.
CONFIG_PSA_WANT_ALG_ECDSA=y
CONFIG_PSA_WANT_ECC_SECP_R1_256=y

# Certificate validity dates are deliberately not checked.
#
# This board has no real-time clock. With CONFIG_MBEDTLS_HAVE_TIME_DATE=y and
# no time source the clock reads 1970, every certificate is "not yet valid",
# and every handshake fails forever. The option is orthogonal to chain and name
# checking, so leaving it off costs neither of those.
#
# The consequence is real and belongs in the Weakness ledger: this device would
# accept an expired certificate. Tier 8 is where credential lifetime becomes
# the subject.
CONFIG_MBEDTLS_HAVE_TIME_DATE=n

# Reading the verification flags after a refusal, so the device can say which
# check failed instead of only that something did.
CONFIG_MBEDTLS_X509_CRT_PARSE_C=y

# Writing the downloaded image into the secondary slot and asking MCUboot to
# swap it in. Tier 0 deliberately added no check here at all; Tier 4 decides
# whether to write before the transfer starts, and whether to request the swap
# after the bytes have been hashed.
CONFIG_FLASH=y
CONFIG_FLASH_MAP=y
CONFIG_STREAM_FLASH=y
CONFIG_IMG_MANAGER=y
CONFIG_IMG_ERASE_PROGRESSIVELY=y
CONFIG_MCUBOOT_IMG_MANAGER=y

# The course network may publish the same name on 2.4 GHz and 5 GHz. Scanning
# every channel makes the board pick the 2.4 GHz radio it can actually use.
CONFIG_ESP32_WIFI_STA_SCAN_ALL=y
CONFIG_ESP32_WIFI_STA_RECONNECT=y

# Tier 5: the storage partition's first use in this course.
#
# The 192 KiB storage partition at 0x3b0000 has been in the pinned flash map
# since Tier 0 and no tier has ever written to it. Tier 5 needs somewhere for
# the download progress record and the trial failure count to survive a power
# cut, and this is what that partition is for.
#
# NVS directly rather than the settings subsystem. Settings is built on NVS
# here, so it is a layer of ergonomics over a record with four fields, and in
# the one tier whose subject is what survives a power cut a Learner is better
# served by seeing the write that matters.
CONFIG_NVS=y

# Tier 5: the watchdog that resets a trial image which hangs before it can
# report failure.
#
# Nothing in firmware/ has ever set this, and the esp32 driver actively
# disables the hardware during its own init, so the watchdog is off until an
# application turns it on and calls wdt_setup(). An image that hangs on a board
# with no watchdog running looks exactly like a control working.
#
# Read the COURSE_TRIAL_HANG help text before assuming this catches every hang.
# It does not, and what it misses is in the Tier 5 ledger.
CONFIG_WATCHDOG=y

# Reading back the image from the secondary slot to hash it.
#
# Tier 4 hashed the bytes as they streamed past, which a resumable download
# cannot do: after a power cut the hash state is gone, and persisting SHA-256
# midstate would be a great deal of unpleasantness for no gain. Tier 5 hashes
# the slot once the transfer completes instead.
#
# That is strictly the better check. Tier 4's comment says the digest protects
# the upgrade request, and hashing the slot makes that true of what is actually
# in the flash rather than of what the device believes it wrote.
CONFIG_FLASH_PAGE_LAYOUT=y

# Tier 6: a device identity key generated on the board.
#
# PSA_WANT_ALG_ECDSA and PSA_WANT_ECC_SECP_R1_256 are already on above, from
# Tier 4's manifest verification. Generating a key rather than only verifying
# with one needs the keypair types as well.
CONFIG_PSA_WANT_KEY_TYPE_ECC_KEY_PAIR_GENERATE=y
CONFIG_PSA_WANT_KEY_TYPE_ECC_KEY_PAIR_EXPORT=y
CONFIG_PSA_WANT_ALG_SHA_256=y

# PSA_WANT_KEY_TYPE_ECC_PUBLIC_KEY is not optional and it fails silently.
#
# MBEDTLS_PK_MAX_PUBKEY_RAW_LEN is defined as 0 without it (pk.h:91) and that
# constant sizes a buffer in every PK context, so the failure is a zero length
# public key rather than a build error. It is currently on in some builds only
# as a side effect of the Wi-Fi driver's WPA3 option, which is not something to
# depend on. Measured on issue #108.
CONFIG_PSA_WANT_KEY_TYPE_ECC_PUBLIC_KEY=y

# Writing a certification request. MBEDTLS_X509_CSR_WRITE_C selects nothing at
# all, and the CSR writer calls mbedtls_pk_write_pubkey_der(), which is
# compiled out without MBEDTLS_PK_WRITE_C. Both are named here rather than one
# being assumed to imply the other.
#
# MBEDTLS_PEM_WRITE_C is deliberately absent. The request goes over the wire as
# DER. Turning PEM writing on would partly reverse the size decision Tier 5
# made and explained when it set CONFIG_MBEDTLS_PEM_PARSE_C=n.
CONFIG_MBEDTLS_PK_WRITE_C=y
CONFIG_MBEDTLS_X509_CSR_WRITE_C=y
CONFIG_MBEDTLS_X509_USE_C=y

# Storing the private key, in the exact configuration section 8 fixes.
#
# Read the limitation with it. The AEAD key is SHA-256 over a device identifier
# and the entry uid, and on this part that identifier is six bytes of the
# factory MAC: a value the device broadcasts in every Wi-Fi frame and which
# esptool read-mac prints over the same cable used to dump the flash. This
# encrypts the key at rest against casual inspection and detects unauthenticated
# changes. It is not a protected root secret, it does not prevent record replay,
# and it does not protect the key from privileged firmware, a debugger, or a
# capable flash attacker.
#
# Zephyr says so itself at boot, and the course leaves that warning switched on:
#   WARNING: Using a potentially insecure PSA ITS encryption key provider.
CONFIG_SECURE_STORAGE=y
CONFIG_SECURE_STORAGE_ITS_TRANSFORM_IMPLEMENTATION_AEAD=y
CONFIG_SECURE_STORAGE_ITS_TRANSFORM_AEAD_SCHEME_AES_GCM=y
CONFIG_SECURE_STORAGE_ITS_TRANSFORM_AEAD_KEY_PROVIDER_DEVICE_ID_HASH=y
CONFIG_SECURE_STORAGE_ITS_STORE_IMPLEMENTATION_SETTINGS=y

# The device identifier the key provider hashes comes from hwinfo.
CONFIG_HWINFO=y

# Settings, which the ITS store writes through, and which brings its own NVS
# instance on the storage partition.
#
# Tier 5 mounted its own nvs_fs at the first byte of that same partition and
# explained at length why it chose NVS over settings. Both land on the same
# bytes and nothing detects it: nvs_mount() checks write block size, sector
# size and a count of at least two, and nothing else, so both mounts return 0
# and the damage does not wait for a write.
#
# Tier 6 keeps Tier 5's raw records and its reasoning, and stops mounting a
# second instance. recovery_state.c now writes through the instance settings
# already owns, reached with settings_storage_get(). The entry id spaces do not
# overlap: settings uses 0x8000 and above, Tier 5 uses 1, 2 and 3. Measured on
# issue #109, decided on issue #120.
CONFIG_SETTINGS=y
CONFIG_SETTINGS_NVS=y

# The provisioning interface.
#
# SHELL_MINIMAL is the load-bearing line. Without it KERNEL_SHELL is default y
# and implies INIT_STACKS, THREAD_MONITOR, THREAD_NAME and THREAD_STACK_INFO,
# so a plain CONFIG_SHELL=y would hand anyone with the cable thread
# introspection and a reboot command. Every one of those, and the built-in
# commands, history, tab completion and VT100 handling, is gated on the same
# !SHELL_MINIMAL condition, so one symbol turns the lot off and anything
# upstream adds the same way stays off too.
#
# SHELL_AUTOSTART is off so the application chooses when the shell runs.
# shell_init() still runs at boot from the backend; AUTOSTART only decides
# whether it calls shell_start() for you (shell.c:1369).
CONFIG_SHELL=y
CONFIG_SHELL_MINIMAL=y
CONFIG_SHELL_AUTOSTART=n
CONFIG_SHELL_BACKEND_SERIAL=y

# The provisioning shell's own thread, and the buffers around it.
#
# Every one of these three was found on the board, and each produced a failure
# that looked like something else.
#
# SHELL_STACK_SIZE defaults to 2048. Enrollment runs the entire certification
# request on this thread: loading the persistent PSA key out of Secure Storage
# decrypts an AES-GCM record through settings and NVS, and the CSR writer then
# encodes and signs. That overran 2 KiB and the symptom was an illegal
# instruction at an address in SRAM with a call trace pointing into gcm_mask,
# which reads like a fault inside the crypto library rather than like a stack
# that ran out. It is neither: it is a return address overwritten by the frame
# below it.
CONFIG_SHELL_STACK_SIZE=8192

# A stack that runs out should say so instead of jumping to whatever the data
# happened to be. The sentinel is checked on every context switch and turns the
# failure above into a named panic. It is here because the failure it names
# cost a debugging session, and because an unprovisioned board in front of a
# Learner is exactly where this path runs.
CONFIG_STACK_SENTINEL=y

# The station sends the issued certificate over this console. The command
# buffer defaults to 128 bytes, which is shorter than the certificate.
CONFIG_SHELL_CMD_BUFF_SIZE=256

# The serial backend's receive ring defaults to 64 bytes. The shell thread does
# not drain it fast enough when a host writes a long line in one go, and the
# first attempt at enrollment lost characters out of the middle of a 64
# character credential and acted on the corrupted text. Nothing reported the
# loss: a dropped character is not an error, it is simply a different command.
CONFIG_SHELL_BACKEND_SERIAL_RX_RING_BUFFER_SIZE=512

# The onboard status beacon. The DevKitC-1 shows the machine state on its
# WS2812 RGB LED as well as on the console; CONFIG_COURSE_BEACON_LED in
# firmware/common turns that off again for a board that has no such LED.
CONFIG_LED_STRIP=y
```

## src/health_gate.c
```c
#include "health_gate.h"
#include "ota_client.h"

#include <errno.h>
#include <stddef.h>
#include <string.h>

#include <zephyr/devicetree.h>
#include <zephyr/drivers/watchdog.h>
#include <zephyr/kernel.h>
#include <zephyr/dfu/mcuboot.h>
#include <zephyr/storage/flash_map.h>
#include <zephyr/sys/atomic.h>
#include <zephyr/sys/printk.h>
#include <zephyr/sys/util.h>

/* The dev kit enables one Timer Group watchdog and gives it this alias. The
 * second is disabled in the SoC devicetree, and the RTC watchdog is not
 * exposed to Zephyr at all on this part.
 */
#define WDT_NODE DT_ALIAS(watchdog0)

static const struct device *const wdt = DEVICE_DT_GET_OR_NULL(WDT_NODE);
static int wdt_channel = -1;

static atomic_t beacon_ticks;

/* How long the watchdog is given before it decides the device is not coming
 * back.
 *
 * Comfortably longer than the slowest thing main legitimately does between
 * feeds, which is a TLS handshake, and comfortably shorter than the health
 * window, so a hang is caught during the trial rather than after it.
 *
 * Ten seconds was tried first and was too tight: a single poll opens four TLS
 * connections, and the device reset itself partway through the poll that would
 * have started an install. The window is not the only defence against that;
 * main also feeds around every exchange with the service. Both were needed. The research behind this tier could not pin down exactly how
 * the driver's second stage relates to its first, so the reset lands somewhere
 * between one and two times this value. That is enough to size a window
 * against the 60 second gate and not enough to quote a deadline, so no course
 * text quotes one.
 */
#define WDT_WINDOW_MS 20000

int health_gate_start_watchdog(void)
{
	struct wdt_timeout_cfg cfg = {
		.window.min = 0U,
		.window.max = WDT_WINDOW_MS,
		.callback = NULL,
		.flags = WDT_FLAG_RESET_SOC,
	};
	int err;

	if (wdt == NULL || !device_is_ready(wdt)) {
		printk("health.watchdog no watchdog device, a hung trial image would hang forever\n");
		return -ENODEV;
	}

	wdt_channel = wdt_install_timeout(wdt, &cfg);
	if (wdt_channel < 0) {
		printk("health.watchdog install failed err=%d\n", wdt_channel);
		return wdt_channel;
	}

	/* WDT_OPT_PAUSE_HALTED_BY_DBG keeps a paused debugger from resetting the
	 * board out from under whoever is reading it.
	 */
	err = wdt_setup(wdt, WDT_OPT_PAUSE_HALTED_BY_DBG);
	if (err != 0) {
		printk("health.watchdog setup failed err=%d\n", err);
		return err;
	}

	printk("health.watchdog armed at %d ms on channel %d\n", WDT_WINDOW_MS, wdt_channel);
	printk("health.watchdog Only the thread doing the work feeds it, never a timer. A feed on\n");
	printk("health.watchdog a timer would keep running while the thread it vouches for was\n");
	printk("health.watchdog dead, and the watchdog would be guarding nothing.\n");
	return 0;
}

void health_gate_note_beacon(void)
{
	atomic_inc(&beacon_ticks);
}

void health_gate_feed(void)
{
	if (wdt != NULL && wdt_channel >= 0) {
		(void)wdt_feed(wdt, wdt_channel);
	}
}

/* Check 1: the running image is one the bootloader was able to describe.
 *
 * MCUboot verified this image's signature before it ran, which is the check
 * that matters and is not one the application can repeat: the application is
 * the thing that would have to be trusted to repeat it. What the application
 * can establish is that it can read its own slot's header back and that the
 * header describes an image, which catches a primary slot that is not what
 * anybody thinks it is.
 *
 * The module text says exactly this. A check that overstated itself here would
 * teach a Learner to believe an application's word about its own integrity,
 * which is the habit the whole course is written against.
 */
static bool check_image_integrity(void)
{
	struct mcuboot_img_header header;
	int err;

	err = boot_read_bank_header(PARTITION_ID(slot0_partition), &header,
				    sizeof(header));
	if (err != 0) {
		printk("health.check the primary slot header is unreadable err=%d\n", err);
		return false;
	}
	return header.h.v1.image_size > 0U;
}

/* Check 2: the material this image needs in order to trust anything is
 * present.
 *
 * Both are compiled in, so this cannot fail on a correctly built image. It can
 * and does fail on one built without the Course certificate authority or
 * without the Release manifest verification key, which the build allows on
 * purpose so the repository still builds standalone. An image that trusts
 * nothing is the right failure, and a health gate that let it confirm anyway
 * would be the wrong one.
 */
static bool check_credentials_loaded(void)
{
	return ota_client_has_trust_anchor() && release_policy_has_key();
}

/* Check 3: the reference product is doing its job.
 *
 * This is section 6's "reference-product state handling". For a status beacon
 * the product state is the beacon producing status; there is no second thing
 * it can mean for this product.
 *
 * It is the only check that must keep holding for the whole window, which is
 * what makes the window a gate rather than a delay.
 */
static bool check_beacon_running(void)
{
	/* At boot the question is whether the beacon has run at all, not
	 * whether it has run twice.
	 *
	 * Comparing against a previous sample here was a race: the gate starts
	 * within milliseconds of the beacon thread, so the first sample was
	 * usually taken before the first tick and read as "not advancing". It
	 * failed the healthy image as readily as a broken one, which would have
	 * looked exactly like the health gate doing its job.
	 */
	return atomic_get(&beacon_ticks) > 0;
}

/* Whether the beacon has advanced since the last time this was asked.
 *
 * This is the question that belongs inside the window, and it is a different
 * question from the one above. A beacon that ticked once at boot and then
 * stopped passes the boot check and fails this one, which is exactly the
 * timeout-health release.
 */
static bool check_beacon_advancing(void)
{
	static atomic_val_t last;
	atomic_val_t now = atomic_get(&beacon_ticks);
	bool advanced = now != last;

	last = now;
	return advanced;
}

/* Check 4: the update client came up.
 *
 * Deliberately scoped to the client having initialised, never to it having
 * reached the service. Section 6 forbids loss of network service alone from
 * failing this gate, and this is the check that would otherwise violate it: an
 * "is the service reachable" check here would turn every network outage into a
 * revert, which is the endless loop the specification names by name.
 */
static bool check_update_client_ready(void)
{
#ifdef CONFIG_COURSE_TRIAL_FAIL_HEALTH
	/* The fail-health release fails exactly one named check while the other
	 * three visibly pass, so a Learner reads the cause instead of inferring
	 * it from where the output stopped.
	 *
	 * It fails at boot, before the window opens, which is what separates it
	 * from timeout-health: that release passes every check and then lets the
	 * window expire.
	 */
	printk("health.check update-client-ready is failed deliberately by this build\n");
	return false;
#else
	return ota_client_ready();
#endif
}

struct health_check {
	const char *name;
	bool (*run)(void);
	bool holds_for_window;
};

static const struct health_check checks[] = {
	{"image-integrity", check_image_integrity, false},
	{"credentials-loaded", check_credentials_loaded, false},
	{"beacon-running", check_beacon_running, false},
	{"update-client-ready", check_update_client_ready, false},
};

/* The one check that has to keep being true for the whole window, which is
 * what makes the window a gate rather than a delay.
 */
static const struct health_check window_check = {
	"beacon-advancing", check_beacon_advancing, true,
};

enum health_result health_gate_run(char *reason, size_t reason_len)
{
	bool failed = false;
	const char *first_failure = NULL;
	int64_t deadline;

	if (reason_len > 0U) {
		reason[0] = '\0';
	}

	/* Give the beacon thread a moment to produce its first tick before the
	 * beacon-running check asks whether it has. Without this the gate races
	 * the thread it is judging.
	 */
	for (int waited = 0; waited < 3 && atomic_get(&beacon_ticks) == 0; waited++) {
		k_sleep(K_SECONDS(1));
	}

	printk("health.gate running %zu local checks, then a %d second window\n",
	       ARRAY_SIZE(checks), CONFIG_COURSE_HEALTH_GATE_SECONDS);
	printk("health.gate no check asks whether the service is reachable. Section 6 forbids\n");
	printk("health.gate network loss alone from failing this gate.\n");

	/* Every check runs. Stopping at the first failure would hide which of
	 * the others were fine, and the fail-health release is only legible
	 * because three checks visibly pass beside the one that does not.
	 */
	for (size_t i = 0; i < ARRAY_SIZE(checks); i++) {
		bool ok = checks[i].run();

		printk("health.check %-20s %s\n", checks[i].name, ok ? "pass" : "FAIL");
		if (!ok && !failed) {
			failed = true;
			first_failure = checks[i].name;
		}
	}

	if (failed) {
		if (reason_len > 0U) {
			strncpy(reason, first_failure, reason_len - 1);
			reason[reason_len - 1] = '\0';
		}
		printk("health.gate refused by %s before the window started\n", first_failure);
		return HEALTH_FAILED;
	}

	/* The window is timed from here, the end of the boot checks, rather than
	 * from boot. Starting it at boot would let a slow boot eat the window
	 * and make the gate's length depend on something it is not measuring.
	 */
	printk("health.gate every check passed, holding for %d seconds\n",
	       CONFIG_COURSE_HEALTH_GATE_SECONDS);

	deadline = k_uptime_get() + (int64_t)CONFIG_COURSE_HEALTH_GATE_SECONDS * 1000;
	while (k_uptime_get() < deadline) {
		k_sleep(K_SECONDS(5));
		health_gate_feed();

		{
			if (!window_check.run()) {
				int64_t left = (deadline - k_uptime_get()) / 1000;

				printk("health.check %-20s FAIL with %lld seconds left\n",
				       window_check.name, (long long)left);
				if (reason_len > 0U) {
					strncpy(reason, window_check.name, reason_len - 1);
					reason[reason_len - 1] = '\0';
				}
				/* This is the window's failure rather than a
				 * boot check's, which is the distinction
				 * section 6 draws between a failed check and an
				 * expired health timer. The timeout-health
				 * release reaches this line and the fail-health
				 * one does not.
				 *
				 * The wording says what happened rather than
				 * claiming the timer ran out. It did not: the
				 * gate gives up the moment the beacon stops,
				 * because waiting out the remaining seconds
				 * would delay the revert without learning
				 * anything.
				 */
				printk("health.gate the window did not complete: the beacon stopped\n");
				return HEALTH_TIMEOUT;
			}
		}
		printk("health.gate holding, %lld seconds left\n",
		       (long long)((deadline - k_uptime_get()) / 1000));
	}

	printk("health.gate passed\n");
	return HEALTH_PASSED;
}
```

## src/identity.h
```c
/*
 * Tier 6 device identity.
 *
 * Two identity models live behind this interface, selected by the Kconfig
 * choice in Kconfig. The shared model carries one key compiled into every
 * image; the factory model generates a key on the device and never lets the
 * private half leave. Everything above this header asks the same questions of
 * both, which is what makes the two builds comparable.
 */

#ifndef COURSE_IDENTITY_H
#define COURSE_IDENTITY_H

#include <stddef.h>
#include <stdbool.h>

/* The longest device identifier the course issues, plus a terminator. */
#define COURSE_DEVICE_ID_MAX 64

/*
 * Bring up the identity subsystem.
 *
 * For the factory build this mounts settings, which is also what the PSA
 * Secure Storage ITS store writes through, and loads any certificate already
 * held. It reports success even when the device is unprovisioned: having no
 * identity is a state, not a failure.
 */
int course_identity_init(void);

/* Whether this device holds a usable identity. */
bool course_identity_is_provisioned(void);

/*
 * The identifier this device reports.
 *
 * For the factory build it is read out of the subject of the stored Factory
 * certificate, so the certificate is the one source of truth and the device
 * cannot report a name it cannot prove. For the shared build it is the
 * compiled-in name that every image shares.
 *
 * Returns NULL when the device is unprovisioned. A caller that treats NULL as
 * "use the old shared name" has reintroduced the fallback section 11 forbids,
 * so every caller is expected to handle it as a refusal to speak.
 */
const char *course_identity_device_id(void);

/* Fingerprint of the identity's certificate, for the boot banner. */
const char *course_identity_fingerprint(void);

#ifdef CONFIG_COURSE_IDENTITY_FACTORY

/*
 * Generate the device key, if there is not one already.
 *
 * The key is marked non-exportable at the PSA boundary. That marking is real
 * and it is not a boundary against a flash attacker: see
 * course_identity_try_export(), which exists so a Learner can watch both
 * halves of that sentence being true at once.
 */
int course_identity_generate_key(void);

/*
 * Build a certification request for the device key, carrying the Bootstrap
 * credential inside the signed structure.
 *
 * The credential goes inside rather than beside it so that it is covered by
 * the request's own self-signature and cannot be lifted onto another key.
 */
int course_identity_build_csr(const char *credential, unsigned char *out,
			      size_t out_size, size_t *out_len);

/* Store a Factory certificate issued by the provisioning station. */
int course_identity_store_certificate(const unsigned char *der, size_t len);

/*
 * Ask the course API to hand over the device private key.
 *
 * This always fails, and it is here to be run rather than to be useful. It is
 * evidence row E-6-04, and it is read beside E-6-05, which reads the same key
 * out of a flash dump and succeeds.
 */
int course_identity_try_export(void);

/*
 * Erase the identity, for remanufacturing.
 *
 * Two places, because the key lives in Secure Storage and the certificate does
 * not. Erasing one and not the other leaves a certificate for a key that no
 * longer exists, which is why this is one call rather than two.
 */
int course_identity_erase(void);

#endif /* CONFIG_COURSE_IDENTITY_FACTORY */

#ifdef CONFIG_COURSE_IDENTITY_SHARED

/*
 * The fleet certificate this image carries, for the station to check the nonce
 * signature against.
 *
 * Every image built in this variant returns the same bytes, which is the whole
 * argument of the tier.
 */
int course_shared_certificate(const unsigned char **der, size_t *len);

/*
 * Sign a station nonce with the compiled-in fleet key.
 *
 * This is a real proof of possession and it is not weaker than the one the
 * factory build performs. It is the same question, asked of a key every device
 * in the fleet already knows the answer to.
 *
 * The signature comes back as the ASN.1 sequence the station's verifier
 * expects, not as the raw r||s pair PSA produces.
 */
int course_shared_sign_nonce(const unsigned char *nonce, size_t nonce_len,
			     unsigned char *out, size_t out_size, size_t *out_len);

#endif /* CONFIG_COURSE_IDENTITY_SHARED */

/*
 * Decide whether the provisioning interface runs at all, and start it if so.
 *
 * Open when the device holds no identity, or when the BOOT button is held at
 * reset. Closed otherwise, and closed again the moment enrollment succeeds.
 */
void course_identity_gate(void);

#endif /* COURSE_IDENTITY_H */
```
