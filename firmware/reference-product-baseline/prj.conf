## CMakeLists.txt
```
# SPDX-License-Identifier: Apache-2.0

cmake_minimum_required(VERSION 3.20.0)

# The shared beacon and Wi-Fi code. Every tier pulls in the same module, so a
# fix there reaches every tier instead of needing nine copies.
list(APPEND EXTRA_ZEPHYR_MODULES ${CMAKE_CURRENT_SOURCE_DIR}/../common)

find_package(Zephyr REQUIRED HINTS $ENV{ZEPHYR_BASE})
project(reference_product_baseline)

test_sysbuild()

target_sources(app PRIVATE
	src/main.c
	src/ota_client.c
)
```

## Kconfig
```
# Tier 0 adds no configuration of its own.
#
# Everything the Tier 0 Reference product reads lives in firmware/common, which
# every tier shares. Tier 2 is the first tier to declare options here.

source "Kconfig.zephyr"
```

## sysbuild.conf
```
SB_CONFIG_BOOTLOADER_MCUBOOT=y
SB_CONFIG_BOOT_SIGNATURE_TYPE_NONE=y

# The course uses swap-using-offset in every tier.
#
# MCUboot copies the candidate from the secondary slot into the primary slot
# one sector at a time and keeps the displaced image, so a fallback path
# physically exists from Tier 0 onward. No tier before Tier 5 uses it: the
# application asks for a permanent upgrade, which makes the swap final as soon
# as it completes. Tier 5 is where the device learns to boot a candidate on
# trial and go back.
#
# The mode needs no scratch area. The scratch partition stays defined and
# unused in dts/esp32c6_4m_flash_map.dtsi so the pinned flash map does not move.
#
# The mode is selected here explicitly rather than left to the default that
# follows from an absent scratch node. A control that depends on a default is a
# control nobody can see.
#
# An earlier version of this file said swap modes hung on this board. They did,
# along with overwrite-only: the cause was esp_restart() leaving the BBPLL
# running so MCUboot hung configuring a PLL that was already on. The fix is
# course_reset_system() in src/main.c. See docs/esp32c6-build-baseline.md.
SB_CONFIG_MCUBOOT_MODE_SWAP_USING_OFFSET=y
```

## prj.conf
```kconfig
CONFIG_PRINTK=y
CONFIG_ESPTOOLPY_FLASHSIZE_4MB=y
CONFIG_MAIN_STACK_SIZE=8192
CONFIG_REBOOT=y

# Wi-Fi station and IPv4. Tier 0 speaks plain HTTP to one literal address, so
# it needs no name resolution and no TLS.
CONFIG_NETWORKING=y
CONFIG_WIFI=y
CONFIG_NET_IPV4=y
CONFIG_NET_IPV6=n
CONFIG_NET_DHCPV4=y
CONFIG_NET_TCP=y
CONFIG_NET_SOCKETS=y
CONFIG_NET_MGMT=y
CONFIG_NET_MGMT_EVENT=y
CONFIG_NET_MGMT_EVENT_INFO=y
CONFIG_NET_MGMT_EVENT_STACK_SIZE=4096
CONFIG_ESP32_WIFI_STA_AUTO_DHCPV4=y

CONFIG_NET_PKT_RX_COUNT=16
CONFIG_NET_PKT_TX_COUNT=16
CONFIG_NET_BUF_RX_COUNT=32
CONFIG_NET_BUF_TX_COUNT=32
CONFIG_NET_MAX_CONTEXTS=8

CONFIG_HTTP_CLIENT=y
CONFIG_JSON_LIBRARY=y

# Writing the downloaded image into the secondary slot and asking MCUboot to
# swap it in. Tier 0 deliberately adds no authenticity check here.
CONFIG_FLASH=y
CONFIG_FLASH_MAP=y
CONFIG_STREAM_FLASH=y
CONFIG_IMG_MANAGER=y
CONFIG_IMG_ERASE_PROGRESSIVELY=y
CONFIG_MCUBOOT_IMG_MANAGER=y

# The course network may publish the same name on 2.4 GHz and 5 GHz. Scanning
# every channel makes the board pick the 2.4 GHz radio it can actually use.
CONFIG_ESP32_WIFI_STA_SCAN_ALL=y
CONFIG_ESP32_WIFI_STA_RECONNECT=y

# The onboard status beacon. The DevKitC-1 shows the machine state on its
# WS2812 RGB LED as well as on the console; CONFIG_COURSE_BEACON_LED in
# firmware/common turns that off again for a board that has no such LED.
CONFIG_LED_STRIP=y
```

## boards/esp32c6_devkitc_esp32c6_hpcore.overlay
```dts
#include "../dts/esp32c6_4m_flash_map.dtsi"
```

## src/main.c
```c
#include <course/beacon.h>
#include <course/net_link.h>
#include "ota_client.h"

#include <string.h>
#include <zephyr/devicetree.h>
#include <zephyr/kernel.h>
#include <zephyr/net/net_ip.h>
#include <zephyr/sys/util.h>

#include <esp_rom_sys.h>

#define ASSERT_PARTITION(node, expected_offset, expected_size) \
	BUILD_ASSERT(DT_REG_ADDR(DT_NODELABEL(node)) == (expected_offset)); \
	BUILD_ASSERT(DT_REG_SIZE(DT_NODELABEL(node)) == (expected_size))

BUILD_ASSERT(DT_REG_SIZE(DT_NODELABEL(flash0)) == 0x400000);
ASSERT_PARTITION(boot_partition, 0x000000, 0x010000);
ASSERT_PARTITION(sys_partition, 0x010000, 0x010000);
ASSERT_PARTITION(slot0_partition, 0x020000, 0x1c0000);
ASSERT_PARTITION(slot1_partition, 0x1e0000, 0x1c0000);
ASSERT_PARTITION(slot0_lpcore_partition, 0x3a0000, 0x008000);
ASSERT_PARTITION(slot1_lpcore_partition, 0x3a8000, 0x008000);
ASSERT_PARTITION(storage_partition, 0x3b0000, 0x030000);
ASSERT_PARTITION(scratch_partition, 0x3e0000, 0x01f000);
ASSERT_PARTITION(coredump_partition, 0x3ff000, 0x001000);

static void announce(enum beacon_state state)
{
	printk("ESP32-C6 Reference product: intentionally unsecured Tier 0\n");
	printk("Image label: %s\n", CONFIG_COURSE_IMAGE_LABEL);
	printk("Running release: %s\n", CONFIG_COURSE_RELEASE_ID);
	printk("Board: %s\n", CONFIG_BOARD_TARGET);
	printk("Tier 0 boot mode: unsigned MCUboot, swap using offset, no test boot, no rollback\n");
	printk("Synthetic shared device identifier: %s\n", CONFIG_COURSE_DEVICE_ID);
	printk("OTA service: http://%s:%d\n", CONFIG_COURSE_OTA_HOST, CONFIG_COURSE_OTA_PORT);
	printk("Beacon state: %s, toggle period: %u ms\n",
	       beacon_state_name(state), beacon_toggle_period_ms(state));
	printk("Hardware note: %s\n", beacon_led_note());
}

/* Restart the whole chip, not only the processor.
 *
 * Zephyr's sys_reboot() ends in esp_restart(), which resets the processor but
 * deliberately leaves the BBPLL running so the ROM can keep logging. MCUboot
 * then tries to configure a PLL that is already on, and hangs inside its clock
 * setup before it reaches any of its own code. An update installed that way
 * never starts, and the board only recovers by a manual reset.
 *
 * The ROM's system reset returns the clocks to their power-on state, so
 * MCUboot starts exactly as it does after a power cycle.
 */
static void course_reset_system(void)
{
	esp_rom_software_reset_system();

	/* The reset is immediate. This loop only satisfies the compiler. */
	while (true) {
		k_sleep(K_FOREVER);
	}
}

/* One poll: report status, read the assignment, and install it when it names
 * a different release. Returns true when the device should reboot into a
 * freshly installed image.
 */
static bool poll_once(enum beacon_state state)
{
	struct ota_release release;
	const char *state_name = beacon_state_name(state);

	/* A rejected status report must not stop the update check: the two
	 * exchanges are independent, and Tier 0 gates neither on the other.
	 */
	(void)ota_client_report("status.observed", state_name, CONFIG_COURSE_RELEASE_ID,
				"plaintext HTTP, shared identifier");

	if (ota_client_fetch_assignment(&release) != 0) {
		return false;
	}

	printk("ota.assignment release_id=%s version=%s image=%s\n",
	       release.release_id, release.version, release.image_path);

	if (!ota_release_differs(&release)) {
		printk("ota.assignment matches the running release, nothing to install\n");
		return false;
	}

	printk("ota.assignment differs from running release %s, installing without any check\n",
	       CONFIG_COURSE_RELEASE_ID);

	if (ota_client_install(&release) != 0) {
		(void)ota_client_report("update.failed", state_name,
					CONFIG_COURSE_RELEASE_ID, release.release_id);
		return false;
	}

	(void)ota_client_report("update.installed", state_name, CONFIG_COURSE_RELEASE_ID,
				release.release_id);
	return true;
}

int main(void)
{
	enum beacon_state state = beacon_configured_state();
	char address[NET_IPV4_ADDR_LEN];

	/* Before the banner, so the banner's hardware note can report whether
	 * the LED really started rather than whether it was asked to.
	 */
	beacon_led_start(state);
	announce(state);

	if (net_link_connect() != 0) {
		printk("Offline mode: no OTA exchange is possible\n");
		printk("Hardware note: Wi-Fi, HTTP transfer, and OTA install remain unobserved\n");
		while (true) {
			k_sleep(K_SECONDS(CONFIG_COURSE_POLL_INTERVAL_SECONDS));
			printk("status.offline device_id=%s machine_state=%s\n",
			       CONFIG_COURSE_DEVICE_ID, beacon_state_name(state));
		}
	}

	if (net_link_address(address, sizeof(address)) == 0) {
		printk("wifi.address %s assigned by DHCP\n", address);
	}

	while (true) {
		if (poll_once(state)) {
			printk("Rebooting into the newly installed image\n");
			k_sleep(K_MSEC(200));
			course_reset_system();
		}
		k_sleep(K_SECONDS(CONFIG_COURSE_POLL_INTERVAL_SECONDS));
	}
}
```

## src/beacon.c
```c
#include "beacon.h"

#include <string.h>
#include <zephyr/kernel.h>

enum beacon_state beacon_configured_state(void)
{
	const char *configured = CONFIG_COURSE_BEACON_STATE;

	if (strcmp(configured, "fast") == 0) {
		return BEACON_FAST_BLINK;
	}
	if (strcmp(configured, "slow") == 0) {
		return BEACON_SLOW_BLINK;
	}
	return BEACON_STEADY;
}

const char *beacon_state_name(enum beacon_state state)
{
	switch (state) {
	case BEACON_STEADY:
		return "steady";
	case BEACON_FAST_BLINK:
		return "fast";
	case BEACON_SLOW_BLINK:
		return "slow";
	default:
		return "unknown";
	}
}

uint32_t beacon_toggle_period_ms(enum beacon_state state)
{
	switch (state) {
	case BEACON_FAST_BLINK:
		return 200;
	case BEACON_SLOW_BLINK:
		return 1000;
	case BEACON_STEADY:
	default:
		return 0;
	}
}
```

## src/beacon.h
```c
/*
 * The simulated machine state that the Reference product shows.
 *
 * The nanoESP32-C6 1.0 board wires its onboard LED to the 3V3 rail, so the
 * LED cannot be driven on this hardware (see docs/esp32c6-build-baseline.md).
 * The state is therefore reported on the serial console instead.
 */

#ifndef COURSE_BEACON_H
#define COURSE_BEACON_H

#include <stdint.h>

enum beacon_state {
	BEACON_STEADY,
	BEACON_FAST_BLINK,
	BEACON_SLOW_BLINK,
};

/* Returns the state named by CONFIG_COURSE_BEACON_STATE, or BEACON_STEADY
 * when the configured name is not one of steady, fast, or slow.
 */
enum beacon_state beacon_configured_state(void);

const char *beacon_state_name(enum beacon_state state);

/* Milliseconds between LED transitions; 0 means the LED stays on. */
uint32_t beacon_toggle_period_ms(enum beacon_state state);

#endif /* COURSE_BEACON_H */
```

## src/net_link.c
```c
#include "net_link.h"

#include <string.h>
#include <zephyr/kernel.h>
#include <zephyr/net/net_if.h>
#include <zephyr/net/net_ip.h>
#include <zephyr/net/net_mgmt.h>
#include <zephyr/net/wifi.h>
#include <zephyr/net/wifi_mgmt.h>

#define LINK_EVENTS (NET_EVENT_IPV4_ADDR_ADD)
#define WIFI_EVENTS (NET_EVENT_WIFI_CONNECT_RESULT | NET_EVENT_WIFI_DISCONNECT_RESULT)

static K_SEM_DEFINE(address_ready, 0, 1);

static struct net_mgmt_event_callback link_callback;
static struct net_mgmt_event_callback wifi_callback;

static void on_link_event(struct net_mgmt_event_callback *cb, uint64_t event,
			  struct net_if *iface)
{
	ARG_UNUSED(cb);
	ARG_UNUSED(iface);

	if (event == NET_EVENT_IPV4_ADDR_ADD) {
		k_sem_give(&address_ready);
	}
}

static void on_wifi_event(struct net_mgmt_event_callback *cb, uint64_t event,
			  struct net_if *iface)
{
	const struct wifi_status *status = (const struct wifi_status *)cb->info;

	ARG_UNUSED(iface);

	switch (event) {
	case NET_EVENT_WIFI_CONNECT_RESULT:
		if (status->status != 0) {
			printk("wifi.association failed status=%d\n", status->status);
		} else {
			printk("wifi.association succeeded ssid=%s\n", CONFIG_COURSE_WIFI_SSID);
		}
		break;
	case NET_EVENT_WIFI_DISCONNECT_RESULT:
		printk("wifi.disconnected status=%d\n", status->status);
		break;
	default:
		break;
	}
}

int net_link_connect(void)
{
	struct net_if *iface = net_if_get_first_wifi();
	struct wifi_connect_req_params params = {0};
	int err;

	if (iface == NULL) {
		printk("wifi.unavailable no Wi-Fi interface is present\n");
		return -ENOTSUP;
	}
	if (strlen(CONFIG_COURSE_WIFI_SSID) == 0) {
		printk("wifi.unconfigured run ./course setup --wifi-ssid <name> --wifi-psk <passphrase>\n");
		return -EINVAL;
	}

	net_mgmt_init_event_callback(&link_callback, on_link_event, LINK_EVENTS);
	net_mgmt_add_event_callback(&link_callback);
	net_mgmt_init_event_callback(&wifi_callback, on_wifi_event, WIFI_EVENTS);
	net_mgmt_add_event_callback(&wifi_callback);

	params.ssid = (const uint8_t *)CONFIG_COURSE_WIFI_SSID;
	params.ssid_length = strlen(CONFIG_COURSE_WIFI_SSID);
	params.psk = (const uint8_t *)CONFIG_COURSE_WIFI_PSK;
	params.psk_length = strlen(CONFIG_COURSE_WIFI_PSK);
	params.security = WIFI_SECURITY_TYPE_PSK;
	params.channel = WIFI_CHANNEL_ANY;
	params.band = WIFI_FREQ_BAND_2_4_GHZ;
	params.mfp = WIFI_MFP_OPTIONAL;
	params.timeout = CONFIG_COURSE_WIFI_CONNECT_TIMEOUT_SECONDS;

	printk("wifi.connecting ssid=%s security=wpa2-psk band=2.4GHz\n", CONFIG_COURSE_WIFI_SSID);

	err = net_mgmt(NET_REQUEST_WIFI_CONNECT, iface, &params, sizeof(params));
	if (err != 0) {
		printk("wifi.request failed err=%d\n", err);
		return err;
	}

	if (k_sem_take(&address_ready,
		       K_SECONDS(CONFIG_COURSE_WIFI_CONNECT_TIMEOUT_SECONDS)) != 0) {
		printk("wifi.address timed out after %d seconds\n",
		       CONFIG_COURSE_WIFI_CONNECT_TIMEOUT_SECONDS);
		return -ETIMEDOUT;
	}

	return 0;
}

int net_link_address(char *buf, size_t len)
{
	struct net_if *iface = net_if_get_first_wifi();
	struct net_if_ipv4 *ipv4;

	if (iface == NULL || iface->config.ip.ipv4 == NULL) {
		return -ENOTSUP;
	}
	ipv4 = iface->config.ip.ipv4;

	ARRAY_FOR_EACH(ipv4->unicast, i) {
		if (!ipv4->unicast[i].ipv4.is_used ||
		    ipv4->unicast[i].ipv4.addr_type != NET_ADDR_DHCP) {
			continue;
		}
		if (net_addr_ntop(AF_INET, &ipv4->unicast[i].ipv4.address.in_addr,
				  buf, len) == NULL) {
			return -EINVAL;
		}
		return 0;
	}
	return -ENOENT;
}
```

## src/net_link.h
```c
/*
 * Joining the local course Wi-Fi network.
 *
 * Tier 0 joins one WPA2 network with a passphrase compiled into the image and
 * takes its address from DHCP. It does not check what network it joined, and
 * it keeps no state across a reboot.
 */

#ifndef COURSE_NET_LINK_H
#define COURSE_NET_LINK_H

#include <stddef.h>

/* Joins the configured network and waits for a DHCP address.
 *
 * Returns 0 once an IPv4 address is assigned, -ENOTSUP when no Wi-Fi
 * interface exists, -EINVAL when no network is configured, and -ETIMEDOUT
 * when no address arrives within CONFIG_COURSE_WIFI_CONNECT_TIMEOUT_SECONDS.
 */
int net_link_connect(void);

/* Writes the current IPv4 address into buf. Returns 0 on success. */
int net_link_address(char *buf, size_t len);

#endif /* COURSE_NET_LINK_H */
```

## src/ota_client.c
```c
#include "ota_client.h"

#include <stdio.h>
#include <string.h>
#include <zephyr/data/json.h>
#include <zephyr/dfu/flash_img.h>
#include <zephyr/dfu/mcuboot.h>
#include <zephyr/kernel.h>
#include <zephyr/net/http/client.h>
#include <zephyr/net/socket.h>

#define OTA_REQUEST_TIMEOUT_MS 15000
#define OTA_DOWNLOAD_TIMEOUT_MS 120000
#define OTA_RECV_BUF_SIZE 1024
#define OTA_BODY_BUF_SIZE 768
#define OTA_EVENT_PATH "/v1/devices/" CONFIG_COURSE_DEVICE_ID "/events"

static uint8_t recv_buf[OTA_RECV_BUF_SIZE];

/* The JSON parser stores each string as a pointer into the response buffer,
 * so parsing needs its own struct of pointers. The values are copied into the
 * caller's fixed-size record before that buffer goes out of scope.
 *
 * Only the fields Tier 0 acts on appear here. json_obj_parse skips the rest of
 * the release record, so adding fields to the service does not break the
 * device.
 */
struct release_json {
	const char *release_id;
	const char *version;
	const char *image_path;
	const char *image_sha256;
	int image_size;
};

static const struct json_obj_descr release_descr[] = {
	JSON_OBJ_DESCR_PRIM(struct release_json, release_id, JSON_TOK_STRING),
	JSON_OBJ_DESCR_PRIM(struct release_json, version, JSON_TOK_STRING),
	JSON_OBJ_DESCR_PRIM(struct release_json, image_path, JSON_TOK_STRING),
	JSON_OBJ_DESCR_PRIM(struct release_json, image_sha256, JSON_TOK_STRING),
	JSON_OBJ_DESCR_PRIM(struct release_json, image_size, JSON_TOK_NUMBER),
};

static void copy_field(char *target, size_t len, const char *value)
{
	if (value == NULL) {
		target[0] = '\0';
		return;
	}
	strncpy(target, value, len - 1);
	target[len - 1] = '\0';
}

struct body_capture {
	char *buf;
	size_t len;
	size_t used;
};

struct status_capture {
	int code;
};

struct image_writer {
	struct flash_img_context ctx;
	size_t written;
	int err;
};

static int ota_connect(void)
{
	struct sockaddr_in addr = {
		.sin_family = AF_INET,
		.sin_port = htons(CONFIG_COURSE_OTA_PORT),
	};
	int sock;

	if (net_addr_pton(AF_INET, CONFIG_COURSE_OTA_HOST, &addr.sin_addr) != 0) {
		printk("ota.target invalid address %s\n", CONFIG_COURSE_OTA_HOST);
		return -EINVAL;
	}

	sock = zsock_socket(AF_INET, SOCK_STREAM, IPPROTO_TCP);
	if (sock < 0) {
		printk("ota.socket failed errno=%d\n", errno);
		return -errno;
	}
	if (zsock_connect(sock, (struct sockaddr *)&addr, sizeof(addr)) < 0) {
		printk("ota.connect failed host=%s port=%d errno=%d\n",
		       CONFIG_COURSE_OTA_HOST, CONFIG_COURSE_OTA_PORT, errno);
		zsock_close(sock);
		return -errno;
	}
	return sock;
}

static int capture_body(struct http_response *rsp, enum http_final_call final,
			void *user_data)
{
	struct body_capture *capture = user_data;
	size_t room;

	ARG_UNUSED(final);

	if (rsp->body_frag_len == 0) {
		return 0;
	}
	room = capture->len - capture->used - 1;
	if (rsp->body_frag_len < room) {
		room = rsp->body_frag_len;
	}
	memcpy(capture->buf + capture->used, rsp->body_frag_start, room);
	capture->used += room;
	capture->buf[capture->used] = '\0';
	return 0;
}

/* http_client_req refuses a request with no response callback, so even a
 * fire-and-forget POST needs one. This records the status line so the caller
 * can tell a rejected report from a delivered one.
 */
static int capture_status(struct http_response *rsp, enum http_final_call final,
			  void *user_data)
{
	struct status_capture *capture = user_data;

	ARG_UNUSED(final);

	if (capture != NULL) {
		capture->code = rsp->http_status_code;
	}
	return 0;
}

static int write_image(struct http_response *rsp, enum http_final_call final,
		       void *user_data)
{
	struct image_writer *writer = user_data;

	if (writer->err != 0) {
		return writer->err;
	}
	if (rsp->body_frag_len > 0) {
		writer->err = flash_img_buffered_write(&writer->ctx,
						       rsp->body_frag_start,
						       rsp->body_frag_len, false);
		if (writer->err != 0) {
			printk("ota.write failed offset=%zu err=%d\n",
			       writer->written, writer->err);
			return writer->err;
		}
		writer->written += rsp->body_frag_len;
	}
	if (final == HTTP_DATA_FINAL) {
		writer->err = flash_img_buffered_write(&writer->ctx, NULL, 0, true);
		if (writer->err != 0) {
			printk("ota.flush failed err=%d\n", writer->err);
			return writer->err;
		}
	}
	return 0;
}

static int run_request(struct http_request *req, int32_t timeout_ms, void *user_data)
{
	int sock = ota_connect();
	int err;

	if (sock < 0) {
		return sock;
	}
	req->host = CONFIG_COURSE_OTA_HOST;
	req->protocol = "HTTP/1.1";
	req->recv_buf = recv_buf;
	req->recv_buf_len = sizeof(recv_buf);

	err = http_client_req(sock, req, timeout_ms, user_data);
	zsock_close(sock);

	if (err < 0) {
		printk("ota.request failed url=%s err=%d\n", req->url, err);
		return err;
	}
	return 0;
}

int ota_client_fetch_assignment(struct ota_release *release)
{
	char body[OTA_BODY_BUF_SIZE];
	struct body_capture capture = {.buf = body, .len = sizeof(body)};
	struct release_json parsed = {0};
	struct http_request req = {
		.method = HTTP_GET,
		.url = "/v1/releases/current",
		.response = capture_body,
	};
	int err;

	body[0] = '\0';
	err = run_request(&req, OTA_REQUEST_TIMEOUT_MS, &capture);
	if (err != 0) {
		return err;
	}
	if (capture.used == 0) {
		printk("ota.assignment empty response\n");
		return -ENODATA;
	}

	err = json_obj_parse(body, capture.used, release_descr,
			     ARRAY_SIZE(release_descr), &parsed);
	if (err < 0) {
		printk("ota.assignment unreadable err=%d\n", err);
		return err;
	}

	memset(release, 0, sizeof(*release));
	copy_field(release->release_id, sizeof(release->release_id), parsed.release_id);
	copy_field(release->version, sizeof(release->version), parsed.version);
	copy_field(release->image_path, sizeof(release->image_path), parsed.image_path);
	copy_field(release->image_sha256, sizeof(release->image_sha256), parsed.image_sha256);
	release->image_size = parsed.image_size;

	if (release->release_id[0] == '\0' || release->image_path[0] == '\0') {
		printk("ota.assignment missing release_id or image_path\n");
		return -EINVAL;
	}
	return 0;
}

int ota_client_report(const char *event, const char *machine_state,
		      const char *release_id, const char *detail)
{
	char payload[320];
	const char *headers[] = {"Content-Type: application/json\r\n", NULL};
	struct status_capture status = {0};
	struct http_request req = {
		.method = HTTP_POST,
		.url = OTA_EVENT_PATH,
		.header_fields = headers,
		.response = capture_status,
	};
	int len;
	int err;

	len = snprintf(payload, sizeof(payload),
		       "{\"device_id\":\"%s\",\"event\":\"%s\",\"machine_state\":\"%s\","
		       "\"running_release_id\":\"%s\",\"detail\":\"%s\","
		       "\"transport\":\"http\",\"synthetic_data\":true}",
		       CONFIG_COURSE_DEVICE_ID, event, machine_state, release_id,
		       detail == NULL ? "" : detail);
	if (len < 0 || len >= (int)sizeof(payload)) {
		return -ENOMEM;
	}
	req.payload = payload;
	req.payload_len = len;

	err = run_request(&req, OTA_REQUEST_TIMEOUT_MS, &status);
	if (err != 0) {
		return err;
	}
	if (status.code < 200 || status.code >= 300) {
		printk("ota.report rejected status=%d\n", status.code);
		return -EIO;
	}
	return 0;
}

bool ota_release_differs(const struct ota_release *release)
{
	return strcmp(release->release_id, CONFIG_COURSE_RELEASE_ID) != 0;
}

int ota_client_install(const struct ota_release *release)
{
	char url[OTA_FIELD_MAX + 16];
	struct image_writer writer = {0};
	struct http_request req = {
		.method = HTTP_GET,
		.response = write_image,
	};
	int err;

	if (snprintf(url, sizeof(url), "/v1/firmware/%s", release->image_path) >=
	    (int)sizeof(url)) {
		return -ENOMEM;
	}
	req.url = url;

	printk("ota.install starting release_id=%s version=%s size=%d\n",
	       release->release_id, release->version, release->image_size);
	printk("ota.install declared_sha256=%s (Tier 0 does not check it)\n",
	       release->image_sha256);

	err = flash_img_init(&writer.ctx);
	if (err != 0) {
		printk("ota.slot unavailable err=%d\n", err);
		return err;
	}

	err = run_request(&req, OTA_DOWNLOAD_TIMEOUT_MS, &writer);
	if (err != 0) {
		return err;
	}
	if (writer.err != 0) {
		return writer.err;
	}
	if (writer.written == 0) {
		printk("ota.install received no image bytes\n");
		return -ENODATA;
	}
	if (release->image_size > 0 && writer.written != (size_t)release->image_size) {
		printk("ota.install size mismatch declared=%d received=%zu\n",
		       release->image_size, writer.written);
		return -EMSGSIZE;
	}

	printk("ota.install wrote %zu bytes to the secondary slot\n", writer.written);

	err = boot_request_upgrade(BOOT_UPGRADE_PERMANENT);
	if (err != 0) {
		printk("ota.upgrade request failed err=%d\n", err);
		return err;
	}
	printk("ota.upgrade requested a permanent swap, no test boot, no rollback\n");
	return 0;
}
```

## src/ota_client.h
```c
/*
 * The Tier 0 OTA client.
 *
 * It asks the local OTA service which release it should run, reports its own
 * status, and installs whatever image the service hands back. Tier 0 checks
 * nothing about the service or the image: that absence is the point of the
 * tier, and the Weakness ledger records it as T0-W-03 and T0-W-04.
 */

#ifndef COURSE_OTA_CLIENT_H
#define COURSE_OTA_CLIENT_H

#include <stdbool.h>
#include <stddef.h>

#define OTA_FIELD_MAX 64
#define OTA_DIGEST_MAX 72

struct ota_release {
	char release_id[OTA_FIELD_MAX];
	char version[OTA_FIELD_MAX];
	char image_path[OTA_FIELD_MAX];
	char image_sha256[OTA_DIGEST_MAX];
	int image_size;
};

/* Reads the update assignment from GET /v1/releases/current. */
int ota_client_fetch_assignment(struct ota_release *release);

/* Posts one status event to POST /v1/devices/<id>/events.
 *
 * The body names this device with the compiled-in identifier. The service
 * trusts that name, which is weakness T0-W-02.
 */
int ota_client_report(const char *event, const char *machine_state,
		      const char *release_id, const char *detail);

/* Downloads the release image into the secondary slot and asks MCUboot to
 * swap it in permanently. Returns 0 when the device is ready to reboot.
 *
 * No signature, publisher, or digest check happens here. Tier 3 adds the
 * first one.
 */
int ota_client_install(const struct ota_release *release);

/* True when the service assigned a release other than the one built into
 * this image.
 */
bool ota_release_differs(const struct ota_release *release);

#endif /* COURSE_OTA_CLIENT_H */
```
