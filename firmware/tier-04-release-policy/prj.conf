## CMakeLists.txt
```
# SPDX-License-Identifier: Apache-2.0

cmake_minimum_required(VERSION 3.20.0)

list(APPEND EXTRA_ZEPHYR_MODULES ${CMAKE_CURRENT_SOURCE_DIR}/../common)

find_package(Zephyr REQUIRED HINTS $ENV{ZEPHYR_BASE})
project(tier_04_release_policy)

test_sysbuild()

# The trust anchor is compiled into the image, the same way the Wi-Fi
# credentials are. ./course build firmware writes course_ca_der.inc from the
# Course certificate authority in .course-secrets/, and passes the directory
# here.
#
# Without it the build falls back to anchor/, which holds an empty anchor. The
# repository then still builds standalone, and the resulting image refuses to
# connect and says why. An image that trusts nothing is the right failure: the
# alternative is an image that trusts anything.
# The directory arrives in the environment rather than as a CMake cache
# variable. Sysbuild keeps an image-scoped -D<image>_VAR in its own cache and
# does not forward an arbitrary one into the image build, so a cache variable
# silently produced an image with no anchor. The environment reaches every
# image's configure step.
if(DEFINED ENV{COURSE_CA_INC_DIR})
	zephyr_include_directories($ENV{COURSE_CA_INC_DIR})
else()
	zephyr_include_directories(anchor)
endif()

# The release manifest verification key arrives the same way, from
# ./course build firmware, which writes release_pubkey.inc from the public half
# of the Learner's Release signing key. It has its own variable because it is
# its own decision: the certificate authority says which service to talk to,
# and this key says whose release metadata to believe. Nothing about one
# implies the other.
#
# Without it the build falls back to anchor/, which holds no key, and the
# resulting image verifies no manifest and says so at boot and at every
# refusal. That is the same honest failure the empty trust anchor produces.
if(DEFINED ENV{COURSE_RELEASE_KEY_INC_DIR})
	zephyr_include_directories($ENV{COURSE_RELEASE_KEY_INC_DIR})
else()
	zephyr_include_directories(anchor)
endif()

target_sources(app PRIVATE
	src/main.c
	src/ota_client.c
	src/release_policy.c
)
```

## Kconfig
```
# Configuration Tier 4 adds on top of the shared options in firmware/common.
#
# The first block is inherited from Tier 2, which taught the device to verify
# the service it talks to. Tier 4 keeps every word of it: the manifest is
# fetched over that same verified connection, and a signed manifest does not
# make an unverified connection acceptable.

menu "Tier 2 authenticated service"

config COURSE_OTA_SERVICE_NAME
	string "Name the service certificate must carry"
	default "ota.course.example"
	help
	  The device connects to CONFIG_COURSE_OTA_HOST, a literal address, and
	  then requires the certificate presented there to carry this name.

	  The name is never resolved. There is no DNS resolver in this image.
	  It is the value the TLS layer compares the certificate against, which
	  is why a wrong name is refused even though the address was right.

config COURSE_OTA_TLS_PORT
	int "OTA service TLS port"
	default 8443
	help
	  Tier 2 moves release records, firmware bytes, and status events to
	  this port. Health and the Course environment marker stay on the plain
	  HTTP port, because a safety check must not depend on the control it
	  is used to test.

config COURSE_TRUST_ANCHOR_FINGERPRINT
	string "Fingerprint of the trust anchor compiled into this image"
	default "unknown"
	help
	  Printed at boot so a stale trust anchor diagnoses itself instead of
	  looking like a broken network. ./course build firmware writes this
	  value, and ./course service certificate prints the same one.

	  The device does not compute it. Computing a digest on the board to
	  describe material the board already holds would prove nothing that the
	  build cannot state.

endmenu

menu "Tier 4 release policy"

config COURSE_SECURITY_COUNTER
	int "Security counter of the running image"
	default 1
	help
	  The anti-rollback counter this image was signed with. The same value
	  goes into the signed MCUboot image TLV and into the signed Release
	  manifest, and ./course build firmware writes it from the one constant
	  in internal/courseapp/tier04.go so the two cannot disagree.

	  The application refuses a manifest whose counter is lower than this
	  one. Equal is allowed; lower never is. That check saves a wasted
	  download and is not the boundary: the bootloader is what actually
	  stops a downgrade, by comparing the candidate's counter against the
	  counter in the image already in the primary slot.

	  It is deliberately not derived from the human-readable version.
	  "Human-readable versions override the security counter" is the
	  failure this tier is about.

config COURSE_HARDWARE_REVISION
	int "Product hardware revision this build asserts"
	default 1
	help
	  The product hardware revision a release is targeted at, compared
	  against the manifest's signed hardware_revision_min..max range.

	  It is asserted, not read. The chip reports its silicon stepping from
	  eFuse and the boot banner prints that beside this value, but nothing
	  on this part reports which product a board was built into. Product
	  identity is asserted and protected; a value the device reads is not a
	  claim anybody signed.

config COURSE_RELEASE_CHANNEL
	string "Release channel this device follows"
	default "stable"
	help
	  One of stable or candidate. The device refuses a manifest published
	  to any other channel, even a correctly signed one.

	  This is the check that has no attacker behind it. Nobody without the
	  Release signing key can produce a manifest that gets this far, so a
	  channel mismatch means whoever holds the key published something for
	  the wrong devices. The device cannot tell that from a leaked key, and
	  refusing is the same either way.

endmenu

source "Kconfig.zephyr"

config COURSE_SIGNING_KEY_FINGERPRINT
	string "Fingerprint of the image verification key this image was built beside"
	default "unknown"
	help
	  Printed at boot so a Learner can see which key the build trusted, and
	  so a key regenerated after flashing diagnoses itself instead of looking
	  like a broken image.

	  Read the wording in main.c before changing this. The application cannot
	  see what the bootloader actually holds. This value comes from the same
	  build that produced the bootloader, so it is a claim about the build and
	  not an observation of the device. Verifying the bootloader itself is
	  Advanced Tier A's subject.

	  From Tier 4 the same fingerprint also describes the release manifest
	  verification key compiled into the application, because section 7 fixes
	  that one key signs both. Unlike the bootloader's copy, that one this
	  application does hold, and release_policy.c reports when it is absent.
```

## prj.conf
```kconfig
CONFIG_PRINTK=y
CONFIG_ESPTOOLPY_FLASHSIZE_4MB=y
CONFIG_MAIN_STACK_SIZE=8192
CONFIG_REBOOT=y

# Wi-Fi station and IPv4. Tier 2 speaks HTTPS to one literal address and checks
# the certificate against a name, so it still needs no name resolution. The
# name is compared, never looked up, and there is no resolver in this image.
#
# Tier 4 fetches two more objects over that same connection, the Release
# manifest and its detached signature. Verifying the manifest does not make an
# unverified connection acceptable, so nothing here is relaxed.
CONFIG_NETWORKING=y
CONFIG_WIFI=y
CONFIG_NET_IPV4=y
CONFIG_NET_IPV6=n
CONFIG_NET_DHCPV4=y
CONFIG_NET_TCP=y
CONFIG_NET_SOCKETS=y
CONFIG_NET_MGMT=y
CONFIG_NET_MGMT_EVENT=y
CONFIG_NET_MGMT_EVENT_INFO=y
CONFIG_NET_MGMT_EVENT_STACK_SIZE=4096
CONFIG_ESP32_WIFI_STA_AUTO_DHCPV4=y

CONFIG_NET_PKT_RX_COUNT=16
CONFIG_NET_PKT_TX_COUNT=16
CONFIG_NET_BUF_RX_COUNT=32
CONFIG_NET_BUF_TX_COUNT=32
CONFIG_NET_MAX_CONTEXTS=8

CONFIG_HTTP_CLIENT=y
CONFIG_JSON_LIBRARY=y

# TLS for the update and status connection.
#
# CONFIG_MBEDTLS is already on in Tier 0, because the Wi-Fi driver needs it.
# Tier 2 adds the socket layer, the credential store, and one ciphersuite.
CONFIG_NET_SOCKETS_SOCKOPT_TLS=y
CONFIG_TLS_CREDENTIALS=y
CONFIG_MBEDTLS_CIPHERSUITE_TLS_ECDHE_ECDSA_WITH_AES_128_GCM_SHA256=y
CONFIG_MBEDTLS_ENABLE_HEAP=y
CONFIG_MBEDTLS_HEAP_SIZE=49152
# A TLS record can be 16 KiB, and the peer decides how big it makes one.
#
# This was 2048 while Tier 3 was being built, because every response Tier 2
# had ever fetched over TLS was a small JSON record that fitted. Tier 3 is the
# first tier to download a firmware image over the verified connection, and the
# Go service sends that in full sized records. The client cannot hold one,
# mbedTLS treats it as fatal, and the socket layer returns -ECONNABORTED before
# a single byte reaches the flash writer.
#
# The symptom is misleading: "ota.request failed err=-113" after a handshake
# the same log line says succeeded. Nothing in the failure mentions buffers.
#
# Tier 2 now sets 16384 for the same reason. See issue #62.
CONFIG_MBEDTLS_SSL_MAX_CONTENT_LEN=16384
CONFIG_NET_SOCKETS_TLS_MAX_CONTEXTS=2

# The trust anchor is compiled in as DER, so the PEM parser is not needed.
#
# Tier 4 adds a second compiled-in key, the release manifest verification key,
# and it stays off for that too. The build strips it to a bare 65-byte EC point
# that PSA imports directly. Measured on issue #65: turning PEM parsing back on
# costs 1696 bytes of .text and 228 of .flash.rodata to do at run time what the
# build does for free, and puts a text parser on the path to a trust decision.
CONFIG_MBEDTLS_PEM_PARSE_C=n

# Verifying the Release manifest needs no new Kconfig symbol at all.
#
# psa_hash_compute, mbedtls_ecdsa_der_to_raw, psa_import_key and
# psa_verify_hash are already linked into the untouched Tier 3 image, pulled in
# by two lines nobody set for this purpose: the ciphersuite above selects
# PSA_WANT_ALG_ECDSA, PSA_WANT_ALG_SHA_256 and the ECC key types and implies
# PSA_WANT_ECC_SECP_R1_256, and CONFIG_NET_SOCKETS_SOCKOPT_TLS does
# "select PSA_CRYPTO". psa_crypto_init() is already called from Zephyr's own
# SYS_INIT.
#
# The two lines below are assertions, not requests. They are already y, they
# change no bytes, and they are here so that a future change to the ciphersuite
# fails the build rather than quietly removing a verifier. release_policy.c
# carries the same statement as compile-time #error probes, because a symbol
# being set is not the same as a driver being present.
#
# Do not reach for CONFIG_MBEDTLS_ECDSA_C, CONFIG_MBEDTLS_ECP_C or
# CONFIG_MBEDTLS_ECP_DP_SECP256R1_ENABLED. This tree is Mbed TLS 4.1.0 with the
# separate tf-psa-crypto module and those symbols do not exist here; curves and
# algorithms are selected only through PSA_WANT_*.
CONFIG_PSA_WANT_ALG_ECDSA=y
CONFIG_PSA_WANT_ECC_SECP_R1_256=y

# Certificate validity dates are deliberately not checked.
#
# This board has no real-time clock. With CONFIG_MBEDTLS_HAVE_TIME_DATE=y and
# no time source the clock reads 1970, every certificate is "not yet valid",
# and every handshake fails forever. The option is orthogonal to chain and name
# checking, so leaving it off costs neither of those.
#
# The consequence is real and belongs in the Weakness ledger: this device would
# accept an expired certificate. Tier 8 is where credential lifetime becomes
# the subject.
CONFIG_MBEDTLS_HAVE_TIME_DATE=n

# Reading the verification flags after a refusal, so the device can say which
# check failed instead of only that something did.
CONFIG_MBEDTLS_X509_CRT_PARSE_C=y

# Writing the downloaded image into the secondary slot and asking MCUboot to
# swap it in. Tier 0 deliberately added no check here at all; Tier 4 decides
# whether to write before the transfer starts, and whether to request the swap
# after the bytes have been hashed.
CONFIG_FLASH=y
CONFIG_FLASH_MAP=y
CONFIG_STREAM_FLASH=y
CONFIG_IMG_MANAGER=y
CONFIG_IMG_ERASE_PROGRESSIVELY=y
CONFIG_MCUBOOT_IMG_MANAGER=y

# The course network may publish the same name on 2.4 GHz and 5 GHz. Scanning
# every channel makes the board pick the 2.4 GHz radio it can actually use.
CONFIG_ESP32_WIFI_STA_SCAN_ALL=y
CONFIG_ESP32_WIFI_STA_RECONNECT=y

# The onboard status beacon. The DevKitC-1 shows the machine state on its
# WS2812 RGB LED as well as on the console; CONFIG_COURSE_BEACON_LED in
# firmware/common turns that off again for a board that has no such LED.
CONFIG_LED_STRIP=y
```

## src/main.c
```c
#include <course/beacon.h>
#include <course/net_link.h>
#include "ota_client.h"

#include <string.h>
#include <zephyr/devicetree.h>
#include <zephyr/kernel.h>
#include <zephyr/net/net_ip.h>
#include <zephyr/sys/util.h>

#include <esp_rom_sys.h>
#include <hal/efuse_hal.h>

#define ASSERT_PARTITION(node, expected_offset, expected_size) \
	BUILD_ASSERT(DT_REG_ADDR(DT_NODELABEL(node)) == (expected_offset)); \
	BUILD_ASSERT(DT_REG_SIZE(DT_NODELABEL(node)) == (expected_size))

BUILD_ASSERT(DT_REG_SIZE(DT_NODELABEL(flash0)) == 0x400000);
ASSERT_PARTITION(boot_partition, 0x000000, 0x010000);
ASSERT_PARTITION(sys_partition, 0x010000, 0x010000);
ASSERT_PARTITION(slot0_partition, 0x020000, 0x1c0000);
ASSERT_PARTITION(slot1_partition, 0x1e0000, 0x1c0000);
ASSERT_PARTITION(slot0_lpcore_partition, 0x3a0000, 0x008000);
ASSERT_PARTITION(slot1_lpcore_partition, 0x3a8000, 0x008000);
ASSERT_PARTITION(storage_partition, 0x3b0000, 0x030000);
ASSERT_PARTITION(scratch_partition, 0x3e0000, 0x01f000);
ASSERT_PARTITION(coredump_partition, 0x3ff000, 0x001000);

/* Print the silicon revision the chip reports beside the product hardware
 * revision this build asserts.
 *
 * They are two different kinds of fact and Tier 4 turns on the difference.
 * efuse_hal_chip_revision() reads eFuse and returns the wafer stepping as
 * major * 100 + minor: it describes the die, it is set by the silicon vendor,
 * and nothing about it says which product this board was built into.
 *
 * The product hardware revision is the one a release is targeted at, and
 * nothing on this part reports it. So it is asserted by the build, compiled
 * in, and compared against a signed range. Product identity is asserted and
 * protected, never read: a value an attacker can set is not an identity, and a
 * value this device reads is not a claim anybody signed.
 */
static void announce_hardware(void)
{
	uint32_t revision = efuse_hal_chip_revision();

	printk("Silicon revision read from eFuse: v%u.%u\n",
	       revision / 100, revision % 100);
	printk("Product hardware revision asserted by this build: %d\n",
	       CONFIG_COURSE_HARDWARE_REVISION);
	printk("The first is read from the chip. The second is asserted and signed, because\n");
	printk("nothing on this part reports which product a board was built into.\n");
}

static void announce(enum beacon_state state)
{
	printk("ESP32-C6 Reference product: Tier 4, protected release metadata\n");
	printk("Image label: %s\n", CONFIG_COURSE_IMAGE_LABEL);
	printk("Running release: %s\n", CONFIG_COURSE_RELEASE_ID);
	printk("Security counter of the running image: %d\n", CONFIG_COURSE_SECURITY_COUNTER);
	printk("Release channel this device follows: %s\n", CONFIG_COURSE_RELEASE_CHANNEL);
	printk("Board: %s\n", CONFIG_BOARD_TARGET);
	announce_hardware();
	printk("Tier 4 boot mode: signed MCUboot images, swap using offset, permanent upgrade\n");
	printk("Tier 4 downgrade prevention: by security counter, enforced by the bootloader\n");
	printk("Image verification key this build trusted: %s\n",
	       CONFIG_COURSE_SIGNING_KEY_FINGERPRINT);
	printk("That is the key the build used. This application cannot read what the bootloader holds.\n");
	printk("Release manifest verification key: %s\n", release_policy_key_description());
	printk("One key signs both the image and the manifest, and two independent verifiers\n");
	printk("check them. Passing one is never evidence for the other.\n");
	printk("Tier 4 verifies signed release metadata before it parses it, and refuses six ways.\n");
	printk("Synthetic shared device identifier: %s\n", CONFIG_COURSE_DEVICE_ID);
	printk("OTA service: https://%s:%d at address %s\n",
	       CONFIG_COURSE_OTA_SERVICE_NAME, CONFIG_COURSE_OTA_TLS_PORT,
	       CONFIG_COURSE_OTA_HOST);
	printk("Trust anchor: %s\n", ota_client_anchor_description());
	printk("Beacon state: %s, toggle period: %u ms\n",
	       beacon_state_name(state), beacon_toggle_period_ms(state));
	printk("Hardware note: %s\n", beacon_led_note());
}

/* Restart the whole chip, not only the processor.
 *
 * Zephyr's sys_reboot() ends in esp_restart(), which resets the processor but
 * deliberately leaves the BBPLL running so the ROM can keep logging. MCUboot
 * then tries to configure a PLL that is already on, and hangs inside its clock
 * setup before it reaches any of its own code. An update installed that way
 * never starts, and the board only recovers by a manual reset.
 *
 * The ROM's system reset returns the clocks to their power-on state, so
 * MCUboot starts exactly as it does after a power cycle.
 */
static void course_reset_system(void)
{
	esp_rom_software_reset_system();

	/* The reset is immediate. This loop only satisfies the compiler. */
	while (true) {
		k_sleep(K_FOREVER);
	}
}

/* One poll: report status, read the assignment, fetch and verify the signed
 * manifest for whatever release it names, and install only if every check
 * passes. Returns true when the device should reboot into a freshly installed
 * image.
 *
 * The Update assignment is unchanged from Tier 0, down to the "signed": true
 * it still carries about itself. What changed is that the device stops taking
 * its word for anything except which release to go and ask about.
 */
static bool poll_once(enum beacon_state state)
{
	struct ota_release release;
	struct release_manifest manifest;
	const char *state_name = beacon_state_name(state);

	/* A rejected status report must not stop the update check: the two
	 * exchanges are independent, and Tier 0 gates neither on the other.
	 */
	(void)ota_client_report("status.observed", state_name, CONFIG_COURSE_RELEASE_ID,
				"verified service, signed release metadata");

	if (ota_client_fetch_assignment(&release) != 0) {
		return false;
	}

	printk("ota.assignment release_id=%s version=%s image=%s\n",
	       release.release_id, release.version, release.image_path);
	printk("ota.assignment it also claims size=%d sha256=%s\n",
	       release.image_size, release.image_sha256);
	printk("ota.assignment this device believes neither; they are the service's claims\n");
	printk("ota.assignment about itself. Only release_id is used, to know what to ask about.\n");

	if (!ota_release_differs(&release)) {
		printk("ota.assignment matches the running release, nothing to install\n");
		return false;
	}

	printk("ota.assignment offers %s instead of the running %s; asking for its signed manifest\n",
	       release.release_id, CONFIG_COURSE_RELEASE_ID);

	if (ota_client_fetch_manifest(release.release_id, &manifest) != 0) {
		(void)ota_client_report("update.refused", state_name,
					CONFIG_COURSE_RELEASE_ID, release.release_id);
		return false;
	}

	if (ota_client_install(&manifest) != 0) {
		(void)ota_client_report("update.failed", state_name,
					CONFIG_COURSE_RELEASE_ID, manifest.release_id);
		return false;
	}

	(void)ota_client_report("update.installed", state_name, CONFIG_COURSE_RELEASE_ID,
				manifest.release_id);
	return true;
}

int main(void)
{
	enum beacon_state state = beacon_configured_state();
	char address[NET_IPV4_ADDR_LEN];

	/* Before the banner, so the banner's hardware note can report whether
	 * the LED really started rather than whether it was asked to.
	 */
	beacon_led_start(state);
	announce(state);

	if (net_link_connect() != 0) {
		printk("Offline mode: no OTA exchange is possible\n");
		printk("Hardware note: Wi-Fi, HTTP transfer, and OTA install remain unobserved\n");
		while (true) {
			k_sleep(K_SECONDS(CONFIG_COURSE_POLL_INTERVAL_SECONDS));
			printk("status.offline device_id=%s machine_state=%s\n",
			       CONFIG_COURSE_DEVICE_ID, beacon_state_name(state));
		}
	}

	if (net_link_address(address, sizeof(address)) == 0) {
		printk("wifi.address %s assigned by DHCP\n", address);
	}

	while (true) {
		if (poll_once(state)) {
			printk("Rebooting into the newly installed image\n");
			k_sleep(K_MSEC(200));
			course_reset_system();
		}
		k_sleep(K_SECONDS(CONFIG_COURSE_POLL_INTERVAL_SECONDS));
	}
}
```

## src/ota_client.c
```c
#include "ota_client.h"

#include <stdio.h>
#include <string.h>
#include <zephyr/data/json.h>
#include <zephyr/dfu/flash_img.h>
#include <zephyr/dfu/mcuboot.h>
#include <zephyr/kernel.h>
#include <zephyr/net/http/client.h>
#include <zephyr/net/socket.h>
#include <zephyr/net/tls_credentials.h>

#include <mbedtls/x509.h>

/* The Course certificate authority, compiled into this image.
 *
 * ./course build firmware writes course_ca_der.inc from the authority
 * generated for your Course environment. Without it the build falls back to
 * anchor/course_ca_der.inc, which is empty, and this image then trusts nothing
 * and says so on the console.
 *
 * The trailing zero keeps the array from being zero length when the anchor is
 * empty, so the length is one less than the array.
 */
static const unsigned char course_ca_der[] = {
#include "course_ca_der.inc"
	0x00
};

#define COURSE_CA_DER_LEN (sizeof(course_ca_der) - 1)

/* One tag identifies the trust anchor in Zephyr's credential store. */
#define COURSE_CA_TAG 1

#define OTA_REQUEST_TIMEOUT_MS 15000
#define OTA_DOWNLOAD_TIMEOUT_MS 120000
#define OTA_RECV_BUF_SIZE 1024
#define OTA_BODY_BUF_SIZE 768
#define OTA_EVENT_PATH "/v1/devices/" CONFIG_COURSE_DEVICE_ID "/events"

/* The manifest and its signature get their own buffers, and they are static
 * for the same reason recv_buf is: this runs on the main thread's stack and a
 * kilobyte of manifest plus a verification is not what that stack is sized
 * for. A kilobyte of .bss spent here is visible in the map file; a stack
 * overflow during a signature check is not.
 *
 * OTA_MANIFEST_BUF_SIZE is generous on purpose. A manifest that does not fit
 * is refused as truncated rather than verified as far as it got.
 */
#define OTA_MANIFEST_BUF_SIZE 1024
#define OTA_SIGNATURE_BUF_SIZE 96

static uint8_t recv_buf[OTA_RECV_BUF_SIZE];
static char manifest_buf[OTA_MANIFEST_BUF_SIZE];
static uint8_t signature_buf[OTA_SIGNATURE_BUF_SIZE];

/* The JSON parser stores each string as a pointer into the response buffer,
 * so parsing needs its own struct of pointers. The values are copied into the
 * caller's fixed-size record before that buffer goes out of scope.
 *
 * Only the fields Tier 0 acts on appear here. json_obj_parse skips the rest of
 * the release record, so adding fields to the service does not break the
 * device.
 */
struct release_json {
	const char *release_id;
	const char *version;
	const char *image_path;
	const char *image_sha256;
	int image_size;
};

static const struct json_obj_descr release_descr[] = {
	JSON_OBJ_DESCR_PRIM(struct release_json, release_id, JSON_TOK_STRING),
	JSON_OBJ_DESCR_PRIM(struct release_json, version, JSON_TOK_STRING),
	JSON_OBJ_DESCR_PRIM(struct release_json, image_path, JSON_TOK_STRING),
	JSON_OBJ_DESCR_PRIM(struct release_json, image_sha256, JSON_TOK_STRING),
	JSON_OBJ_DESCR_PRIM(struct release_json, image_size, JSON_TOK_NUMBER),
};

static void copy_field(char *target, size_t len, const char *value)
{
	if (value == NULL) {
		target[0] = '\0';
		return;
	}
	strncpy(target, value, len - 1);
	target[len - 1] = '\0';
}

struct body_capture {
	char *buf;
	size_t len;
	size_t used;
	/* A response longer than the buffer used to be silently cut short. For
	 * a release record that produced a parse error nobody could read; for a
	 * manifest it would mean verifying a prefix of what was sent, which is
	 * the sort of thing a signature check exists to prevent. So truncation
	 * is recorded and treated as a failure.
	 */
	bool overflow;
};

struct status_capture {
	int code;
};

struct image_writer {
	struct flash_img_context ctx;
	const struct release_manifest *manifest;
	size_t written;
	bool length_checked;
	int err;
};

/* Register the trust anchor once. The credential store keeps a pointer rather
 * than a copy, which is why course_ca_der has static storage.
 */
static int ota_install_trust_anchor(void)
{
	static bool installed;
	int err;

	if (installed) {
		return 0;
	}
	if (COURSE_CA_DER_LEN == 0) {
		printk("ota.tls no trust anchor is compiled into this image\n");
		printk("ota.tls this image trusts nothing and will refuse every service\n");
		printk("ota.tls run ./course setup and build again\n");
		return -ENOENT;
	}
	err = tls_credential_add(COURSE_CA_TAG, TLS_CREDENTIAL_CA_CERTIFICATE,
				 course_ca_der, COURSE_CA_DER_LEN);
	if (err != 0 && err != -EEXIST) {
		printk("ota.tls trust anchor rejected err=%d\n", err);
		return err;
	}
	installed = true;
	return 0;
}

/* Say which check failed, not just that something did.
 *
 * A device that stops without explaining teaches nothing, and "connection
 * failed" is indistinguishable from a cable problem. This reconnects once with
 * verification set to optional, purely to read the verification flags, and
 * closes the socket immediately. No request is ever sent on it and no data ever
 * crosses it.
 *
 * The connection that carries data, above, always requires verification. This
 * one exists so the refusal can be read out loud.
 */
static void ota_explain_refusal(struct sockaddr_in *addr)
{
	sec_tag_t tags[] = {COURSE_CA_TAG};
	int optional = TLS_PEER_VERIFY_OPTIONAL;
	uint32_t result = 0;
	socklen_t len = sizeof(result);
	int sock;

	sock = zsock_socket(AF_INET, SOCK_STREAM, IPPROTO_TLS_1_2);
	if (sock < 0) {
		return;
	}
	(void)zsock_setsockopt(sock, SOL_TLS, TLS_SEC_TAG_LIST, tags, sizeof(tags));
	(void)zsock_setsockopt(sock, SOL_TLS, TLS_HOSTNAME,
			       CONFIG_COURSE_OTA_SERVICE_NAME,
			       sizeof(CONFIG_COURSE_OTA_SERVICE_NAME));
	(void)zsock_setsockopt(sock, SOL_TLS, TLS_PEER_VERIFY, &optional, sizeof(optional));
	if (zsock_connect(sock, (struct sockaddr *)addr, sizeof(*addr)) == 0 &&
	    zsock_getsockopt(sock, SOL_TLS, TLS_CERT_VERIFY_RESULT, &result, &len) == 0) {
		printk("ota.tls verification flags 0x%08x\n", result);
		if (result & MBEDTLS_X509_BADCERT_NOT_TRUSTED) {
			printk("ota.tls  the certificate was not issued by the trust anchor in this image\n");
			printk("ota.tls  compared: the certificate issuer against the Course certificate authority\n");
		}
		if (result & MBEDTLS_X509_BADCERT_CN_MISMATCH) {
			printk("ota.tls  the certificate does not carry the name this device requires\n");
			printk("ota.tls  compared: the certificate names against %s\n",
			       CONFIG_COURSE_OTA_SERVICE_NAME);
		}
		if (result & (MBEDTLS_X509_BADCERT_EXPIRED | MBEDTLS_X509_BADCERT_FUTURE)) {
			printk("ota.tls  the certificate validity window was rejected\n");
		}
		if (result == 0) {
			printk("ota.tls  the certificate verified; the failure was not the certificate\n");
		}
	}
	zsock_close(sock);
}

static int ota_connect(void)
{
	struct sockaddr_in addr = {
		.sin_family = AF_INET,
		.sin_port = htons(CONFIG_COURSE_OTA_TLS_PORT),
	};
	sec_tag_t tags[] = {COURSE_CA_TAG};
	int required = TLS_PEER_VERIFY_REQUIRED;
	int sock;
	int err;

	if (net_addr_pton(AF_INET, CONFIG_COURSE_OTA_HOST, &addr.sin_addr) != 0) {
		printk("ota.target invalid address %s\n", CONFIG_COURSE_OTA_HOST);
		return -EINVAL;
	}

	err = ota_install_trust_anchor();
	if (err != 0) {
		return err;
	}

	sock = zsock_socket(AF_INET, SOCK_STREAM, IPPROTO_TLS_1_2);
	if (sock < 0) {
		printk("ota.socket failed errno=%d\n", errno);
		return -errno;
	}

	/* The three options that make this a check rather than an encryption
	 * tunnel. The anchor to verify against, the name to require, and the
	 * demand that verification succeed.
	 *
	 * Zephyr already requires verification for clients by default, and sets
	 * an empty hostname when the application sets none, so a forgotten
	 * option fails loudly rather than accepting anything. This code states
	 * the requirement anyway, because a control that depends on a default
	 * is a control nobody can see.
	 */
	if (zsock_setsockopt(sock, SOL_TLS, TLS_SEC_TAG_LIST, tags, sizeof(tags)) < 0 ||
	    zsock_setsockopt(sock, SOL_TLS, TLS_HOSTNAME, CONFIG_COURSE_OTA_SERVICE_NAME,
			     sizeof(CONFIG_COURSE_OTA_SERVICE_NAME)) < 0 ||
	    zsock_setsockopt(sock, SOL_TLS, TLS_PEER_VERIFY, &required, sizeof(required)) < 0) {
		printk("ota.tls could not configure verification errno=%d\n", errno);
		zsock_close(sock);
		return -errno;
	}

	if (zsock_connect(sock, (struct sockaddr *)&addr, sizeof(addr)) < 0) {
		int connect_errno = errno;

		printk("ota.tls refused the connection to %s:%d errno=%d\n",
		       CONFIG_COURSE_OTA_HOST, CONFIG_COURSE_OTA_TLS_PORT, connect_errno);
		printk("ota.tls required name %s issued by the trust anchor in this image\n",
		       CONFIG_COURSE_OTA_SERVICE_NAME);
		zsock_close(sock);
		ota_explain_refusal(&addr);
		printk("ota.tls no release data was read, and the running image is unchanged\n");
		return -connect_errno;
	}
	printk("ota.tls verified %s at %s:%d, connection established\n",
	       CONFIG_COURSE_OTA_SERVICE_NAME, CONFIG_COURSE_OTA_HOST,
	       CONFIG_COURSE_OTA_TLS_PORT);
	return sock;
}

static int capture_body(struct http_response *rsp, enum http_final_call final,
			void *user_data)
{
	struct body_capture *capture = user_data;
	size_t room;

	ARG_UNUSED(final);

	if (rsp->body_frag_len == 0) {
		return 0;
	}
	room = capture->len - capture->used - 1;
	if (rsp->body_frag_len > room) {
		capture->overflow = true;
	} else {
		room = rsp->body_frag_len;
	}
	memcpy(capture->buf + capture->used, rsp->body_frag_start, room);
	capture->used += room;
	capture->buf[capture->used] = '\0';
	return 0;
}

/* http_client_req refuses a request with no response callback, so even a
 * fire-and-forget POST needs one. This records the status line so the caller
 * can tell a rejected report from a delivered one.
 */
static int capture_status(struct http_response *rsp, enum http_final_call final,
			  void *user_data)
{
	struct status_capture *capture = user_data;

	ARG_UNUSED(final);

	if (capture != NULL) {
		capture->code = rsp->http_status_code;
	}
	return 0;
}

static int write_image(struct http_response *rsp, enum http_final_call final,
		       void *user_data)
{
	struct image_writer *writer = user_data;

	if (writer->err != 0) {
		return writer->err;
	}

	/* Check 5, first half, and the last thing that happens before a byte
	 * reaches flash. The transfer announced a length in its headers; if
	 * that does not match the size the signed manifest declared, nothing is
	 * written at all.
	 *
	 * A declared length is a promise, not a fact, so the same check runs
	 * again on the delivered count after the transfer. This half exists so
	 * an obviously wrong image never touches the slot.
	 */
	if (!writer->length_checked) {
		writer->length_checked = true;
		if (rsp->content_length == 0) {
			printk("ota.install the transfer declared no length; the size check "
			       "runs on the delivered bytes instead\n");
		} else if (release_policy_check_size(writer->manifest, rsp->content_length,
						     "length this transfer declared before any "
						     "byte was written", true) != 0) {
			writer->err = -EMSGSIZE;
			return writer->err;
		}
	}

	if (rsp->body_frag_len > 0) {
		writer->err = release_digest_update(rsp->body_frag_start, rsp->body_frag_len);
		if (writer->err != 0) {
			return writer->err;
		}
		writer->err = flash_img_buffered_write(&writer->ctx,
						       rsp->body_frag_start,
						       rsp->body_frag_len, false);
		if (writer->err != 0) {
			printk("ota.write failed offset=%zu err=%d\n",
			       writer->written, writer->err);
			return writer->err;
		}
		writer->written += rsp->body_frag_len;
	}
	if (final == HTTP_DATA_FINAL) {
		writer->err = flash_img_buffered_write(&writer->ctx, NULL, 0, true);
		if (writer->err != 0) {
			printk("ota.flush failed err=%d\n", writer->err);
			return writer->err;
		}
	}
	return 0;
}

static int run_request(struct http_request *req, int32_t timeout_ms, void *user_data)
{
	int sock = ota_connect();
	int err;

	if (sock < 0) {
		return sock;
	}
	/* The Host header names the service, the socket connects to an address.
	 * The name is never resolved: it is what the certificate is checked
	 * against, and what the service is called.
	 */
	req->host = CONFIG_COURSE_OTA_SERVICE_NAME;
	req->protocol = "HTTP/1.1";
	req->recv_buf = recv_buf;
	req->recv_buf_len = sizeof(recv_buf);

	err = http_client_req(sock, req, timeout_ms, user_data);
	zsock_close(sock);

	if (err < 0) {
		printk("ota.request failed url=%s err=%d\n", req->url, err);
		return err;
	}
	return 0;
}

int ota_client_fetch_assignment(struct ota_release *release)
{
	char body[OTA_BODY_BUF_SIZE];
	struct body_capture capture = {.buf = body, .len = sizeof(body)};
	struct release_json parsed = {0};
	struct http_request req = {
		.method = HTTP_GET,
		.url = "/v1/releases/current",
		.response = capture_body,
	};
	int err;

	body[0] = '\0';
	err = run_request(&req, OTA_REQUEST_TIMEOUT_MS, &capture);
	if (err != 0) {
		return err;
	}
	if (capture.used == 0) {
		printk("ota.assignment empty response\n");
		return -ENODATA;
	}
	if (capture.overflow) {
		printk("ota.assignment response longer than %zu bytes, refused as truncated\n",
		       sizeof(body));
		return -EMSGSIZE;
	}

	err = json_obj_parse(body, capture.used, release_descr,
			     ARRAY_SIZE(release_descr), &parsed);
	if (err < 0) {
		printk("ota.assignment unreadable err=%d\n", err);
		return err;
	}

	memset(release, 0, sizeof(*release));
	copy_field(release->release_id, sizeof(release->release_id), parsed.release_id);
	copy_field(release->version, sizeof(release->version), parsed.version);
	copy_field(release->image_path, sizeof(release->image_path), parsed.image_path);
	copy_field(release->image_sha256, sizeof(release->image_sha256), parsed.image_sha256);
	release->image_size = parsed.image_size;

	if (release->release_id[0] == '\0' || release->image_path[0] == '\0') {
		printk("ota.assignment missing release_id or image_path\n");
		return -EINVAL;
	}
	return 0;
}

/* Fetch one stored artifact of a release into a caller supplied buffer.
 *
 * The manifest and its signature are both served as opaque stored bytes, so
 * one function fetches either. Nothing here looks inside what it downloaded:
 * that is release_policy.c's job, and it does it in the order that matters.
 */
static int ota_fetch_release_artifact(const char *release_id, const char *suffix,
				      char *buf, size_t buf_len, size_t *used)
{
	char url[OTA_FIELD_MAX + 40];
	struct body_capture capture = {.buf = buf, .len = buf_len};
	struct http_request req = {
		.method = HTTP_GET,
		.response = capture_body,
	};
	int err;

	if (snprintf(url, sizeof(url), "/v1/releases/%s/%s", release_id, suffix) >=
	    (int)sizeof(url)) {
		return -ENOMEM;
	}
	req.url = url;
	buf[0] = '\0';

	err = run_request(&req, OTA_REQUEST_TIMEOUT_MS, &capture);
	if (err != 0) {
		return err;
	}
	if (capture.used == 0) {
		printk("ota.manifest %s returned nothing\n", url);
		return -ENODATA;
	}
	if (capture.overflow) {
		printk("ota.manifest %s is longer than the %zu bytes this device will "
		       "hold; refused as truncated rather than verified in part\n",
		       url, buf_len - 1);
		return -EMSGSIZE;
	}
	*used = capture.used;
	return 0;
}

int ota_client_fetch_manifest(const char *release_id, struct release_manifest *manifest)
{
	size_t manifest_len = 0;
	size_t signature_len = 0;
	int err;

	err = ota_fetch_release_artifact(release_id, "manifest",
					 manifest_buf, sizeof(manifest_buf), &manifest_len);
	if (err != 0) {
		return err;
	}
	err = ota_fetch_release_artifact(release_id, "manifest.sig",
					 (char *)signature_buf, sizeof(signature_buf),
					 &signature_len);
	if (err != 0) {
		return err;
	}
	printk("ota.manifest fetched %zu manifest bytes and a %zu byte detached signature\n",
	       manifest_len, signature_len);

	/* Check 1, and it runs here rather than after the parse on purpose.
	 * The bytes below are still exactly what came off the socket. One line
	 * further on they will not be, because the JSON parser rewrites the
	 * buffer it reads.
	 */
	err = release_policy_verify((const uint8_t *)manifest_buf, manifest_len,
				    signature_buf, signature_len);
	if (err != 0) {
		return err;
	}
	err = release_policy_parse(manifest_buf, manifest_len, manifest);
	if (err != 0) {
		return err;
	}
	return release_policy_admit(manifest, release_id);
}

int ota_client_report(const char *event, const char *machine_state,
		      const char *release_id, const char *detail)
{
	char payload[320];
	const char *headers[] = {"Content-Type: application/json\r\n", NULL};
	struct status_capture status = {0};
	struct http_request req = {
		.method = HTTP_POST,
		.url = OTA_EVENT_PATH,
		.header_fields = headers,
		.response = capture_status,
	};
	int len;
	int err;

	len = snprintf(payload, sizeof(payload),
		       "{\"device_id\":\"%s\",\"event\":\"%s\",\"machine_state\":\"%s\","
		       "\"running_release_id\":\"%s\",\"detail\":\"%s\","
		       "\"transport\":\"https\",\"synthetic_data\":true}",
		       CONFIG_COURSE_DEVICE_ID, event, machine_state, release_id,
		       detail == NULL ? "" : detail);
	if (len < 0 || len >= (int)sizeof(payload)) {
		return -ENOMEM;
	}
	req.payload = payload;
	req.payload_len = len;

	err = run_request(&req, OTA_REQUEST_TIMEOUT_MS, &status);
	if (err != 0) {
		return err;
	}
	if (status.code < 200 || status.code >= 300) {
		printk("ota.report rejected status=%d\n", status.code);
		return -EIO;
	}
	return 0;
}

bool ota_release_differs(const struct ota_release *release)
{
	return strcmp(release->release_id, CONFIG_COURSE_RELEASE_ID) != 0;
}

int ota_client_install(const struct release_manifest *manifest)
{
	char url[OTA_FIELD_MAX + 16];
	char digest_hex[65];
	struct image_writer writer = {.manifest = manifest};
	struct http_request req = {
		.method = HTTP_GET,
		.response = write_image,
	};
	int err;

	/* The path comes from the manifest, not from the Update assignment.
	 * Section 7 calls it the immutable image path: it is part of what was
	 * signed, so the service cannot point a verified release at a different
	 * file.
	 */
	if (snprintf(url, sizeof(url), "/v1/firmware/%s", manifest->image_path) >=
	    (int)sizeof(url)) {
		return -ENOMEM;
	}
	req.url = url;

	printk("ota.install starting release_id=%s version=%s size=%d\n",
	       manifest->release_id, manifest->version, manifest->image_size);
	printk("ota.install every value above came from the signed manifest\n");

	err = release_digest_begin();
	if (err != 0) {
		return err;
	}

	err = flash_img_init(&writer.ctx);
	if (err != 0) {
		printk("ota.slot unavailable err=%d\n", err);
		return err;
	}

	err = run_request(&req, OTA_DOWNLOAD_TIMEOUT_MS, &writer);
	if (err != 0) {
		return err;
	}
	if (writer.err != 0) {
		return writer.err;
	}
	if (writer.written == 0) {
		printk("ota.install received no image bytes\n");
		return -ENODATA;
	}

	/* Check 5, second half: what actually arrived, against what was
	 * signed. The header check above can be lied to; this one counts.
	 */
	err = release_policy_check_size(manifest, writer.written,
					"number of bytes this transfer actually delivered",
					false);
	if (err != 0) {
		return err;
	}

	/* Check 6. The bytes are in the secondary slot by now, because an
	 * image this size is streamed through a device that cannot hold it.
	 * What this check protects is the upgrade request below: an image whose
	 * digest is wrong is never asked for, so it is never swapped in and
	 * never booted, and MCUboot would refuse it on its own signature
	 * anyway. The two verifiers stay independent; passing one is never
	 * evidence for the other.
	 */
	err = release_digest_finish(digest_hex, sizeof(digest_hex));
	if (err != 0) {
		return err;
	}
	err = release_policy_check_digest(manifest, digest_hex);
	if (err != 0) {
		return err;
	}

	printk("ota.install wrote %zu bytes to the secondary slot\n", writer.written);
	printk("ota.install six checks ran and none refused\n");

	err = boot_request_upgrade(BOOT_UPGRADE_PERMANENT);
	if (err != 0) {
		printk("ota.upgrade request failed err=%d\n", err);
		return err;
	}
	printk("ota.upgrade requested a permanent swap, no test boot, no rollback\n");
	printk("ota.upgrade the bootloader now checks the signature and the security "
	       "counter itself, and its refusal is the one that stops a downgrade\n");
	return 0;
}

const char *ota_client_anchor_description(void)
{
	if (COURSE_CA_DER_LEN == 0) {
		return "none compiled in, this image trusts nothing";
	}
	return CONFIG_COURSE_TRUST_ANCHOR_FINGERPRINT;
}
```

## src/ota_client.h
```c
/*
 * The Tier 4 OTA client.
 *
 * Tier 2 and Tier 3 shared one byte-identical client. It asked the service
 * which release to run, and the whole install decision was one strcmp on
 * release_id: everything else in that record was believed because it arrived
 * over a verified connection from a service with the right certificate.
 *
 * Tier 4 keeps the same Update assignment, byte for byte, and stops believing
 * it. GET /v1/releases/current is unchanged from Tier 0 and still says
 * "signed": true about whatever it is pointing at. The device now reads one
 * field out of it, the release identifier, and then goes and fetches signed
 * metadata about that release: a Release manifest and its detached signature.
 *
 * Everything that decides whether an image is installed comes from the
 * manifest. See release_policy.h for the checks and the order they run in.
 */

#ifndef COURSE_OTA_CLIENT_H
#define COURSE_OTA_CLIENT_H

#include "release_policy.h"

#include <stdbool.h>
#include <stddef.h>

#define OTA_FIELD_MAX 64
#define OTA_DIGEST_MAX 72

/* The Update assignment, exactly as Tier 0 read it.
 *
 * The digest and size in this record are still read and still printed, and
 * Tier 4 no longer acts on either: they are the service's claim about itself,
 * and a service that has been taken over writes them as happily as one that
 * has not. Only release_id is used, to learn which release to ask about.
 */
struct ota_release {
	char release_id[OTA_FIELD_MAX];
	char version[OTA_FIELD_MAX];
	char image_path[OTA_FIELD_MAX];
	char image_sha256[OTA_DIGEST_MAX];
	int image_size;
};

/* Reads the update assignment from GET /v1/releases/current. */
int ota_client_fetch_assignment(struct ota_release *release);

/* Fetches GET /v1/releases/{release_id}/manifest and its detached signature
 * from GET /v1/releases/{release_id}/manifest.sig, verifies the signature over
 * the manifest bytes exactly as they arrived, parses them only then, and runs
 * the metadata checks.
 *
 * Returns 0 only when the manifest is signed by the key this image carries,
 * describes the release that was asked about, and passes every check. The
 * refusal is printed by whichever check made it.
 */
int ota_client_fetch_manifest(const char *release_id, struct release_manifest *manifest);

/* Posts one status event to POST /v1/devices/<id>/events.
 *
 * The body names this device with the compiled-in identifier. The service
 * trusts that name, which is weakness T0-W-02.
 */
int ota_client_report(const char *event, const char *machine_state,
		      const char *release_id, const char *detail);

/* Downloads the image the manifest describes and asks MCUboot to swap it in
 * permanently. Returns 0 when the device is ready to reboot.
 *
 * The image path, the size and the digest all come from the verified
 * manifest, never from the Update assignment. The transfer is refused if the
 * length it declares does not match the manifest before a byte reaches flash,
 * and the upgrade is refused if the delivered bytes do not hash to the digest
 * the manifest declared.
 *
 * The upgrade stays permanent. Test boot, the health gate, confirmation and
 * revert are Tier 5's subject.
 */
int ota_client_install(const struct release_manifest *manifest);

/* True when the service assigned a release other than the one built into
 * this image.
 */
bool ota_release_differs(const struct ota_release *release);


/* A short fingerprint of the trust anchor compiled into this image, printed
 * at boot so a stale anchor diagnoses itself instead of looking like a
 * broken network. Compare it with ./course service certificate.
 */
const char *ota_client_anchor_description(void);
#endif /* COURSE_OTA_CLIENT_H */
```

## src/release_policy.h
```c
/*
 * The Tier 4 release policy.
 *
 * Tier 3 taught the device to care who signed an image. It still learned what
 * to install from one mutable record the service was free to rewrite, and the
 * whole install decision was one strcmp on release_id.
 *
 * Tier 4 moves the decision onto a Release manifest: signed metadata that
 * describes exactly one firmware release, whose exact bytes are verified
 * before anything parses them. Everything this module does is a refusal it is
 * willing to explain.
 *
 * The order matters and it is the order of the functions below. A manifest is
 * verified before it is parsed, because parsing is the first thing that acts
 * on attacker-supplied bytes. The policy checks then run against values that
 * are known to have been signed, rather than against whatever the service
 * happened to say.
 */

#ifndef COURSE_RELEASE_POLICY_H
#define COURSE_RELEASE_POLICY_H

#include <stdbool.h>
#include <stddef.h>
#include <stdint.h>

#define RELEASE_FIELD_MAX 64
#define RELEASE_DIGEST_MAX 72

/* The Release manifest, after its bytes have been verified and parsed.
 *
 * Every field here was covered by the signature. Nothing in this struct came
 * from the Update assignment, and nothing in it can be changed by the service
 * without the signature failing.
 */
struct release_manifest {
	int schema_version;
	char release_id[RELEASE_FIELD_MAX];
	char version[RELEASE_FIELD_MAX];
	int security_counter;
	char channel[RELEASE_FIELD_MAX];
	char board[RELEASE_FIELD_MAX];
	int hardware_revision_min;
	int hardware_revision_max;
	char image_path[RELEASE_FIELD_MAX];
	int image_size;
	char image_sha256[RELEASE_DIGEST_MAX];
	/* Carried, signed, and never acted on. This device has no clock, and
	 * every time source it can reach is controlled by something Tier 4
	 * assumes hostile. Signing these means they cannot be edited after the
	 * fact; it does not mean the device can check them. Tier 9 consumes
	 * them. See the Weakness ledger beside T2-W-09.
	 */
	char created_at[RELEASE_FIELD_MAX];
	char supported_until[RELEASE_FIELD_MAX];
};

/* Verify the detached signature over the exact manifest bytes.
 *
 * Check 1 of six, and the only one that runs before anything parses the
 * bytes. ECDSA P-256 over SHA-256, against the release verification key
 * compiled into this image. Returns 0 when the signature is good.
 */
int release_policy_verify(const uint8_t *body, size_t body_len,
			  const uint8_t *sig_der, size_t sig_len);

/* Parse verified manifest bytes into the struct above.
 *
 * Only ever called on bytes release_policy_verify() has already accepted. The
 * JSON parser writes into the buffer it is given, so calling this first would
 * mean verifying something other than what arrived.
 */
int release_policy_parse(char *body, size_t body_len, struct release_manifest *manifest);

/* Checks 2, 3 and 4: hardware compatibility, security counter, release
 * channel. Every one compares a signed manifest value against a value this
 * build asserts about itself, and every refusal says which.
 *
 * expected_release_id is the release the Update assignment named. A manifest
 * that describes a different release is refused before any policy check runs:
 * a manifest is only evidence about the release it names.
 */
int release_policy_admit(const struct release_manifest *manifest,
			 const char *expected_release_id);

/* Check 5: the delivered image is the size the manifest declared.
 *
 * declared is the manifest's image_size, delivered is what the transfer
 * actually produced. Called twice on the install path: once against the
 * Content-Length before a single byte reaches flash, and once against the
 * byte count after the transfer, because a header is a promise and a count is
 * a fact.
 */
int release_policy_check_size(const struct release_manifest *manifest,
			      size_t delivered, const char *when, bool before_write);

/* Check 6: the SHA-256 of the delivered bytes is the digest the manifest
 * declared. digest_hex is lower-case hex, NUL terminated.
 */
int release_policy_check_digest(const struct release_manifest *manifest,
				const char *digest_hex);

/* The running SHA-256 over the delivered image bytes, for check 6.
 *
 * Three calls rather than one, because the image is streamed straight into
 * flash and never exists anywhere this device could hash in one piece: the
 * secondary slot is 1.75 MiB and there is nothing like that much RAM. So the
 * digest is accumulated as the bytes go past.
 *
 * That is also the honest limit of check 6. The bytes are in flash by the time
 * the digest is known, so what this check protects is the upgrade request, not
 * the flash write. An image that fails it is never asked for, never swapped in
 * and never booted, and MCUboot would refuse it independently anyway.
 *
 * One download at a time, so the state is file-static and this header stays
 * free of PSA types.
 */
int release_digest_begin(void);
int release_digest_update(const uint8_t *data, size_t len);
int release_digest_finish(char *hex, size_t hex_len);

/* A short description of the release verification key compiled into this
 * image, for the boot banner. Says so plainly when there is none.
 */
const char *release_policy_key_description(void);

#endif /* COURSE_RELEASE_POLICY_H */
```
