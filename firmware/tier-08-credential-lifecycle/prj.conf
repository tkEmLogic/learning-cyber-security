## CMakeLists.txt
```
# SPDX-License-Identifier: Apache-2.0

cmake_minimum_required(VERSION 3.20.0)

list(APPEND EXTRA_ZEPHYR_MODULES ${CMAKE_CURRENT_SOURCE_DIR}/../common)

find_package(Zephyr REQUIRED HINTS $ENV{ZEPHYR_BASE})
project(tier_08_credential_lifecycle)

test_sysbuild()

# The trust anchor is compiled into the image, the same way the Wi-Fi
# credentials are. ./course build firmware writes course_ca_der.inc from the
# Course certificate authority in .course-secrets/, and passes the directory
# here.
#
# Without it the build falls back to anchor/, which holds an empty anchor. The
# repository then still builds standalone, and the resulting image refuses to
# connect and says why. An image that trusts nothing is the right failure: the
# alternative is an image that trusts anything.
# The directory arrives in the environment rather than as a CMake cache
# variable. Sysbuild keeps an image-scoped -D<image>_VAR in its own cache and
# does not forward an arbitrary one into the image build, so a cache variable
# silently produced an image with no anchor. The environment reaches every
# image's configure step.
if(DEFINED ENV{COURSE_CA_INC_DIR})
	zephyr_include_directories($ENV{COURSE_CA_INC_DIR})
else()
	zephyr_include_directories(anchor)
endif()

# The release manifest verification key arrives the same way, from
# ./course build firmware, which writes release_pubkey.inc from the public half
# of the Learner's Release signing key. It has its own variable because it is
# its own decision: the certificate authority says which service to talk to,
# and this key says whose release metadata to believe. Nothing about one
# implies the other.
#
# Without it the build falls back to anchor/, which holds no key, and the
# resulting image verifies no manifest and says so at boot and at every
# refusal. That is the same honest failure the empty trust anchor produces.
if(DEFINED ENV{COURSE_RELEASE_KEY_INC_DIR})
	zephyr_include_directories($ENV{COURSE_RELEASE_KEY_INC_DIR})
else()
	zephyr_include_directories(anchor)
endif()

target_sources(app PRIVATE
	src/health_gate.c
	src/identity.c
	src/main.c
	src/opaque_tls.c
	src/ota_client.c
	src/recovery_state.c
	src/release_policy.c
	src/renewal.c
	src/time_floor.c
)

target_sources_ifdef(CONFIG_COURSE_CLAIM app PRIVATE
	src/claim.c
)

target_sources_ifdef(CONFIG_COURSE_PROVISIONING_SHELL app PRIVATE
	src/provisioning_shell.c
)
```

## Kconfig
```
# Configuration Tier 5 adds on top of the shared options in firmware/common.
#
# The first block is inherited from Tier 2, which taught the device to verify
# the service it talks to. Tier 4 keeps every word of it: the manifest is
# fetched over that same verified connection, and a signed manifest does not
# make an unverified connection acceptable.

menu "Tier 2 authenticated service"

config COURSE_OTA_SERVICE_NAME
	string "Name the service certificate must carry"
	default "ota.course.example"
	help
	  The device connects to CONFIG_COURSE_OTA_HOST, a literal address, and
	  then requires the certificate presented there to carry this name.

	  The name is never resolved. There is no DNS resolver in this image.
	  It is the value the TLS layer compares the certificate against, which
	  is why a wrong name is refused even though the address was right.

config COURSE_OTA_TLS_PORT
	int "OTA service TLS port"
	default 8443
	help
	  Tier 2 moves release records, firmware bytes, and status events to
	  this port. Health and the Course environment marker stay on the plain
	  HTTP port, because a safety check must not depend on the control it
	  is used to test.

config COURSE_TRUST_ANCHOR_FINGERPRINT
	string "Fingerprint of the trust anchor compiled into this image"
	default "unknown"
	help
	  Printed at boot so a stale trust anchor diagnoses itself instead of
	  looking like a broken network. ./course build firmware writes this
	  value, and ./course service certificate prints the same one.

	  The device does not compute it. Computing a digest on the board to
	  describe material the board already holds would prove nothing that the
	  build cannot state.

endmenu

menu "Tier 4 release policy"

config COURSE_SECURITY_COUNTER
	int "Security counter of the running image"
	default 1
	help
	  The anti-rollback counter this image was signed with. The same value
	  goes into the signed MCUboot image TLV and into the signed Release
	  manifest, and ./course build firmware writes it from the one constant
	  in internal/courseapp/tier04.go so the two cannot disagree.

	  The application refuses a manifest whose counter is lower than this
	  one. Equal is allowed; lower never is. That check saves a wasted
	  download and is not the boundary: the bootloader is what actually
	  stops a downgrade, by comparing the candidate's counter against the
	  counter in the image already in the primary slot.

	  It is deliberately not derived from the human-readable version.
	  "Human-readable versions override the security counter" is the
	  failure this tier is about.

config COURSE_HARDWARE_REVISION
	int "Product hardware revision this build asserts"
	default 1
	help
	  The product hardware revision a release is targeted at, compared
	  against the manifest's signed hardware_revision_min..max range.

	  It is asserted, not read. The chip reports its silicon stepping from
	  eFuse and the boot banner prints that beside this value, but nothing
	  on this part reports which product a board was built into. Product
	  identity is asserted and protected; a value the device reads is not a
	  claim anybody signed.

config COURSE_RELEASE_CHANNEL
	string "Release channel this device follows"
	default "stable"
	help
	  One of stable or candidate. The device refuses a manifest published
	  to any other channel, even a correctly signed one.

	  This is the check that has no attacker behind it. Nobody without the
	  Release signing key can produce a manifest that gets this far, so a
	  channel mismatch means whoever holds the key published something for
	  the wrong devices. The device cannot tell that from a leaked key, and
	  refusing is the same either way.

endmenu

menu "Tier 5 recoverable install"

choice COURSE_TRIAL_BEHAVIOUR
	prompt "How this image behaves during its trial boot"
	default COURSE_TRIAL_HEALTHY
	help
	  Tier 5 publishes five images from this one source tree. They differ
	  only in what happens between the trial boot and the confirmation,
	  which is the whole subject of the tier, so the difference a Learner
	  has to understand is one conditional rather than a diff between five
	  directories.

	  Every one of them is a real, correctly signed image. None of them is
	  hostile: an unhealthy release is the manufacturer publishing something
	  that does not work, which section 11 names beside the attacks.

config COURSE_TRIAL_HEALTHY
	bool "Healthy: pass every check and confirm"
	help
	  The release that works. It passes the four health checks, survives the
	  60 second window, and calls boot_write_img_confirmed().

config COURSE_TRIAL_CRASH
	bool "Crash: fault before the health gate starts"
	help
	  Faults deliberately before the gate runs, so it is distinct from
	  FAIL_HEALTH, which requires the gate to have run. The image never
	  reaches the code that could record why, so the device identifies it by
	  reset cause and by the absence of a written reason.

config COURSE_TRIAL_HANG
	bool "Hang: stop in the thread that feeds the watchdog"
	help
	  An ordinary loop, in main. Interrupts keep being serviced and the
	  beacon thread keeps running; what stops is the watchdog feed, because
	  main is the only thing that ever performs one.

	  Feeding from the thread that does the work, rather than from a timer,
	  is what makes this catchable at all. A feed on a timer keeps running
	  while the thread it vouches for is dead, and the watchdog would be
	  guarding nothing.

	  This was checked on the board. The driver programs stage 0 as an
	  interrupt whose handler is documented as clearing the interrupt and
	  feeding the watchdog, which would mean only a hang that also blocked
	  interrupts ever reached the resetting stage. It does not work out that
	  way: that function must be called with write protection disabled, and
	  wdt_esp32_isr() does not disable it, so its feed has no effect and
	  stage 1 resets the chip. That is a property of this driver rather than
	  a guarantee, and an upstream fix would change it silently.

config COURSE_TRIAL_FAIL_HEALTH
	bool "Fail health: fail one named check"
	help
	  Fails a single named check while the other three visibly pass, so the
	  cause is read rather than inferred from where the output stopped.

config COURSE_TRIAL_TIMEOUT_HEALTH
	bool "Timeout health: never reach a verdict"
	help
	  Leaves one check unsatisfied so the 60 second window expires without a
	  verdict. Distinct from FAIL_HEALTH: the specification separates a
	  failed check from an expired timer, and these two images are what make
	  that separation observable.

endchoice

config COURSE_TRIAL_BEHAVIOUR_NAME
	string
	default "healthy" if COURSE_TRIAL_HEALTHY
	default "crash" if COURSE_TRIAL_CRASH
	default "hang" if COURSE_TRIAL_HANG
	default "fail-health" if COURSE_TRIAL_FAIL_HEALTH
	default "timeout-health" if COURSE_TRIAL_TIMEOUT_HEALTH
	help
	  The name this image prints for its own trial behaviour. Not settable:
	  it follows the choice above so the two cannot disagree.

config COURSE_HEALTH_GATE_SECONDS
	int "Length of the local health window"
	default 60
	help
	  Section 6 fixes this at 60 seconds. It is measured from the end of the
	  boot-time checks rather than from boot, so a slow boot cannot eat the
	  window and make the gate's length depend on something it is not
	  measuring.

config COURSE_TRIAL_FAILURE_LIMIT
	int "How many trials of one release before it is refused"
	default 3
	help
	  Bounds the revert loop. A release that installs cleanly and then fails
	  its trial would otherwise be offered, installed, fail and revert
	  forever, because nothing about it is invalid.

	  The count is incremented when a trial begins, never when one fails. A
	  crashing image never reaches code that could record a failure, and a
	  hung one is reset from interrupt context where an NVS write is not
	  safe, so a count kept on failure would miss exactly the two failures
	  that most need counting.

	  This is persistent state about a release, and it is not the
	  application-managed accepted-image database section 6 forbids. That
	  prohibition exists so a failed trial can always revert to the
	  previously confirmed image. This count never blocks a revert; it only
	  stops the device re-attempting a release it has already proven bad.

config COURSE_SOURCE_REVISION
	string "Source revision this image was built from"
	default "unknown"
	help
	  The git hash of the tree this image was built from, with -dirty
	  appended when the tree was dirty, exactly as git describe --dirty
	  reports it.

	  It also travels in a protected MCUboot TLV at tag 0x00A0, so it is
	  covered by the image signature and cannot be rewritten without
	  invalidating the image. This Kconfig value is what the build put in
	  that TLV.

	  It identifies the build and not the release. A Learner's own build
	  carries their hash and will usually be dirty, and will not match a
	  published one. The course claims no reproducible builds, and this
	  value is not evidence of any.

	  What it answers is "what am I running" after a revert, when the
	  Release manifest that described the image was consumed long ago and
	  the device no longer holds it.

endmenu

menu "Tier 6 factory identity, carried into Tier 7"

config COURSE_IDENTITY_FACTORY
	bool "Factory: a key generated on this device"
	default y
	help
	  Tier 7 builds one image, and the factory identity is not a choice in
	  it.

	  Tier 6 published two images from one source tree, because where the
	  device's identity comes from was that tier's whole subject. Tier 7's
	  subject is what an identity authorizes, and it takes the per-device
	  Factory identity as given. The comparison is Tier 6's and Tier 6
	  still publishes both halves of it.

	  Be precise about why the shared image is not carried forward. It is
	  not that it cannot prove anything. Its certificate is a real Factory
	  certificate signed by the manufacturer device CA, so it proves
	  possession of its key exactly as well as a per-device one does, and
	  it would pass the identity-factory check at the claim endpoint. What
	  it cannot prove is which device it is. Every shared image carries the
	  same subject, and a claim binds an owner to a device rather than to a
	  fleet.

	  Follow that through and the shared image fails in a way worth
	  knowing. Ownership is first come, so the first shared board to
	  complete a claim takes the identifier, and every other board flashed
	  from the same image is refused at device-unowned from then on. No
	  attacker appears anywhere in that story. That is the strongest
	  argument for per-device identity, and it is why this symbol is not a
	  choice.

	  The symbol keeps its prompt and its name so the generated Tier 6
	  fragment still configures this tree, and so the two tiers are
	  readable side by side. Turning it off builds an image with no
	  identity subsystem at all, which is not a Tier 7 variant, it is a
	  broken configuration.

config COURSE_IDENTITY_NAME
	string
	default "factory"
	help
	  The name this image prints for its own identity model.

config COURSE_PROVISIONING_SHELL
	bool "Offer the provisioning shell while unprovisioned"
	default y
	depends on COURSE_IDENTITY_FACTORY
	help
	  The enrollment interface. It is a Zephyr shell rather than a private
	  protocol on purpose: a hidden framing is obscurity and not security,
	  and both are exposed on exactly the same terms once the gating below
	  is in place.

	  What makes it defensible is that it is reduced and closed. SHELL_MINIMAL
	  turns off the kernel module, the built-in commands, history, tab
	  completion and VT100 handling, all of which are gated on the same
	  condition, so an attacker finding this shell finds two provisioning
	  commands and nothing else. SHELL_AUTOSTART is off, so the application
	  decides when it runs, and it stops it the moment enrollment succeeds.

	  A Learner can check both halves: type a command after enrolling and
	  watch nothing happen.

config COURSE_PROVISIONING_BUTTON_REOPENS
	bool "Let the BOOT button reopen provisioning on an enrolled device"
	default y
	depends on COURSE_PROVISIONING_SHELL
	help
	  Without this the interface closes permanently on enrollment, and there
	  is then no way to send the erase command that remanufacturing needs.
	  Reflashing does not help: Secure Storage lives in the storage
	  partition and survives a slot 0 flash, exactly the way MCUboot's
	  trailer does.

	  The cost is a weakness worth naming rather than hiding: anyone with
	  physical access and this button can put the device back into
	  provisioning mode. That is a deliberate trade for recoverability, and
	  Advanced Tier A is where the debug and download paths around it are
	  closed.

config COURSE_PROVISIONING_BUTTON_HOLD_SECONDS
	int "Seconds the BOOT button must be held to reopen provisioning"
	default 10
	range 2 60
	depends on COURSE_PROVISIONING_BUTTON_REOPENS
	help
	  The button is read while the application runs, not at reset.

	  Reading it at reset cannot work on this part: sw0 is GPIO9, the
	  ESP32-C6 strapping pin, so holding it through the reset edge straps
	  the chip into the ROM download loader and the application never runs
	  at all. The only window was therefore after the reset and before the
	  gate, which is a fraction of a second, and hitting it reliably was not
	  something a Learner should have to practise.

	  So the button is armed with an interrupt instead, and a deliberate
	  long press reopens the interface in place, with no reset and no
	  re-enumeration of the USB device. A sustained hold is also harder to
	  trigger by accident than a press during boot.

endmenu

menu "Tier 7 operational identity"

config COURSE_CLAIM
	bool "Build the Claim window"
	default y
	depends on COURSE_IDENTITY_FACTORY && COURSE_PROVISIONING_BUTTON_REOPENS
	help
	  The timed half of Tier 7: a nonce, a ten-minute window, a bounded
	  submit and a poll, in src/claim.c.

	  It depends on the button rather than merely on the factory identity,
	  and that dependency is the decision #135 made rather than an accident
	  of wiring. The Claim window is opened by a documented physical action
	  and by nothing else. An image with the button disabled has no way to
	  open one, and building the window into it would leave a claim path
	  with no way to authorize it.

config COURSE_CLAIM_WINDOW_SECONDS
	int "Seconds a Claim window stays open on this device"
	default 600
	range 60 3600
	depends on COURSE_CLAIM
	help
	  The device times this itself with a k_timer and closes its own window
	  by destroying the nonce and the pending Operational key.

	  This is not the service's ten minutes and it is not meant to be. The
	  service starts counting when the request reaches it, some seconds
	  later, and the service alone decides that a claim has expired. The
	  device's timer only ever closes the device's own window: it never
	  reports a time and it is never an authorization input, which is what
	  keeps device time evidence rather than permission.

	  CONFIG_MBEDTLS_HAVE_TIME_DATE=n costs this board wall-clock judgement,
	  not duration judgement. It cannot tell you whether a certificate has
	  expired. It can perfectly well count ten minutes.

config COURSE_CLAIM_SUBMIT_ATTEMPTS
	int "Attempts at submitting the device half before the window closes"
	default 4
	range 1 10
	depends on COURSE_CLAIM
	help
	  Submitting is a thing that either lands or does not, so it is bounded.
	  Four attempts on the cadence 0, 2, 4 and 8 seconds: the delay belongs
	  to the attempt it precedes, so the first goes out at once and the three
	  after it wait two, four and eight seconds. After the fourth failure the
	  device closes its own window and says the button must be pressed again.

	  The two halves of the claim share that one cadence. The *operator*
	  half's budget lives at the service, it is four attempts on the same 0,
	  2, 4 and 8 seconds, and the sequence is what fixes the count in both
	  places, so #134's five is superseded. A Learner reads one cadence in
	  two files rather than two cadences that happen to both be bounded.

	  This budget is still not shared with the retrieval poll below, because
	  the two bound different things: this bounds a submission, and the poll
	  is the waiting state.

config COURSE_CLAIM_POLL_SECONDS
	int "Seconds between retrieval polls while a window is open"
	default 5
	range 1 60
	depends on COURSE_CLAIM
	help
	  How the device learns its certificate was issued. A fresh connection
	  each time, closed after, bounded only by the window timer.

	  A fresh connection rather than one held open for ten minutes: it keeps
	  #158's one-connection-at-a-time decision intact with no connection
	  lifetime state to carry, and it makes the poll the same run_request()
	  as every other Tier 7 exchange rather than the tier's only long-lived
	  socket with its own idle-timeout handling.

endmenu

menu "Tier 8 credential lifecycle"

config COURSE_TIME_FLOOR_SEED
	string "Build time this image seeds its Time floor with"
	default "2026-09-01T00:00:00Z"
	help
	  RFC 3339 in UTC, exactly as ./course build firmware writes it: the
	  moment the image was built. It is compiled into the image and so
	  covered by the image signature, which is what makes it evidence.

	  The Time floor starts here and rises to the created_at of every
	  Release manifest whose signature verifies. It never falls, except to
	  someone who can rewrite the flash, and it judges only this device's
	  own Operational certificate. It is not a clock: see time_floor.h.

	  The default is only for a standalone build of this tree, and it is
	  deliberately not in the future: a floor ahead of real time would
	  refuse every certificate issued before it and could never come back.

config COURSE_RENEWAL_ATTEMPTS
	int "Renewal attempts on one poll that says renew"
	default 4
	range 1 10
	help
	  #148's cadence, the claim's: 0, 2, 4 and 8 seconds, the delay
	  belonging to the attempt it precedes. After the last one the device
	  keeps its current identity and waits for a later poll that still
	  says renew. The poll interval is the outer backoff, and there is no
	  third cadence (#212).

endmenu

source "Kconfig.zephyr"

config COURSE_SIGNING_KEY_FINGERPRINT
	string "Fingerprint of the image verification key this image was built beside"
	default "unknown"
	help
	  Printed at boot so a Learner can see which key the build trusted, and
	  so a key regenerated after flashing diagnoses itself instead of looking
	  like a broken image.

	  Read the wording in main.c before changing this. The application cannot
	  see what the bootloader actually holds. This value comes from the same
	  build that produced the bootloader, so it is a claim about the build and
	  not an observation of the device. Verifying the bootloader itself is
	  Advanced Tier A's subject.

	  From Tier 4 the same fingerprint also describes the release manifest
	  verification key compiled into the application, because section 7 fixes
	  that one key signs both. Unlike the bootloader's copy, that one this
	  application does hold, and release_policy.c reports when it is absent.
```

## sysbuild.conf
```
SB_CONFIG_BOOTLOADER_MCUBOOT=y

# Sysbuild is told there is no signing, and that is deliberate.
#
# Sysbuild has one setting for a signing key, and it feeds two different jobs.
# The bootloader runs "imgtool getpub" on it, which needs only the public half.
# The application build runs "imgtool sign" on it, which needs the private
# half. One value cannot be both, and pointing it at the private key would name
# the Release signing key in a firmware build command, which
# docs/fixture-safety-contract.md forbids in as many words.
#
# So the two jobs are split, and so are the builds. This setting keeps the
# application image unsigned, exactly as Tier 0 and Tier 2 build it today, and
# the bootloader sysbuild produces here is discarded. Tier 4 needs the split
# for a second reason as well: its bootloader turns on downgrade prevention by
# security counter, which sysbuild's bootloader here knows nothing about. The bootloader that ships
# is built separately from bootloader/mcuboot.conf, which names only the public
# half, so no firmware build command ever names the Release signing key.
#
# The two bootloaders were compared: the separately built one resolves to a
# byte-identical Kconfig and the same 47,872 byte binary, so nothing is lost by
# building it outside sysbuild.
#
# Signing is a step the Learner runs afterwards, with the private key, on an
# image the build has already finished with.
SB_CONFIG_BOOT_SIGNATURE_TYPE_NONE=y

# The course uses swap-using-offset in every tier. See Tier 0 and Tier 2 for
# the reasoning, which Tier 4 does not change.
SB_CONFIG_MCUBOOT_MODE_SWAP_USING_OFFSET=y
```

## prj.conf
```kconfig
CONFIG_PRINTK=y
CONFIG_ESPTOOLPY_FLASHSIZE_4MB=y
CONFIG_MAIN_STACK_SIZE=8192
CONFIG_REBOOT=y

# Wi-Fi station and IPv4. Tier 2 speaks HTTPS to one literal address and checks
# the certificate against a name, so it still needs no name resolution. The
# name is compared, never looked up, and there is no resolver in this image.
#
# Tier 4 fetches two more objects over that same connection, the Release
# manifest and its detached signature. Verifying the manifest does not make an
# unverified connection acceptable, so nothing here is relaxed.
CONFIG_NETWORKING=y
CONFIG_WIFI=y
CONFIG_NET_IPV4=y
CONFIG_NET_IPV6=n
CONFIG_NET_DHCPV4=y
CONFIG_NET_TCP=y
CONFIG_NET_SOCKETS=y
CONFIG_NET_MGMT=y
CONFIG_NET_MGMT_EVENT=y
CONFIG_NET_MGMT_EVENT_INFO=y
CONFIG_NET_MGMT_EVENT_STACK_SIZE=4096
CONFIG_ESP32_WIFI_STA_AUTO_DHCPV4=y

CONFIG_NET_PKT_RX_COUNT=16
CONFIG_NET_PKT_TX_COUNT=16
CONFIG_NET_BUF_RX_COUNT=32
CONFIG_NET_BUF_TX_COUNT=32
CONFIG_NET_MAX_CONTEXTS=8

CONFIG_HTTP_CLIENT=y
CONFIG_JSON_LIBRARY=y

# TLS for the update and status connection.
#
# CONFIG_MBEDTLS is already on in Tier 0, because the Wi-Fi driver needs it.
# Tier 2 adds the socket layer, the credential store, and one ciphersuite.
# From Tier 7 these two are kept for what they select rather than for what they
# do. Nothing in this image calls setsockopt(SOL_TLS, ...) or
# tls_credential_add() any more: #138 established that Zephyr's socket TLS
# layer cannot carry a PSA key identifier as a client private key, and src/
# opaque_tls.c replaces it. But NET_SOCKETS_SOCKOPT_TLS is what "select
# PSA_CRYPTO" hangs off, and the mbedTLS configuration below is reached through
# it. Turning them off is a larger change than it looks and buys a few hundred
# bytes.
CONFIG_NET_SOCKETS_SOCKOPT_TLS=y
CONFIG_TLS_CREDENTIALS=y
CONFIG_MBEDTLS_CIPHERSUITE_TLS_ECDHE_ECDSA_WITH_AES_128_GCM_SHA256=y
CONFIG_MBEDTLS_ENABLE_HEAP=y
CONFIG_MBEDTLS_HEAP_SIZE=49152
# A TLS record can be 16 KiB, and the peer decides how big it makes one.
#
# This was 2048 while Tier 3 was being built, because every response Tier 2
# had ever fetched over TLS was a small JSON record that fitted. Tier 3 is the
# first tier to download a firmware image over the verified connection, and the
# Go service sends that in full sized records. The client cannot hold one,
# mbedTLS treats it as fatal, and the socket layer returns -ECONNABORTED before
# a single byte reaches the flash writer.
#
# The symptom is misleading: "ota.request failed err=-113" after a handshake
# the same log line says succeeded. Nothing in the failure mentions buffers.
#
# Tier 2 now sets 16384 for the same reason. See issue #62.
CONFIG_MBEDTLS_SSL_MAX_CONTENT_LEN=16384
CONFIG_NET_SOCKETS_TLS_MAX_CONTEXTS=2

# The trust anchor is compiled in as DER, so the PEM parser is not needed.
#
# Tier 4 adds a second compiled-in key, the release manifest verification key,
# and it stays off for that too. The build strips it to a bare 65-byte EC point
# that PSA imports directly. Measured on issue #65: turning PEM parsing back on
# costs 1696 bytes of .text and 228 of .flash.rodata to do at run time what the
# build does for free, and puts a text parser on the path to a trust decision.
CONFIG_MBEDTLS_PEM_PARSE_C=n

# Verifying the Release manifest needs no new Kconfig symbol at all.
#
# psa_hash_compute, mbedtls_ecdsa_der_to_raw, psa_import_key and
# psa_verify_hash are already linked into the untouched Tier 3 image, pulled in
# by two lines nobody set for this purpose: the ciphersuite above selects
# PSA_WANT_ALG_ECDSA, PSA_WANT_ALG_SHA_256 and the ECC key types and implies
# PSA_WANT_ECC_SECP_R1_256, and CONFIG_NET_SOCKETS_SOCKOPT_TLS does
# "select PSA_CRYPTO". psa_crypto_init() is already called from Zephyr's own
# SYS_INIT.
#
# The two lines below are assertions, not requests. They are already y, they
# change no bytes, and they are here so that a future change to the ciphersuite
# fails the build rather than quietly removing a verifier. release_policy.c
# carries the same statement as compile-time #error probes, because a symbol
# being set is not the same as a driver being present.
#
# Do not reach for CONFIG_MBEDTLS_ECDSA_C, CONFIG_MBEDTLS_ECP_C or
# CONFIG_MBEDTLS_ECP_DP_SECP256R1_ENABLED. This tree is Mbed TLS 4.1.0 with the
# separate tf-psa-crypto module and those symbols do not exist here; curves and
# algorithms are selected only through PSA_WANT_*.
CONFIG_PSA_WANT_ALG_ECDSA=y
CONFIG_PSA_WANT_ECC_SECP_R1_256=y

# Certificate validity dates are deliberately not checked.
#
# This board has no real-time clock. With CONFIG_MBEDTLS_HAVE_TIME_DATE=y and
# no time source the clock reads 1970, every certificate is "not yet valid",
# and every handshake fails forever. The option is orthogonal to chain and name
# checking, so leaving it off costs neither of those.
#
# The consequence is real and belongs in the Weakness ledger: this device would
# accept an expired certificate. Tier 8 is where credential lifetime becomes
# the subject.
CONFIG_MBEDTLS_HAVE_TIME_DATE=n

# Reading the verification flags after a refusal, so the device can say which
# check failed instead of only that something did.
CONFIG_MBEDTLS_X509_CRT_PARSE_C=y

# Writing the downloaded image into the secondary slot and asking MCUboot to
# swap it in. Tier 0 deliberately added no check here at all; Tier 4 decides
# whether to write before the transfer starts, and whether to request the swap
# after the bytes have been hashed.
CONFIG_FLASH=y
CONFIG_FLASH_MAP=y
CONFIG_STREAM_FLASH=y
CONFIG_IMG_MANAGER=y
CONFIG_IMG_ERASE_PROGRESSIVELY=y
CONFIG_MCUBOOT_IMG_MANAGER=y

# The course network may publish the same name on 2.4 GHz and 5 GHz. Scanning
# every channel makes the board pick the 2.4 GHz radio it can actually use.
CONFIG_ESP32_WIFI_STA_SCAN_ALL=y
CONFIG_ESP32_WIFI_STA_RECONNECT=y

# Tier 5: the storage partition's first use in this course.
#
# The 192 KiB storage partition at 0x3b0000 has been in the pinned flash map
# since Tier 0 and no tier has ever written to it. Tier 5 needs somewhere for
# the download progress record and the trial failure count to survive a power
# cut, and this is what that partition is for.
#
# NVS directly rather than the settings subsystem. Settings is built on NVS
# here, so it is a layer of ergonomics over a record with four fields, and in
# the one tier whose subject is what survives a power cut a Learner is better
# served by seeing the write that matters.
CONFIG_NVS=y

# Tier 5: the watchdog that resets a trial image which hangs before it can
# report failure.
#
# Nothing in firmware/ has ever set this, and the esp32 driver actively
# disables the hardware during its own init, so the watchdog is off until an
# application turns it on and calls wdt_setup(). An image that hangs on a board
# with no watchdog running looks exactly like a control working.
#
# Read the COURSE_TRIAL_HANG help text before assuming this catches every hang.
# It does not, and what it misses is in the Tier 5 ledger.
CONFIG_WATCHDOG=y

# Reading back the image from the secondary slot to hash it.
#
# Tier 4 hashed the bytes as they streamed past, which a resumable download
# cannot do: after a power cut the hash state is gone, and persisting SHA-256
# midstate would be a great deal of unpleasantness for no gain. Tier 5 hashes
# the slot once the transfer completes instead.
#
# That is strictly the better check. Tier 4's comment says the digest protects
# the upgrade request, and hashing the slot makes that true of what is actually
# in the flash rather than of what the device believes it wrote.
CONFIG_FLASH_PAGE_LAYOUT=y

# Tier 6: a device identity key generated on the board.
#
# PSA_WANT_ALG_ECDSA and PSA_WANT_ECC_SECP_R1_256 are already on above, from
# Tier 4's manifest verification. Generating a key rather than only verifying
# with one needs the keypair types as well.
CONFIG_PSA_WANT_KEY_TYPE_ECC_KEY_PAIR_GENERATE=y
CONFIG_PSA_WANT_KEY_TYPE_ECC_KEY_PAIR_EXPORT=y
CONFIG_PSA_WANT_ALG_SHA_256=y

# PSA_WANT_KEY_TYPE_ECC_PUBLIC_KEY is not optional and it fails silently.
#
# MBEDTLS_PK_MAX_PUBKEY_RAW_LEN is defined as 0 without it (pk.h:91) and that
# constant sizes a buffer in every PK context, so the failure is a zero length
# public key rather than a build error. It is currently on in some builds only
# as a side effect of the Wi-Fi driver's WPA3 option, which is not something to
# depend on. Measured on issue #108.
CONFIG_PSA_WANT_KEY_TYPE_ECC_PUBLIC_KEY=y

# Writing a certification request. MBEDTLS_X509_CSR_WRITE_C selects nothing at
# all, and the CSR writer calls mbedtls_pk_write_pubkey_der(), which is
# compiled out without MBEDTLS_PK_WRITE_C. Both are named here rather than one
# being assumed to imply the other.
#
# MBEDTLS_PEM_WRITE_C is deliberately absent. The request goes over the wire as
# DER. Turning PEM writing on would partly reverse the size decision Tier 5
# made and explained when it set CONFIG_MBEDTLS_PEM_PARSE_C=n.
CONFIG_MBEDTLS_PK_WRITE_C=y
CONFIG_MBEDTLS_X509_CSR_WRITE_C=y
CONFIG_MBEDTLS_X509_USE_C=y

# Storing the private key, in the exact configuration section 8 fixes.
#
# Read the limitation with it. The AEAD key is SHA-256 over a device identifier
# and the entry uid, and on this part that identifier is six bytes of the
# factory MAC: a value the device broadcasts in every Wi-Fi frame and which
# esptool read-mac prints over the same cable used to dump the flash. This
# encrypts the key at rest against casual inspection and detects unauthenticated
# changes. It is not a protected root secret, it does not prevent record replay,
# and it does not protect the key from privileged firmware, a debugger, or a
# capable flash attacker.
#
# Zephyr says so itself at boot, and the course leaves that warning switched on:
#   WARNING: Using a potentially insecure PSA ITS encryption key provider.
CONFIG_SECURE_STORAGE=y
CONFIG_SECURE_STORAGE_ITS_TRANSFORM_IMPLEMENTATION_AEAD=y
CONFIG_SECURE_STORAGE_ITS_TRANSFORM_AEAD_SCHEME_AES_GCM=y
CONFIG_SECURE_STORAGE_ITS_TRANSFORM_AEAD_KEY_PROVIDER_DEVICE_ID_HASH=y
CONFIG_SECURE_STORAGE_ITS_STORE_IMPLEMENTATION_SETTINGS=y

# The device identifier the key provider hashes comes from hwinfo.
CONFIG_HWINFO=y

# Settings, which the ITS store writes through, and which brings its own NVS
# instance on the storage partition.
#
# Tier 5 mounted its own nvs_fs at the first byte of that same partition and
# explained at length why it chose NVS over settings. Both land on the same
# bytes and nothing detects it: nvs_mount() checks write block size, sector
# size and a count of at least two, and nothing else, so both mounts return 0
# and the damage does not wait for a write.
#
# Tier 6 keeps Tier 5's raw records and its reasoning, and stops mounting a
# second instance. recovery_state.c now writes through the instance settings
# already owns, reached with settings_storage_get(). The entry id spaces do not
# overlap: settings uses 0x8000 and above, Tier 5 uses 1, 2 and 3. Measured on
# issue #109, decided on issue #120.
CONFIG_SETTINGS=y
CONFIG_SETTINGS_NVS=y

# The provisioning interface.
#
# SHELL_MINIMAL is the load-bearing line. Without it KERNEL_SHELL is default y
# and implies INIT_STACKS, THREAD_MONITOR, THREAD_NAME and THREAD_STACK_INFO,
# so a plain CONFIG_SHELL=y would hand anyone with the cable thread
# introspection and a reboot command. Every one of those, and the built-in
# commands, history, tab completion and VT100 handling, is gated on the same
# !SHELL_MINIMAL condition, so one symbol turns the lot off and anything
# upstream adds the same way stays off too.
#
# SHELL_AUTOSTART is off so the application chooses when the shell runs.
# shell_init() still runs at boot from the backend; AUTOSTART only decides
# whether it calls shell_start() for you (shell.c:1369).
CONFIG_SHELL=y
CONFIG_SHELL_MINIMAL=y
CONFIG_SHELL_AUTOSTART=n
CONFIG_SHELL_BACKEND_SERIAL=y

# The provisioning shell's own thread, and the buffers around it.
#
# Every one of these three was found on the board, and each produced a failure
# that looked like something else.
#
# SHELL_STACK_SIZE defaults to 2048. Enrollment runs the entire certification
# request on this thread: loading the persistent PSA key out of Secure Storage
# decrypts an AES-GCM record through settings and NVS, and the CSR writer then
# encodes and signs. That overran 2 KiB and the symptom was an illegal
# instruction at an address in SRAM with a call trace pointing into gcm_mask,
# which reads like a fault inside the crypto library rather than like a stack
# that ran out. It is neither: it is a return address overwritten by the frame
# below it.
CONFIG_SHELL_STACK_SIZE=8192

# A stack that runs out should say so instead of jumping to whatever the data
# happened to be. The sentinel is checked on every context switch and turns the
# failure above into a named panic. It is here because the failure it names
# cost a debugging session, and because an unprovisioned board in front of a
# Learner is exactly where this path runs.
CONFIG_STACK_SENTINEL=y

# The station sends the issued certificate over this console. The command
# buffer defaults to 128 bytes, which is shorter than the certificate.
CONFIG_SHELL_CMD_BUFF_SIZE=256

# The serial backend's receive ring defaults to 64 bytes. The shell thread does
# not drain it fast enough when a host writes a long line in one go, and the
# first attempt at enrollment lost characters out of the middle of a 64
# character credential and acted on the corrupted text. Nothing reported the
# loss: a dropped character is not an error, it is simply a different command.
CONFIG_SHELL_BACKEND_SERIAL_RX_RING_BUFFER_SIZE=512

# --- Tier 7 ---------------------------------------------------------------
#
# The claim carries a certification request out and a certificate back, both
# inside a JSON body, so both travel base64. Go's encoding/json produces and
# consumes exactly this for a []byte without anybody writing an encoder.
CONFIG_BASE64=y

# psa_copy_key() moves the pending Operational key into its persistent slot.
#
# It is declared in tf-psa-crypto's psa/crypto.h and defined in its core, not
# behind a PSA_WANT_* symbol, so nothing here turns it on. This comment is here
# because #140 named it as the first thing Tier 7 had to check and the answer
# belongs beside the code rather than only in a ticket.

# The Claim window is opened from the system workqueue.
#
# The button's hold timer hands the work off there — shell_start() has no
# business running in an interrupt and neither does key generation — and that
# handler now also generates a P-256 key and writes a certification request.
# The default 1024 byte workqueue stack does not cover it. #158 measured this
# thread at 608 of 1024 before Tier 7 gave it anything to do.
#
# The key is volatile, so unlike Tier 6's enrollment path nothing here decrypts
# a Secure Storage record; the request writer is the expensive part. 4096 is
# half of what Tier 6 had to give the shell thread for the heavier job.
CONFIG_SYSTEM_WORKQUEUE_STACK_SIZE=4096

# Deliberately absent: CONFIG_INIT_STACKS, CONFIG_THREAD_MONITOR,
# CONFIG_THREAD_NAME, CONFIG_THREAD_STACK_INFO and the thread analyzer.
#
# The #158 spike turned all of them on to measure main's high water at 3224 of
# 8192. They are measurement instruments and not firmware: Tier 6 turned that
# introspection off deliberately with CONFIG_SHELL_MINIMAL, because it hands
# anyone with the cable a map of every thread. A spike image may carry them and
# a shipped one may not.

# The onboard status beacon. The DevKitC-1 shows the machine state on its
# WS2812 RGB LED as well as on the console; CONFIG_COURSE_BEACON_LED in
# firmware/common turns that off again for a board that has no such LED.
CONFIG_LED_STRIP=y
```

## src/health_gate.h
```c
/*
 * The local health gate Tier 5 runs before it confirms an image.
 *
 * MCUboot starts a freshly swapped image as an unconfirmed test image. It has
 * already checked the signature and the security counter, which is everything
 * a bootloader can know. What it cannot know is whether the image works, and
 * that is what this gate is for.
 *
 * Four named checks, then a 60 second window. Every check is local. Section 6
 * is explicit that loss of network service alone must not fail the gate,
 * because local application health is separated from optional backend
 * reachability, so nothing here asks whether the service can be reached. A
 * device on a dead network passes this gate and confirms, and that is the
 * required behaviour rather than a gap in it.
 *
 * Every check runs and every result is printed, rather than stopping at the
 * first failure. This is the same choice Tier 4 made with its eight refusal
 * reasons: a Learner diagnosing a prepared failure needs to see which checks
 * passed, not only which one failed first. It is also what makes the
 * fail-health release legible, since one named check fails while three
 * visibly pass.
 */

#ifndef COURSE_HEALTH_GATE_H
#define COURSE_HEALTH_GATE_H

#include <stdbool.h>
#include <stddef.h>

enum health_result {
	/* Every check passed and the window elapsed with the device still
	 * healthy. The caller may confirm the image.
	 */
	HEALTH_PASSED = 0,
	/* A named check failed. The name is in the reason string. */
	HEALTH_FAILED,
	/* The window expired without every check being satisfied. Distinct
	 * from HEALTH_FAILED because the specification separates a failed
	 * check from an expired timer, and the two prepared releases that
	 * produce them are what make that separation observable.
	 */
	HEALTH_TIMEOUT,
};

/* Starts the watchdog that resets a trial image which hangs before it can
 * report failure.
 *
 * Nothing in this course has ever enabled the watchdog, and the esp32 driver
 * actively disables the hardware during its own init, so it is off until this
 * runs. An image that hangs on a board with no watchdog running looks exactly
 * like a control working.
 *
 * This catches an ordinary hung thread, which was checked on the board rather
 * than assumed from the driver source. The driver programs stage 0 as an
 * interrupt whose handler calls wdt_hal_handle_intr(), documented as clearing
 * the interrupt and feeding the watchdog, which would mean only a hang that
 * also blocked interrupts ever reached the resetting stage.
 *
 * It does not work out that way. wdt_hal_handle_intr() must be called with
 * write protection disabled, wdt_esp32_feed() unseals and reseals around its
 * own feed, and wdt_esp32_isr() does neither. So the handler's feed does not
 * take effect and stage 1 resets the chip, which is what the board shows as
 * rst:0x7 (TG0_WDT_HPSYS).
 *
 * That is a property of this driver rather than a guarantee, and an upstream
 * fix to the handler would change it silently. Tier 5 says so rather than
 * presenting it as a promise.
 */
int health_gate_start_watchdog(void);

/* Runs the four checks and then the window.
 *
 * reason is filled with the name of the check that failed, or with the name of
 * the check that was still unsatisfied when the window expired. It is left
 * empty on success.
 */
enum health_result health_gate_run(char *reason, size_t reason_len);

/* Reports that the reference product did a unit of work.
 *
 * Called from the beacon's own thread, and observed by the beacon-running
 * check. It does not feed the watchdog: the two questions are different, and
 * collapsing them breaks one of the trial behaviours.
 */
void health_gate_note_beacon(void);

/* Feeds the watchdog.
 *
 * Called only from the thread that drives the device's main work, and never
 * from a timer or an interrupt. That is the whole reason a hung thread is
 * caught at all: a feed on a k_timer keeps running while the thread it is
 * supposed to be vouching for is dead, so the watchdog would guard nothing.
 *
 * It is deliberately not conditional on the beacon advancing. The watchdog's
 * job is a thread that has stopped entirely; a beacon that has stopped while
 * the thread still runs is the health gate's job, and it produces a controlled
 * reboot after the window rather than a reset ten seconds in.
 */
void health_gate_feed(void);

#endif /* COURSE_HEALTH_GATE_H */
```
