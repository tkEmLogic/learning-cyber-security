## firmware/common/Kconfig
```kconfig
# Configuration shared by every tier of the Reference product.
#
# Every value here is generated by `./course build firmware` from the
# disposable Course environment. Nothing in this file carries a real
# credential: the Wi-Fi passphrase arrives from `.course-secrets/wifi.conf`,
# which Git ignores.
#
# A tier that needs its own options declares them in its own Kconfig. This
# file holds only what every tier uses.

menu "Course Reference product"

config COURSE_WIFI_SSID
	string "Course Wi-Fi network name"
	default ""
	help
	  The 2.4 GHz WPA2 network that the Reference product joins. The board
	  refuses to start its OTA client while this is empty.

config COURSE_WIFI_PSK
	string "Course Wi-Fi passphrase"
	default ""
	help
	  The WPA2 passphrase for the course network. Tier 0 stores it in plain
	  text in the built image on purpose, and the Weakness ledger records
	  that.

config COURSE_WIFI_CONNECT_TIMEOUT_SECONDS
	int "Seconds to wait for an address"
	default 60

config COURSE_OTA_HOST
	string "OTA service IPv4 address"
	default "127.0.0.1"
	help
	  The literal address of the local OTA service. Tier 0 uses an address,
	  not a name, so the device performs no name lookup.

config COURSE_OTA_PORT
	int "OTA service TCP port"
	default 8080

config COURSE_DEVICE_ID
	string "Synthetic device identifier"
	default "beacon-development-shared"
	help
	  The shared development identifier. Every Tier 0 device reports the
	  same value, which is the weakness the device-ID spoofing fixture
	  demonstrates.

config COURSE_RELEASE_ID
	string "Release identifier built into this image"
	default "tier-00-baseline"
	help
	  The device compares this value with the release the OTA service
	  assigns. A different value starts an update. Tier 0 has no other
	  version policy.

config COURSE_IMAGE_LABEL
	string "Human-readable label for this image"
	default "baseline"

config COURSE_BEACON_STATE
	string "Simulated machine state at boot"
	default "steady"
	help
	  One of steady, fast, or slow. The altered image uses a different
	  value so the Learner can see on the serial console which image runs.

config COURSE_POLL_INTERVAL_SECONDS
	int "Seconds between status reports"
	default 30

config COURSE_BEACON_LED
	bool "Also show the beacon state on the onboard LED"
	depends on LED_STRIP
	default y
	help
	  The ESP32-C6-DevKitC-1 has one addressable RGB LED, a WS2812 on
	  GPIO8, and the board overlay describes it as a led-strip alias. With
	  this option the beacon state is shown there as well as on the serial
	  console: on for steady, and blinking at the state's toggle period for
	  the two error states.

	  The console output does not change when this option is on or off. The
	  console is where the course collects its evidence, and several tiers
	  quote its lines, so the LED is always an addition and never a
	  replacement.

	  Turn this off when you build for a board that has no such LED, or
	  when a bright LED is unwelcome. The firmware then behaves exactly as
	  it did before, and says so in its boot banner. A board whose
	  devicetree has no led-strip alias switches the LED off by itself, so
	  you do not have to remember to.

config COURSE_BEACON_LED_BRIGHTNESS
	int "Brightness of each LED channel, 1 to 255"
	depends on COURSE_BEACON_LED
	range 1 255
	default 8
	help
	  How hard the LED's lit colour channel is driven. Steady lights the
	  green channel alone, and the two blinking error states light the red
	  channel alone, so only one channel is ever on at a time.

	  A WS2812 at its full value of 255 is uncomfortably bright to sit
	  beside on a desk, and it draws about twenty milliamps per channel. On
	  the DevKitC-1, 24 was still too bright to look at comfortably, and 8
	  was easy to see indoors. Raise it if you are working in daylight.

endmenu
```

## firmware/mcuboot-refusal-reason/Kconfig
```kconfig
# SPDX-License-Identifier: Apache-2.0

config COURSE_REFUSAL_REASON
	bool "Report what the bootloader saw in an image before it judged it"
	depends on BOOT_IMAGE_ACCESS_HOOKS
	help
	  Print four observable facts about a candidate image before MCUboot
	  decides whether to accept it: whether it has an image header, whether
	  it has a TLV area, whether it carries a signature, and whether that
	  signature names the key compiled into this bootloader.

	  MCUboot itself reports only that an image is not valid. It never says
	  why, because bootutil_img_validate() returns a single fih_ret with no
	  cause attached. That is fault injection hardening rather than an
	  oversight: one return value is harder to skip past with a glitch than
	  a set of them.

	  This hook does not change that decision and must never appear to. It
	  reports and then returns FIH_BOOT_HOOK_REGULAR, so MCUboot performs
	  its normal validation and makes every accept and reject call.

if COURSE_REFUSAL_REASON

config COURSE_REFUSAL_REASON_SLOT_OFFSET
	hex "Second offset to look for an image header"
	default 0x1000
	help
	  Swap using offset places a downloaded image one flash sector into the
	  secondary slot rather than at its start. MCUboot knows that offset
	  from its own swap state, but boot_image_check_hook() is handed only an
	  image index and a slot number, so this code has to find the image on
	  its own.

	  It looks for the image magic at the start of the slot first, then
	  here. The value is the erase sector size of the flash device, which is
	  4096 bytes on the ESP32-C6.

endif # COURSE_REFUSAL_REASON
```
