## CMakeLists.txt
```
# SPDX-License-Identifier: Apache-2.0

cmake_minimum_required(VERSION 3.20.0)

list(APPEND EXTRA_ZEPHYR_MODULES ${CMAKE_CURRENT_SOURCE_DIR}/../common)

find_package(Zephyr REQUIRED HINTS $ENV{ZEPHYR_BASE})
project(tier_05_recovery)

test_sysbuild()

# The trust anchor is compiled into the image, the same way the Wi-Fi
# credentials are. ./course build firmware writes course_ca_der.inc from the
# Course certificate authority in .course-secrets/, and passes the directory
# here.
#
# Without it the build falls back to anchor/, which holds an empty anchor. The
# repository then still builds standalone, and the resulting image refuses to
# connect and says why. An image that trusts nothing is the right failure: the
# alternative is an image that trusts anything.
# The directory arrives in the environment rather than as a CMake cache
# variable. Sysbuild keeps an image-scoped -D<image>_VAR in its own cache and
# does not forward an arbitrary one into the image build, so a cache variable
# silently produced an image with no anchor. The environment reaches every
# image's configure step.
if(DEFINED ENV{COURSE_CA_INC_DIR})
	zephyr_include_directories($ENV{COURSE_CA_INC_DIR})
else()
	zephyr_include_directories(anchor)
endif()

# The release manifest verification key arrives the same way, from
# ./course build firmware, which writes release_pubkey.inc from the public half
# of the Learner's Release signing key. It has its own variable because it is
# its own decision: the certificate authority says which service to talk to,
# and this key says whose release metadata to believe. Nothing about one
# implies the other.
#
# Without it the build falls back to anchor/, which holds no key, and the
# resulting image verifies no manifest and says so at boot and at every
# refusal. That is the same honest failure the empty trust anchor produces.
if(DEFINED ENV{COURSE_RELEASE_KEY_INC_DIR})
	zephyr_include_directories($ENV{COURSE_RELEASE_KEY_INC_DIR})
else()
	zephyr_include_directories(anchor)
endif()

target_sources(app PRIVATE
	src/health_gate.c
	src/main.c
	src/ota_client.c
	src/recovery_state.c
	src/release_policy.c
)
```

## Kconfig
```
# Configuration Tier 5 adds on top of the shared options in firmware/common.
#
# The first block is inherited from Tier 2, which taught the device to verify
# the service it talks to. Tier 4 keeps every word of it: the manifest is
# fetched over that same verified connection, and a signed manifest does not
# make an unverified connection acceptable.

menu "Tier 2 authenticated service"

config COURSE_OTA_SERVICE_NAME
	string "Name the service certificate must carry"
	default "ota.course.example"
	help
	  The device connects to CONFIG_COURSE_OTA_HOST, a literal address, and
	  then requires the certificate presented there to carry this name.

	  The name is never resolved. There is no DNS resolver in this image.
	  It is the value the TLS layer compares the certificate against, which
	  is why a wrong name is refused even though the address was right.

config COURSE_OTA_TLS_PORT
	int "OTA service TLS port"
	default 8443
	help
	  Tier 2 moves release records, firmware bytes, and status events to
	  this port. Health and the Course environment marker stay on the plain
	  HTTP port, because a safety check must not depend on the control it
	  is used to test.

config COURSE_TRUST_ANCHOR_FINGERPRINT
	string "Fingerprint of the trust anchor compiled into this image"
	default "unknown"
	help
	  Printed at boot so a stale trust anchor diagnoses itself instead of
	  looking like a broken network. ./course build firmware writes this
	  value, and ./course service certificate prints the same one.

	  The device does not compute it. Computing a digest on the board to
	  describe material the board already holds would prove nothing that the
	  build cannot state.

endmenu

menu "Tier 4 release policy"

config COURSE_SECURITY_COUNTER
	int "Security counter of the running image"
	default 1
	help
	  The anti-rollback counter this image was signed with. The same value
	  goes into the signed MCUboot image TLV and into the signed Release
	  manifest, and ./course build firmware writes it from the one constant
	  in internal/courseapp/tier04.go so the two cannot disagree.

	  The application refuses a manifest whose counter is lower than this
	  one. Equal is allowed; lower never is. That check saves a wasted
	  download and is not the boundary: the bootloader is what actually
	  stops a downgrade, by comparing the candidate's counter against the
	  counter in the image already in the primary slot.

	  It is deliberately not derived from the human-readable version.
	  "Human-readable versions override the security counter" is the
	  failure this tier is about.

config COURSE_HARDWARE_REVISION
	int "Product hardware revision this build asserts"
	default 1
	help
	  The product hardware revision a release is targeted at, compared
	  against the manifest's signed hardware_revision_min..max range.

	  It is asserted, not read. The chip reports its silicon stepping from
	  eFuse and the boot banner prints that beside this value, but nothing
	  on this part reports which product a board was built into. Product
	  identity is asserted and protected; a value the device reads is not a
	  claim anybody signed.

config COURSE_RELEASE_CHANNEL
	string "Release channel this device follows"
	default "stable"
	help
	  One of stable or candidate. The device refuses a manifest published
	  to any other channel, even a correctly signed one.

	  This is the check that has no attacker behind it. Nobody without the
	  Release signing key can produce a manifest that gets this far, so a
	  channel mismatch means whoever holds the key published something for
	  the wrong devices. The device cannot tell that from a leaked key, and
	  refusing is the same either way.

endmenu

menu "Tier 5 recoverable install"

choice COURSE_TRIAL_BEHAVIOUR
	prompt "How this image behaves during its trial boot"
	default COURSE_TRIAL_HEALTHY
	help
	  Tier 5 publishes five images from this one source tree. They differ
	  only in what happens between the trial boot and the confirmation,
	  which is the whole subject of the tier, so the difference a Learner
	  has to understand is one conditional rather than a diff between five
	  directories.

	  Every one of them is a real, correctly signed image. None of them is
	  hostile: an unhealthy release is the manufacturer publishing something
	  that does not work, which section 11 names beside the attacks.

config COURSE_TRIAL_HEALTHY
	bool "Healthy: pass every check and confirm"
	help
	  The release that works. It passes the four health checks, survives the
	  60 second window, and calls boot_write_img_confirmed().

config COURSE_TRIAL_CRASH
	bool "Crash: fault before the health gate starts"
	help
	  Faults deliberately before the gate runs, so it is distinct from
	  FAIL_HEALTH, which requires the gate to have run. The image never
	  reaches the code that could record why, so the device identifies it by
	  reset cause and by the absence of a written reason.

config COURSE_TRIAL_HANG
	bool "Hang: block interrupts and spin"
	help
	  Takes irq_lock() and spins, which is the only kind of hang this
	  configuration actually catches.

	  The Zephyr esp32 watchdog driver programs stage 0 as an interrupt and
	  its ISR feeds the watchdog at the end, so stage 1, the stage that
	  resets the chip, is reached only when interrupts are blocked. A hang
	  that still services interrupts is fed forever and never reset. That is
	  a real residual availability risk and it is in the Tier 5 ledger
	  rather than hidden behind a watchdog that appears to catch everything.

config COURSE_TRIAL_FAIL_HEALTH
	bool "Fail health: fail one named check"
	help
	  Fails a single named check while the other three visibly pass, so the
	  cause is read rather than inferred from where the output stopped.

config COURSE_TRIAL_TIMEOUT_HEALTH
	bool "Timeout health: never reach a verdict"
	help
	  Leaves one check unsatisfied so the 60 second window expires without a
	  verdict. Distinct from FAIL_HEALTH: the specification separates a
	  failed check from an expired timer, and these two images are what make
	  that separation observable.

endchoice

config COURSE_TRIAL_BEHAVIOUR_NAME
	string
	default "healthy" if COURSE_TRIAL_HEALTHY
	default "crash" if COURSE_TRIAL_CRASH
	default "hang" if COURSE_TRIAL_HANG
	default "fail-health" if COURSE_TRIAL_FAIL_HEALTH
	default "timeout-health" if COURSE_TRIAL_TIMEOUT_HEALTH
	help
	  The name this image prints for its own trial behaviour. Not settable:
	  it follows the choice above so the two cannot disagree.

config COURSE_HEALTH_GATE_SECONDS
	int "Length of the local health window"
	default 60
	help
	  Section 6 fixes this at 60 seconds. It is measured from the end of the
	  boot-time checks rather than from boot, so a slow boot cannot eat the
	  window and make the gate's length depend on something it is not
	  measuring.

config COURSE_TRIAL_FAILURE_LIMIT
	int "How many trials of one release before it is refused"
	default 3
	help
	  Bounds the revert loop. A release that installs cleanly and then fails
	  its trial would otherwise be offered, installed, fail and revert
	  forever, because nothing about it is invalid.

	  The count is incremented when a trial begins, never when one fails. A
	  crashing image never reaches code that could record a failure, and a
	  hung one is reset from interrupt context where an NVS write is not
	  safe, so a count kept on failure would miss exactly the two failures
	  that most need counting.

	  This is persistent state about a release, and it is not the
	  application-managed accepted-image database section 6 forbids. That
	  prohibition exists so a failed trial can always revert to the
	  previously confirmed image. This count never blocks a revert; it only
	  stops the device re-attempting a release it has already proven bad.

config COURSE_SOURCE_REVISION
	string "Source revision this image was built from"
	default "unknown"
	help
	  The git hash of the tree this image was built from, with -dirty
	  appended when the tree was dirty, exactly as git describe --dirty
	  reports it.

	  It also travels in a protected MCUboot TLV at tag 0x00A0, so it is
	  covered by the image signature and cannot be rewritten without
	  invalidating the image. This Kconfig value is what the build put in
	  that TLV.

	  It identifies the build and not the release. A Learner's own build
	  carries their hash and will usually be dirty, and will not match a
	  published one. The course claims no reproducible builds, and this
	  value is not evidence of any.

	  What it answers is "what am I running" after a revert, when the
	  Release manifest that described the image was consumed long ago and
	  the device no longer holds it.

endmenu

source "Kconfig.zephyr"

config COURSE_SIGNING_KEY_FINGERPRINT
	string "Fingerprint of the image verification key this image was built beside"
	default "unknown"
	help
	  Printed at boot so a Learner can see which key the build trusted, and
	  so a key regenerated after flashing diagnoses itself instead of looking
	  like a broken image.

	  Read the wording in main.c before changing this. The application cannot
	  see what the bootloader actually holds. This value comes from the same
	  build that produced the bootloader, so it is a claim about the build and
	  not an observation of the device. Verifying the bootloader itself is
	  Advanced Tier A's subject.

	  From Tier 4 the same fingerprint also describes the release manifest
	  verification key compiled into the application, because section 7 fixes
	  that one key signs both. Unlike the bootloader's copy, that one this
	  application does hold, and release_policy.c reports when it is absent.
```

## prj.conf
```kconfig
CONFIG_PRINTK=y
CONFIG_ESPTOOLPY_FLASHSIZE_4MB=y
CONFIG_MAIN_STACK_SIZE=8192
CONFIG_REBOOT=y

# Wi-Fi station and IPv4. Tier 2 speaks HTTPS to one literal address and checks
# the certificate against a name, so it still needs no name resolution. The
# name is compared, never looked up, and there is no resolver in this image.
#
# Tier 4 fetches two more objects over that same connection, the Release
# manifest and its detached signature. Verifying the manifest does not make an
# unverified connection acceptable, so nothing here is relaxed.
CONFIG_NETWORKING=y
CONFIG_WIFI=y
CONFIG_NET_IPV4=y
CONFIG_NET_IPV6=n
CONFIG_NET_DHCPV4=y
CONFIG_NET_TCP=y
CONFIG_NET_SOCKETS=y
CONFIG_NET_MGMT=y
CONFIG_NET_MGMT_EVENT=y
CONFIG_NET_MGMT_EVENT_INFO=y
CONFIG_NET_MGMT_EVENT_STACK_SIZE=4096
CONFIG_ESP32_WIFI_STA_AUTO_DHCPV4=y

CONFIG_NET_PKT_RX_COUNT=16
CONFIG_NET_PKT_TX_COUNT=16
CONFIG_NET_BUF_RX_COUNT=32
CONFIG_NET_BUF_TX_COUNT=32
CONFIG_NET_MAX_CONTEXTS=8

CONFIG_HTTP_CLIENT=y
CONFIG_JSON_LIBRARY=y

# TLS for the update and status connection.
#
# CONFIG_MBEDTLS is already on in Tier 0, because the Wi-Fi driver needs it.
# Tier 2 adds the socket layer, the credential store, and one ciphersuite.
CONFIG_NET_SOCKETS_SOCKOPT_TLS=y
CONFIG_TLS_CREDENTIALS=y
CONFIG_MBEDTLS_CIPHERSUITE_TLS_ECDHE_ECDSA_WITH_AES_128_GCM_SHA256=y
CONFIG_MBEDTLS_ENABLE_HEAP=y
CONFIG_MBEDTLS_HEAP_SIZE=49152
# A TLS record can be 16 KiB, and the peer decides how big it makes one.
#
# This was 2048 while Tier 3 was being built, because every response Tier 2
# had ever fetched over TLS was a small JSON record that fitted. Tier 3 is the
# first tier to download a firmware image over the verified connection, and the
# Go service sends that in full sized records. The client cannot hold one,
# mbedTLS treats it as fatal, and the socket layer returns -ECONNABORTED before
# a single byte reaches the flash writer.
#
# The symptom is misleading: "ota.request failed err=-113" after a handshake
# the same log line says succeeded. Nothing in the failure mentions buffers.
#
# Tier 2 now sets 16384 for the same reason. See issue #62.
CONFIG_MBEDTLS_SSL_MAX_CONTENT_LEN=16384
CONFIG_NET_SOCKETS_TLS_MAX_CONTEXTS=2

# The trust anchor is compiled in as DER, so the PEM parser is not needed.
#
# Tier 4 adds a second compiled-in key, the release manifest verification key,
# and it stays off for that too. The build strips it to a bare 65-byte EC point
# that PSA imports directly. Measured on issue #65: turning PEM parsing back on
# costs 1696 bytes of .text and 228 of .flash.rodata to do at run time what the
# build does for free, and puts a text parser on the path to a trust decision.
CONFIG_MBEDTLS_PEM_PARSE_C=n

# Verifying the Release manifest needs no new Kconfig symbol at all.
#
# psa_hash_compute, mbedtls_ecdsa_der_to_raw, psa_import_key and
# psa_verify_hash are already linked into the untouched Tier 3 image, pulled in
# by two lines nobody set for this purpose: the ciphersuite above selects
# PSA_WANT_ALG_ECDSA, PSA_WANT_ALG_SHA_256 and the ECC key types and implies
# PSA_WANT_ECC_SECP_R1_256, and CONFIG_NET_SOCKETS_SOCKOPT_TLS does
# "select PSA_CRYPTO". psa_crypto_init() is already called from Zephyr's own
# SYS_INIT.
#
# The two lines below are assertions, not requests. They are already y, they
# change no bytes, and they are here so that a future change to the ciphersuite
# fails the build rather than quietly removing a verifier. release_policy.c
# carries the same statement as compile-time #error probes, because a symbol
# being set is not the same as a driver being present.
#
# Do not reach for CONFIG_MBEDTLS_ECDSA_C, CONFIG_MBEDTLS_ECP_C or
# CONFIG_MBEDTLS_ECP_DP_SECP256R1_ENABLED. This tree is Mbed TLS 4.1.0 with the
# separate tf-psa-crypto module and those symbols do not exist here; curves and
# algorithms are selected only through PSA_WANT_*.
CONFIG_PSA_WANT_ALG_ECDSA=y
CONFIG_PSA_WANT_ECC_SECP_R1_256=y

# Certificate validity dates are deliberately not checked.
#
# This board has no real-time clock. With CONFIG_MBEDTLS_HAVE_TIME_DATE=y and
# no time source the clock reads 1970, every certificate is "not yet valid",
# and every handshake fails forever. The option is orthogonal to chain and name
# checking, so leaving it off costs neither of those.
#
# The consequence is real and belongs in the Weakness ledger: this device would
# accept an expired certificate. Tier 8 is where credential lifetime becomes
# the subject.
CONFIG_MBEDTLS_HAVE_TIME_DATE=n

# Reading the verification flags after a refusal, so the device can say which
# check failed instead of only that something did.
CONFIG_MBEDTLS_X509_CRT_PARSE_C=y

# Writing the downloaded image into the secondary slot and asking MCUboot to
# swap it in. Tier 0 deliberately added no check here at all; Tier 4 decides
# whether to write before the transfer starts, and whether to request the swap
# after the bytes have been hashed.
CONFIG_FLASH=y
CONFIG_FLASH_MAP=y
CONFIG_STREAM_FLASH=y
CONFIG_IMG_MANAGER=y
CONFIG_IMG_ERASE_PROGRESSIVELY=y
CONFIG_MCUBOOT_IMG_MANAGER=y

# The course network may publish the same name on 2.4 GHz and 5 GHz. Scanning
# every channel makes the board pick the 2.4 GHz radio it can actually use.
CONFIG_ESP32_WIFI_STA_SCAN_ALL=y
CONFIG_ESP32_WIFI_STA_RECONNECT=y

# Tier 5: the storage partition's first use in this course.
#
# The 192 KiB storage partition at 0x3b0000 has been in the pinned flash map
# since Tier 0 and no tier has ever written to it. Tier 5 needs somewhere for
# the download progress record and the trial failure count to survive a power
# cut, and this is what that partition is for.
#
# NVS directly rather than the settings subsystem. Settings is built on NVS
# here, so it is a layer of ergonomics over a record with four fields, and in
# the one tier whose subject is what survives a power cut a Learner is better
# served by seeing the write that matters.
CONFIG_NVS=y

# Tier 5: the watchdog that resets a trial image which hangs before it can
# report failure.
#
# Nothing in firmware/ has ever set this, and the esp32 driver actively
# disables the hardware during its own init, so the watchdog is off until an
# application turns it on and calls wdt_setup(). An image that hangs on a board
# with no watchdog running looks exactly like a control working.
#
# Read the COURSE_TRIAL_HANG help text before assuming this catches every hang.
# It does not, and what it misses is in the Tier 5 ledger.
CONFIG_WATCHDOG=y

# Reading back the image from the secondary slot to hash it.
#
# Tier 4 hashed the bytes as they streamed past, which a resumable download
# cannot do: after a power cut the hash state is gone, and persisting SHA-256
# midstate would be a great deal of unpleasantness for no gain. Tier 5 hashes
# the slot once the transfer completes instead.
#
# That is strictly the better check. Tier 4's comment says the digest protects
# the upgrade request, and hashing the slot makes that true of what is actually
# in the flash rather than of what the device believes it wrote.
CONFIG_FLASH_PAGE_LAYOUT=y

# The onboard status beacon. The DevKitC-1 shows the machine state on its
# WS2812 RGB LED as well as on the console; CONFIG_COURSE_BEACON_LED in
# firmware/common turns that off again for a board that has no such LED.
CONFIG_LED_STRIP=y
```

## src/health_gate.c
```c
#include "health_gate.h"
#include "ota_client.h"

#include <errno.h>
#include <stddef.h>
#include <string.h>

#include <zephyr/devicetree.h>
#include <zephyr/drivers/watchdog.h>
#include <zephyr/kernel.h>
#include <zephyr/dfu/mcuboot.h>
#include <zephyr/storage/flash_map.h>
#include <zephyr/sys/atomic.h>
#include <zephyr/sys/printk.h>
#include <zephyr/sys/util.h>

/* The dev kit enables one Timer Group watchdog and gives it this alias. The
 * second is disabled in the SoC devicetree, and the RTC watchdog is not
 * exposed to Zephyr at all on this part.
 */
#define WDT_NODE DT_ALIAS(watchdog0)

static const struct device *const wdt = DEVICE_DT_GET_OR_NULL(WDT_NODE);
static int wdt_channel = -1;

static atomic_t beacon_ticks;

/* How long the watchdog is given before it decides the device is not coming
 * back.
 *
 * Comfortably longer than one pass of the loop that feeds it, and comfortably
 * shorter than the health window, so a hang is caught during the trial rather
 * than after it. The research behind this tier could not pin down exactly how
 * the driver's second stage relates to its first, so the reset lands somewhere
 * between one and two times this value. That is enough to size a window
 * against the 60 second gate and not enough to quote a deadline, so no course
 * text quotes one.
 */
#define WDT_WINDOW_MS 10000

int health_gate_start_watchdog(void)
{
	struct wdt_timeout_cfg cfg = {
		.window.min = 0U,
		.window.max = WDT_WINDOW_MS,
		.callback = NULL,
		.flags = WDT_FLAG_RESET_SOC,
	};
	int err;

	if (wdt == NULL || !device_is_ready(wdt)) {
		printk("health.watchdog no watchdog device, a hung trial image would hang forever\n");
		return -ENODEV;
	}

	wdt_channel = wdt_install_timeout(wdt, &cfg);
	if (wdt_channel < 0) {
		printk("health.watchdog install failed err=%d\n", wdt_channel);
		return wdt_channel;
	}

	/* WDT_OPT_PAUSE_HALTED_BY_DBG keeps a paused debugger from resetting the
	 * board out from under whoever is reading it.
	 */
	err = wdt_setup(wdt, WDT_OPT_PAUSE_HALTED_BY_DBG);
	if (err != 0) {
		printk("health.watchdog setup failed err=%d\n", err);
		return err;
	}

	printk("health.watchdog armed at %d ms on channel %d\n", WDT_WINDOW_MS, wdt_channel);
	printk("health.watchdog it resets the chip only when a hang also blocks interrupts.\n");
	printk("health.watchdog The driver's own stage 0 handler feeds the watchdog, so a hang\n");
	printk("health.watchdog that still takes interrupts is fed forever. That gap is T5-W-03.\n");
	return 0;
}

void health_gate_note_beacon(void)
{
	atomic_inc(&beacon_ticks);

	if (wdt != NULL && wdt_channel >= 0) {
		(void)wdt_feed(wdt, wdt_channel);
	}
}

/* Check 1: the running image is one the bootloader was able to describe.
 *
 * MCUboot verified this image's signature before it ran, which is the check
 * that matters and is not one the application can repeat: the application is
 * the thing that would have to be trusted to repeat it. What the application
 * can establish is that it can read its own slot's header back and that the
 * header describes an image, which catches a primary slot that is not what
 * anybody thinks it is.
 *
 * The module text says exactly this. A check that overstated itself here would
 * teach a Learner to believe an application's word about its own integrity,
 * which is the habit the whole course is written against.
 */
static bool check_image_integrity(void)
{
	struct mcuboot_img_header header;
	int err;

	err = boot_read_bank_header(PARTITION_ID(slot0_partition), &header,
				    sizeof(header));
	if (err != 0) {
		printk("health.check the primary slot header is unreadable err=%d\n", err);
		return false;
	}
	return header.h.v1.image_size > 0U;
}

/* Check 2: the material this image needs in order to trust anything is
 * present.
 *
 * Both are compiled in, so this cannot fail on a correctly built image. It can
 * and does fail on one built without the Course certificate authority or
 * without the Release manifest verification key, which the build allows on
 * purpose so the repository still builds standalone. An image that trusts
 * nothing is the right failure, and a health gate that let it confirm anyway
 * would be the wrong one.
 */
static bool check_credentials_loaded(void)
{
	return ota_client_has_trust_anchor() && release_policy_has_key();
}

/* Check 3: the reference product is doing its job.
 *
 * This is section 6's "reference-product state handling". For a status beacon
 * the product state is the beacon producing status; there is no second thing
 * it can mean for this product.
 *
 * It is the only check that must keep holding for the whole window, which is
 * what makes the window a gate rather than a delay.
 */
static bool check_beacon_running(void)
{
	static atomic_val_t last;
	atomic_val_t now = atomic_get(&beacon_ticks);
	bool advanced = now != last;

	last = now;
	return advanced;
}

/* Check 4: the update client came up.
 *
 * Deliberately scoped to the client having initialised, never to it having
 * reached the service. Section 6 forbids loss of network service alone from
 * failing this gate, and this is the check that would otherwise violate it: an
 * "is the service reachable" check here would turn every network outage into a
 * revert, which is the endless loop the specification names by name.
 */
static bool check_update_client_ready(void)
{
#ifdef CONFIG_COURSE_TRIAL_FAIL_HEALTH
	/* The fail-health release fails exactly one named check while the other
	 * three visibly pass, so a Learner reads the cause instead of inferring
	 * it from where the output stopped.
	 *
	 * It fails at boot, before the window opens, which is what separates it
	 * from timeout-health: that release passes every check and then lets the
	 * window expire.
	 */
	printk("health.check update-client-ready is failed deliberately by this build\n");
	return false;
#else
	return ota_client_ready();
#endif
}

struct health_check {
	const char *name;
	bool (*run)(void);
	bool holds_for_window;
};

static const struct health_check checks[] = {
	{"image-integrity", check_image_integrity, false},
	{"credentials-loaded", check_credentials_loaded, false},
	{"beacon-running", check_beacon_running, true},
	{"update-client-ready", check_update_client_ready, false},
};

enum health_result health_gate_run(char *reason, size_t reason_len)
{
	bool failed = false;
	const char *first_failure = NULL;
	int64_t deadline;

	if (reason_len > 0U) {
		reason[0] = '\0';
	}

	printk("health.gate running %zu local checks, then a %d second window\n",
	       ARRAY_SIZE(checks), CONFIG_COURSE_HEALTH_GATE_SECONDS);
	printk("health.gate no check asks whether the service is reachable. Section 6 forbids\n");
	printk("health.gate network loss alone from failing this gate.\n");

	/* Every check runs. Stopping at the first failure would hide which of
	 * the others were fine, and the fail-health release is only legible
	 * because three checks visibly pass beside the one that does not.
	 */
	for (size_t i = 0; i < ARRAY_SIZE(checks); i++) {
		bool ok = checks[i].run();

		printk("health.check %-20s %s\n", checks[i].name, ok ? "pass" : "FAIL");
		if (!ok && !failed) {
			failed = true;
			first_failure = checks[i].name;
		}
	}

	if (failed) {
		if (reason_len > 0U) {
			strncpy(reason, first_failure, reason_len - 1);
			reason[reason_len - 1] = '\0';
		}
		printk("health.gate refused by %s before the window started\n", first_failure);
		return HEALTH_FAILED;
	}

	/* The window is timed from here, the end of the boot checks, rather than
	 * from boot. Starting it at boot would let a slow boot eat the window
	 * and make the gate's length depend on something it is not measuring.
	 */
	printk("health.gate every check passed, holding for %d seconds\n",
	       CONFIG_COURSE_HEALTH_GATE_SECONDS);

	deadline = k_uptime_get() + (int64_t)CONFIG_COURSE_HEALTH_GATE_SECONDS * 1000;
	while (k_uptime_get() < deadline) {
		k_sleep(K_SECONDS(5));

		for (size_t i = 0; i < ARRAY_SIZE(checks); i++) {
			if (!checks[i].holds_for_window) {
				continue;
			}
			if (!checks[i].run()) {
				int64_t left = (deadline - k_uptime_get()) / 1000;

				printk("health.check %-20s FAIL with %lld seconds left\n",
				       checks[i].name, (long long)left);
				if (reason_len > 0U) {
					strncpy(reason, checks[i].name, reason_len - 1);
					reason[reason_len - 1] = '\0';
				}
				/* The window is still running, so this is an
				 * expiry rather than a boot-time refusal. The
				 * timeout-health release reaches this line and
				 * the fail-health one does not.
				 */
				printk("health.gate window expired without a verdict\n");
				return HEALTH_TIMEOUT;
			}
		}
		printk("health.gate holding, %lld seconds left\n",
		       (long long)((deadline - k_uptime_get()) / 1000));
	}

	printk("health.gate passed\n");
	return HEALTH_PASSED;
}
```

## src/health_gate.h
```c
/*
 * The local health gate Tier 5 runs before it confirms an image.
 *
 * MCUboot starts a freshly swapped image as an unconfirmed test image. It has
 * already checked the signature and the security counter, which is everything
 * a bootloader can know. What it cannot know is whether the image works, and
 * that is what this gate is for.
 *
 * Four named checks, then a 60 second window. Every check is local. Section 6
 * is explicit that loss of network service alone must not fail the gate,
 * because local application health is separated from optional backend
 * reachability, so nothing here asks whether the service can be reached. A
 * device on a dead network passes this gate and confirms, and that is the
 * required behaviour rather than a gap in it.
 *
 * Every check runs and every result is printed, rather than stopping at the
 * first failure. This is the same choice Tier 4 made with its eight refusal
 * reasons: a Learner diagnosing a prepared failure needs to see which checks
 * passed, not only which one failed first. It is also what makes the
 * fail-health release legible, since one named check fails while three
 * visibly pass.
 */

#ifndef COURSE_HEALTH_GATE_H
#define COURSE_HEALTH_GATE_H

#include <stdbool.h>
#include <stddef.h>

enum health_result {
	/* Every check passed and the window elapsed with the device still
	 * healthy. The caller may confirm the image.
	 */
	HEALTH_PASSED = 0,
	/* A named check failed. The name is in the reason string. */
	HEALTH_FAILED,
	/* The window expired without every check being satisfied. Distinct
	 * from HEALTH_FAILED because the specification separates a failed
	 * check from an expired timer, and the two prepared releases that
	 * produce them are what make that separation observable.
	 */
	HEALTH_TIMEOUT,
};

/* Starts the watchdog that resets a trial image which hangs before it can
 * report failure.
 *
 * Nothing in this course has ever enabled the watchdog, and the esp32 driver
 * actively disables the hardware during its own init, so it is off until this
 * runs. An image that hangs on a board with no watchdog running looks exactly
 * like a control working.
 *
 * What this catches is narrower than it looks. The Zephyr esp32 driver
 * programs stage 0 as an interrupt and its own ISR feeds the watchdog at the
 * end, so the stage that resets the chip is reached only when interrupts are
 * blocked. A hang that still services interrupts is fed forever and never
 * reset, which includes a plain loop in a thread and an ordinary deadlock.
 * That is a real residual availability risk and it is in the Tier 5 weakness
 * ledger rather than hidden behind a watchdog that appears to catch
 * everything.
 */
int health_gate_start_watchdog(void);

/* Runs the four checks and then the window.
 *
 * reason is filled with the name of the check that failed, or with the name of
 * the check that was still unsatisfied when the window expired. It is left
 * empty on success.
 */
enum health_result health_gate_run(char *reason, size_t reason_len);

/* Reports that the reference product did a unit of work.
 *
 * This is what beacon-running observes, and it is also what feeds the
 * watchdog. One loop proves liveness and feeds the dog, so there is a single
 * thing whose stopping is the failure rather than two mechanisms to reason
 * about.
 */
void health_gate_note_beacon(void);

#endif /* COURSE_HEALTH_GATE_H */
```

## src/recovery_state.c
```c
#include "recovery_state.h"

#include <errno.h>
#include <string.h>

#include <zephyr/device.h>
/* zephyr/fs/nvs.h is deprecated in this Zephyr; the API is unchanged and only
 * the header moved.
 */
#include <zephyr/drivers/flash.h>
#include <zephyr/kvss/nvs.h>
#include <zephyr/kernel.h>
#include <zephyr/storage/flash_map.h>

/* NVS record identifiers.
 *
 * Small integers rather than strings, because this is NVS rather than the
 * settings subsystem. Settings would give string keys and a tidier API, and it
 * is built on NVS here, so it would be a layer of ergonomics over three
 * records with a handful of fields each. In the one tier whose subject is what
 * survives a power cut, a Learner is better served by seeing the write that
 * matters than by a nicer interface to it.
 */
#define RECOVERY_NVS_DOWNLOAD 1
#define RECOVERY_NVS_TRIAL 2
#define RECOVERY_NVS_FAILURE 3

#define STORAGE_PARTITION storage_partition

static struct nvs_fs course_nvs;
static bool mounted;

int recovery_state_init(void)
{
	struct flash_pages_info info;
	const struct device *flash_dev;
	int err;

	if (mounted) {
		return 0;
	}

	flash_dev = PARTITION_DEVICE(STORAGE_PARTITION);
	if (!device_is_ready(flash_dev)) {
		printk("recovery.state flash device not ready\n");
		return -ENODEV;
	}

	course_nvs.flash_device = flash_dev;
	course_nvs.offset = PARTITION_OFFSET(STORAGE_PARTITION);

	err = flash_get_page_info_by_offs(flash_dev, course_nvs.offset, &info);
	if (err != 0) {
		printk("recovery.state cannot describe the storage partition err=%d\n", err);
		return err;
	}

	/* NVS needs at least two sectors to rotate between. Three gives it room
	 * to garbage collect without the record ever being briefly absent,
	 * which matters here because the record being absent is indistinguishable
	 * from there being no download in progress.
	 */
	course_nvs.sector_size = info.size;
	course_nvs.sector_count = 3U;

	err = nvs_mount(&course_nvs);
	if (err != 0) {
		printk("recovery.state cannot mount the storage partition err=%d\n", err);
		return err;
	}

	mounted = true;
	printk("recovery.state mounted the storage partition at 0x%lx, %u sectors of %u bytes\n",
	       (unsigned long)course_nvs.offset, course_nvs.sector_count,
	       course_nvs.sector_size);
	printk("recovery.state this partition has been in the flash map since Tier 0 and Tier 5\n");
	printk("recovery.state is the first tier in the course to write anything to it\n");
	return 0;
}

static int read_record(uint16_t id, void *out, size_t len)
{
	ssize_t got;

	if (!mounted) {
		return -ENODEV;
	}
	got = nvs_read(&course_nvs, id, out, len);
	if (got == -ENOENT) {
		return -ENOENT;
	}
	if (got < 0) {
		return (int)got;
	}
	if ((size_t)got != len) {
		/* A record of the wrong length is a record written by different
		 * code. Treat it as absent rather than as data: reading a
		 * struct out of bytes that were never that struct is how a
		 * recovery mechanism becomes the thing it was meant to prevent.
		 */
		printk("recovery.state record %u is %d bytes, expected %zu; discarding it\n",
		       id, (int)got, len);
		(void)nvs_delete(&course_nvs, id);
		return -ENOENT;
	}
	return 0;
}

static int write_record(uint16_t id, const void *in, size_t len)
{
	ssize_t written;

	if (!mounted) {
		return -ENODEV;
	}
	written = nvs_write(&course_nvs, id, in, len);
	if (written < 0) {
		return (int)written;
	}
	return 0;
}

int recovery_download_read(struct download_record *record)
{
	return read_record(RECOVERY_NVS_DOWNLOAD, record, sizeof(*record));
}

int recovery_download_write(const struct download_record *record)
{
	return write_record(RECOVERY_NVS_DOWNLOAD, record, sizeof(*record));
}

int recovery_download_clear(void)
{
	if (!mounted) {
		return -ENODEV;
	}
	return nvs_delete(&course_nvs, RECOVERY_NVS_DOWNLOAD);
}

int recovery_trial_read(const char *release_id, uint32_t *attempts)
{
	struct trial_record record;
	int err;

	*attempts = 0U;
	err = read_record(RECOVERY_NVS_TRIAL, &record, sizeof(record));
	if (err == -ENOENT) {
		return 0;
	}
	if (err != 0) {
		return err;
	}
	if (strncmp(record.release_id, release_id, sizeof(record.release_id)) != 0) {
		/* The count belongs to a different release. A release the device
		 * is not being offered any more is not one it needs to remember
		 * having failed.
		 */
		return 0;
	}
	*attempts = record.attempts;
	return 0;
}

int recovery_trial_peek(struct trial_record *record)
{
	return read_record(RECOVERY_NVS_TRIAL, record, sizeof(*record));
}

int recovery_trial_begin(const char *release_id, uint32_t *attempt)
{
	struct trial_record record;
	uint32_t attempts = 0U;
	int err;

	err = recovery_trial_read(release_id, &attempts);
	if (err != 0) {
		return err;
	}

	/* The memset is what clears reported. A new trial has not been reported
	 * because it has not happened yet, and writing the whole record in one
	 * go is what stops the mark from outliving the trial it belongs to.
	 */
	memset(&record, 0, sizeof(record));
	strncpy(record.release_id, release_id, sizeof(record.release_id) - 1);
	record.attempts = attempts + 1U;

	err = write_record(RECOVERY_NVS_TRIAL, &record, sizeof(record));
	if (err != 0) {
		return err;
	}
	*attempt = record.attempts;
	return 0;
}

int recovery_trial_clear(void)
{
	if (!mounted) {
		return -ENODEV;
	}
	return nvs_delete(&course_nvs, RECOVERY_NVS_TRIAL);
}

int recovery_trial_mark_reported(void)
{
	struct trial_record record;
	int err;

	err = read_record(RECOVERY_NVS_TRIAL, &record, sizeof(record));
	if (err != 0) {
		return err;
	}
	if (record.reported) {
		return 0;
	}
	record.reported = true;
	return write_record(RECOVERY_NVS_TRIAL, &record, sizeof(record));
}

int recovery_failure_write(const char *release_id, const char *reason)
{
	struct failure_record record;

	memset(&record, 0, sizeof(record));
	strncpy(record.release_id, release_id, sizeof(record.release_id) - 1);
	strncpy(record.reason, reason, sizeof(record.reason) - 1);
	return write_record(RECOVERY_NVS_FAILURE, &record, sizeof(record));
}

int recovery_failure_take(struct failure_record *record)
{
	int err;

	err = read_record(RECOVERY_NVS_FAILURE, record, sizeof(*record));
	if (err != 0) {
		return err;
	}
	(void)nvs_delete(&course_nvs, RECOVERY_NVS_FAILURE);
	return 0;
}

void recovery_state_report(void)
{
	struct download_record download;
	struct trial_record trial;

	if (!mounted) {
		printk("recovery.state not mounted, so nothing survives a power cut\n");
		return;
	}

	if (recovery_download_read(&download) == 0) {
		printk("recovery.state download release_id=%s offset=%u size=%u\n",
		       download.release_id, download.offset, download.size);
		printk("recovery.state that many bytes are known to be in the secondary slot.\n");
		printk("recovery.state The record is written after the bytes, so it may lag the\n");
		printk("recovery.state flash and can never describe more than the flash holds.\n");
	} else {
		printk("recovery.state download none in progress\n");
	}

	if (read_record(RECOVERY_NVS_TRIAL, &trial, sizeof(trial)) == 0) {
		printk("recovery.state trial release_id=%s attempts=%u of %d reported=%s\n",
		       trial.release_id, trial.attempts,
		       CONFIG_COURSE_TRIAL_FAILURE_LIMIT,
		       trial.reported ? "yes" : "no");
	} else {
		printk("recovery.state trial no release is being tried\n");
	}
}
```

## src/recovery_state.h
```c
/*
 * The state Tier 5 keeps in flash so a power cut is survivable.
 *
 * This is the first use of the 192 KiB storage partition at 0x3b0000. It has
 * been in the pinned flash map since Tier 0 and no tier has written to it, so
 * everything here is new ground for the course rather than an extension of
 * something earlier.
 *
 * Three records, each answering a question the device cannot answer from the
 * slot contents alone:
 *
 *   download  where a partial transfer got to, and what it was transferring
 *   trial     how many times a release has been put on trial
 *   failure   why the last trial gave up, for the boot that happens after it
 *
 * None of these is trusted input. The download record says where to resume,
 * never what to believe: a resume re-fetches the Release manifest and verifies
 * its signature again before the record is allowed to matter. Keeping that
 * distinction is the point. In the one tier that introduces persistent state,
 * promoting flash contents to a trust anchor would be exactly the wrong habit
 * to teach.
 */

#ifndef COURSE_RECOVERY_STATE_H
#define COURSE_RECOVERY_STATE_H

#include <stdbool.h>
#include <stddef.h>
#include <stdint.h>

#define RECOVERY_ID_MAX 64
#define RECOVERY_DIGEST_MAX 72
#define RECOVERY_REASON_MAX 64

/* Where a partial download got to.
 *
 * offset is the number of image bytes known to be in the secondary slot. It is
 * written after those bytes reach flash, never before, so it can only ever
 * describe less than the slot holds. A record that over-claims would resume
 * into a gap and produce a corrupt image that only the digest would catch; a
 * record that under-claims costs at most one checkpoint of re-downloaded
 * bytes. Only one of those is safe, so the record always lags the flash.
 *
 * size and digest are copied from the verified manifest at the time the
 * download started. They are kept so a resume can tell that the release
 * changed underneath it without asking the service, which matters because
 * Tier 4 established the service as the party that chooses what a device is
 * offered.
 */
struct download_record {
	char release_id[RECOVERY_ID_MAX];
	char digest[RECOVERY_DIGEST_MAX];
	uint32_t offset;
	uint32_t size;
};

/* How many times one release has been put on trial.
 *
 * The count is incremented when a trial begins, never when one fails. A
 * crashing image never reaches code that could record a failure, and a hung
 * one is reset from interrupt context where an NVS write is not safe, so a
 * count kept on failure would miss the two failures that most need counting.
 * Counting attempts rather than failures is robust against a trial image
 * dying in any manner at all, including manners nobody has thought of.
 */
struct trial_record {
	char release_id[RECOVERY_ID_MAX];
	uint32_t attempts;
};

/* Why the last trial gave up.
 *
 * Only two of the four trial failures can fill this in. A failed health check
 * and an expired health window both happen in thread context with time to
 * spare. A crash and a hang do not: the device can tell you why it gave up
 * only if it was still alive enough to write it down.
 *
 * That asymmetry is not a defect to engineer around. It is the honest
 * description of what a watchdog reset is, and Tier 5 teaches it rather than
 * hiding it behind a uniform-looking report.
 */
struct failure_record {
	char release_id[RECOVERY_ID_MAX];
	char reason[RECOVERY_REASON_MAX];
};

/* Mounts the storage partition. Every function below returns -ENODEV until
 * this has succeeded.
 */
int recovery_state_init(void);

/* Reads the download record. Returns 0 when one was found, -ENOENT when there
 * is no partial download recorded.
 */
int recovery_download_read(struct download_record *record);

/* Writes the download record. Call after the bytes it describes are in flash.
 */
int recovery_download_write(const struct download_record *record);

/* Forgets any partial download.
 *
 * Call this before erasing the slot, which is the mirror of the write order
 * and for the same reason. Writing lags the flash so the record can only
 * under-claim; discarding leads it so a power cut in the middle leaves no
 * record rather than a record pointing into an erased slot. One rule underneath
 * both: the record may never describe more than the flash holds.
 */
int recovery_download_clear(void);

/* Reads the trial count for a release. Returns 0 with attempts set to zero
 * when the release has never been tried.
 */
int recovery_trial_read(const char *release_id, uint32_t *attempts);

/* Records that a trial of this release is about to begin, and reports the
 * attempt number it is. Starting a different release forgets the previous
 * one's count.
 */
int recovery_trial_begin(const char *release_id, uint32_t *attempt);

/* Forgets the trial count, which happens when a release confirms. */
int recovery_trial_clear(void);

/* Records why a trial gave up, for the boot that follows the revert. */
int recovery_failure_write(const char *release_id, const char *reason);

/* Reads and then forgets the reason the last trial gave up. Returns -ENOENT
 * when nothing wrote one, which is what a crash or a hang leaves behind.
 */
int recovery_failure_take(struct failure_record *record);

/* Prints every record. A state a Learner cannot see is a state they cannot be
 * taught, so this runs at boot and again on every resume.
 */
void recovery_state_report(void);

#endif /* COURSE_RECOVERY_STATE_H */
```
